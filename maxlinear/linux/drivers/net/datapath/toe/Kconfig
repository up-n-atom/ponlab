## open_uboot/config/arch/arm/Kconfig.debug
```kconfig
menu "ARM debug"

config UBOOT_CONFIG_DEBUG_LL
	bool "Low-level debugging functions"
	depends on !UBOOT_CONFIG_ARM64
	help
	  Say Y here to include definitions of printascii, printch, printhex
	  in U-Boot.  This is helpful if you are debugging code that
	  executes before the console is initialized.

choice
	prompt "Low-level debugging port"
	depends on UBOOT_CONFIG_DEBUG_LL

	config UBOOT_CONFIG_DEBUG_LL_UART_8250
		bool "Low-level debugging via 8250 UART"
		help
		  Say Y here if you wish the debug print routes to direct
		  their output to an 8250 UART.  You can use this option
		  to provide the parameters for the 8250 UART rather than
		  selecting one of the platform specific options above if
		  you know the parameters for the port.

		  This option is preferred over the platform specific
		  options; the platform specific options are deprecated
		  and will be soon removed.

endchoice

config UBOOT_CONFIG_DEBUG_LL_INCLUDE
	string
	depends on UBOOT_CONFIG_DEBUG_LL
	default "debug/8250.S" if UBOOT_CONFIG_DEBUG_LL_UART_8250 || UBOOT_CONFIG_DEBUG_UART_8250
	default "mach/debug-macro.S"

# Compatibility options for 8250
config UBOOT_CONFIG_DEBUG_UART_8250
	bool

config UBOOT_CONFIG_DEBUG_UART_PHYS
	hex "Physical base address of debug UART"
	depends on UBOOT_CONFIG_DEBUG_LL_UART_8250 || UBOOT_CONFIG_DEBUG_UART_8250

# This is not used in U-Boot
config UBOOT_CONFIG_DEBUG_UART_VIRT
	hex
	default UBOOT_CONFIG_DEBUG_UART_PHYS
	depends on UBOOT_CONFIG_DEBUG_LL_UART_8250 || UBOOT_CONFIG_DEBUG_UART_8250

config UBOOT_CONFIG_DEBUG_UART_8250_SHIFT
	int "Register offset shift for the 8250 debug UART"
	depends on UBOOT_CONFIG_DEBUG_LL_UART_8250 || UBOOT_CONFIG_DEBUG_UART_8250
	default 2

config UBOOT_CONFIG_DEBUG_UART_8250_WORD
	bool "Use 32-bit accesses for 8250 UART"
	depends on UBOOT_CONFIG_DEBUG_LL_UART_8250 || UBOOT_CONFIG_DEBUG_UART_8250
	depends on UBOOT_CONFIG_DEBUG_UART_8250_SHIFT >= 2

config UBOOT_CONFIG_DEBUG_UART_8250_FLOW_CONTROL
	bool "Enable flow control for 8250 UART"
	depends on UBOOT_CONFIG_DEBUG_LL_UART_8250 || UBOOT_CONFIG_DEBUG_UART_8250

endmenu
```

## open_uboot/config/arch/arm/cpu/armv7/ls102xa/Kconfig
```kconfig
config UBOOT_CONFIG_ARCH_LS1021A
	bool
	select UBOOT_CONFIG_SYS_FSL_DDR_BE if SYS_FSL_DDR
	select UBOOT_CONFIG_SYS_FSL_DDR_VER_50 if SYS_FSL_DDR
	select UBOOT_CONFIG_SYS_FSL_ERRATUM_A008378
	select UBOOT_CONFIG_SYS_FSL_ERRATUM_A008407
	select UBOOT_CONFIG_SYS_FSL_ERRATUM_A008850
	select UBOOT_CONFIG_SYS_FSL_ERRATUM_A008997 if USB
	select UBOOT_CONFIG_SYS_FSL_ERRATUM_A009007 if USB
	select UBOOT_CONFIG_SYS_FSL_ERRATUM_A009008 if USB
	select UBOOT_CONFIG_SYS_FSL_ERRATUM_A009663
	select UBOOT_CONFIG_SYS_FSL_ERRATUM_A009798 if USB
	select UBOOT_CONFIG_SYS_FSL_ERRATUM_A009942
	select UBOOT_CONFIG_SYS_FSL_ERRATUM_A010315
	select UBOOT_CONFIG_SYS_FSL_HAS_CCI400
	select UBOOT_CONFIG_SYS_FSL_HAS_DDR3 if SYS_FSL_DDR
	select UBOOT_CONFIG_SYS_FSL_HAS_DDR4 if SYS_FSL_DDR
	select UBOOT_CONFIG_SYS_FSL_HAS_SEC
	select UBOOT_CONFIG_SYS_FSL_SEC_COMPAT_5
	select UBOOT_CONFIG_SYS_FSL_SEC_LE
	select UBOOT_CONFIG_SYS_FSL_SRDS_1
	select UBOOT_CONFIG_SYS_HAS_SERDES
	select UBOOT_CONFIG_SYS_I2C_MXC
	imply CMD_PCI
	imply SCSI
	imply SCSI_AHCI

menu "LS102xA architecture"
	depends on UBOOT_CONFIG_ARCH_LS1021A

config UBOOT_CONFIG_LS1_DEEP_SLEEP
	bool "Deep sleep"

config UBOOT_CONFIG_MAX_CPUS
	int "Maximum number of CPUs permitted for LS102xA"
	default 2
	help
	  Set this number to the maximum number of possible CPUs in the SoC.
	  SoCs may have multiple clusters with each cluster may have multiple
	  ports. If some ports are reserved but higher ports are used for
	  cores, count the reserved ports. This will allocate enough memory
	  in spin table to properly handle all cores.

config UBOOT_CONFIG_NXP_ESBC
	bool	"NXP_ESBC"
	help
		Enable Freescale Secure Boot feature. Normally selected
		by defconfig. If unsure, do not change.

config UBOOT_CONFIG_SYS_CCI400_OFFSET
	hex "Offset for CCI400 base"
	depends on UBOOT_CONFIG_SYS_FSL_HAS_CCI400
	default 0x180000
	help
	  Offset for CCI400 base.
	  CCI400 base addr = CCSRBAR + CCI400_OFFSET

config UBOOT_CONFIG_SYS_FSL_ERRATUM_A008850
	bool
	help
	  Workaround for DDR erratum A008850

config UBOOT_CONFIG_SYS_FSL_ERRATUM_A008997
	bool
	help
	  Workaround for USB PHY erratum A008997

config UBOOT_CONFIG_SYS_FSL_ERRATUM_A009007
	bool
	help
	  Workaround for USB PHY erratum A009007

config UBOOT_CONFIG_SYS_FSL_ERRATUM_A009008
	bool
	help
	  Workaround for USB PHY erratum A009008

config UBOOT_CONFIG_SYS_FSL_ERRATUM_A009798
	bool
	help
	  Workaround for USB PHY erratum A009798

config UBOOT_CONFIG_SYS_FSL_ERRATUM_A010315
	bool "Workaround for PCIe erratum A010315"

config UBOOT_CONFIG_SYS_FSL_HAS_CCI400
	bool

config UBOOT_CONFIG_SYS_FSL_SRDS_1
	bool

config UBOOT_CONFIG_SYS_FSL_SRDS_2
	bool

config UBOOT_CONFIG_SYS_HAS_SERDES
	bool

config UBOOT_CONFIG_SYS_FSL_IFC_BANK_COUNT
	int "Maximum banks of Integrated flash controller"
	default 8

config UBOOT_CONFIG_SYS_FSL_ERRATUM_A008407
	bool

endmenu
```
