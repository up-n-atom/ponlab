## open_uboot/config/arch/arm/cpu/armv8/fsl-layerscape/Kconfig
```kconfig
config UBOOT_CONFIG_ARCH_LS1012A
	bool
	select UBOOT_CONFIG_ARMV8_SET_SMPEN
	select UBOOT_CONFIG_ARM_ERRATA_855873 if !TFABOOT
	select UBOOT_CONFIG_FSL_LAYERSCAPE
	select UBOOT_CONFIG_FSL_LSCH2
	select UBOOT_CONFIG_GICV2
	select UBOOT_CONFIG_SKIP_LOWLEVEL_INIT
	select UBOOT_CONFIG_SYS_FSL_SRDS_1
	select UBOOT_CONFIG_SYS_HAS_SERDES
	select UBOOT_CONFIG_SYS_FSL_DDR_BE
	select UBOOT_CONFIG_SYS_FSL_MMDC
	select UBOOT_CONFIG_SYS_FSL_ERRATUM_A010315 if PCIE_LAYERSCAPE
	select UBOOT_CONFIG_SYS_FSL_ERRATUM_A009798
	select UBOOT_CONFIG_SYS_FSL_ERRATUM_A008997
	select UBOOT_CONFIG_SYS_FSL_ERRATUM_A009007
	select UBOOT_CONFIG_SYS_FSL_ERRATUM_A009008
	select UBOOT_CONFIG_ARCH_EARLY_INIT_R
	select UBOOT_CONFIG_BOARD_EARLY_INIT_F
	select UBOOT_CONFIG_SYS_I2C_MXC
	select UBOOT_CONFIG_SYS_I2C_MXC_I2C1 if !DM_I2C
	select UBOOT_CONFIG_SYS_I2C_MXC_I2C2 if !DM_I2C
	imply PANIC_HANG

config UBOOT_CONFIG_ARCH_LS1028A
	bool
	select UBOOT_CONFIG_ARMV8_SET_SMPEN
	select UBOOT_CONFIG_FSL_LAYERSCAPE
	select UBOOT_CONFIG_FSL_LSCH3
	select UBOOT_CONFIG_GICV3
	select UBOOT_CONFIG_NXP_LSCH3_2
	select UBOOT_CONFIG_SYS_FSL_HAS_CCI400
	select UBOOT_CONFIG_SYS_FSL_SRDS_1
	select UBOOT_CONFIG_SYS_HAS_SERDES
	select UBOOT_CONFIG_SYS_FSL_DDR
	select UBOOT_CONFIG_SYS_FSL_DDR_LE
	select UBOOT_CONFIG_SYS_FSL_DDR_VER_50
	select UBOOT_CONFIG_SYS_FSL_HAS_DDR3
	select UBOOT_CONFIG_SYS_FSL_HAS_DDR4
	select UBOOT_CONFIG_SYS_FSL_HAS_SEC
	select UBOOT_CONFIG_SYS_FSL_SEC_COMPAT_5
	select UBOOT_CONFIG_SYS_FSL_SEC_LE
	select UBOOT_CONFIG_FSL_TZASC_1
	select UBOOT_CONFIG_ARCH_EARLY_INIT_R
	select UBOOT_CONFIG_BOARD_EARLY_INIT_F
	select UBOOT_CONFIG_SYS_I2C_MXC
	select UBOOT_CONFIG_SYS_FSL_ERRATUM_A008997
	select UBOOT_CONFIG_SYS_FSL_ERRATUM_A009007
	select UBOOT_CONFIG_SYS_FSL_ERRATUM_A008514 if !TFABOOT
	select UBOOT_CONFIG_SYS_FSL_ERRATUM_A009663 if !TFABOOT
	select UBOOT_CONFIG_SYS_FSL_ERRATUM_A009942 if !TFABOOT
	select UBOOT_CONFIG_SYS_FSL_ERRATUM_A050382
	select UBOOT_CONFIG_SYS_FSL_ERRATUM_A011334
	select UBOOT_CONFIG_SYS_FSL_ESDHC_UNRELIABLE_PULSE_DETECTION_WORKAROUND
	select UBOOT_CONFIG_RESV_RAM if GIC_V3_ITS
	imply PANIC_HANG

config UBOOT_CONFIG_ARCH_LS1043A
	bool
	select UBOOT_CONFIG_ARMV8_SET_SMPEN
	select UBOOT_CONFIG_ARM_ERRATA_855873 if !TFABOOT
	select UBOOT_CONFIG_FSL_LAYERSCAPE
	select UBOOT_CONFIG_FSL_LSCH2
	select UBOOT_CONFIG_GICV2
	select UBOOT_CONFIG_HAS_FSL_XHCI_USB if USB_HOST
	select UBOOT_CONFIG_SKIP_LOWLEVEL_INIT
	select UBOOT_CONFIG_SYS_FSL_SRDS_1
	select UBOOT_CONFIG_SYS_HAS_SERDES
	select UBOOT_CONFIG_SYS_FSL_DDR
	select UBOOT_CONFIG_SYS_FSL_DDR_BE
	select UBOOT_CONFIG_SYS_FSL_DDR_VER_50
	select UBOOT_CONFIG_SYS_FSL_ERRATUM_A008850 if !TFABOOT
	select UBOOT_CONFIG_SYS_FSL_ERRATUM_A008997
	select UBOOT_CONFIG_SYS_FSL_ERRATUM_A009007
	select UBOOT_CONFIG_SYS_FSL_ERRATUM_A009008
	select UBOOT_CONFIG_SYS_FSL_ERRATUM_A009660 if !TFABOOT
	select UBOOT_CONFIG_SYS_FSL_ERRATUM_A009663 if !TFABOOT
	select UBOOT_CONFIG_SYS_FSL_ERRATUM_A009798
	select UBOOT_CONFIG_SYS_FSL_ERRATUM_A009942 if !TFABOOT
	select UBOOT_CONFIG_SYS_FSL_ERRATUM_A010315 if PCIE_LAYERSCAPE
	select UBOOT_CONFIG_SYS_FSL_ERRATUM_A010539
	select UBOOT_CONFIG_SYS_FSL_HAS_DDR3
	select UBOOT_CONFIG_SYS_FSL_HAS_DDR4
	select UBOOT_CONFIG_ARCH_EARLY_INIT_R
	select UBOOT_CONFIG_BOARD_EARLY_INIT_F
	select UBOOT_CONFIG_SYS_I2C_MXC
	select UBOOT_CONFIG_SYS_I2C_MXC_I2C1 if !DM_I2C
	select UBOOT_CONFIG_SYS_I2C_MXC_I2C2 if !DM_I2C
	select UBOOT_CONFIG_SYS_I2C_MXC_I2C3 if !DM_I2C
	select UBOOT_CONFIG_SYS_I2C_MXC_I2C4 if !DM_I2C
	imply CMD_PCI
	imply ID_EEPROM

config UBOOT_CONFIG_ARCH_LS1046A
	bool
	select UBOOT_CONFIG_ARMV8_SET_SMPEN
	select UBOOT_CONFIG_FSL_LAYERSCAPE
	select UBOOT_CONFIG_FSL_LSCH2
	select UBOOT_CONFIG_GICV2
	select UBOOT_CONFIG_HAS_FSL_XHCI_USB if USB_HOST
	select UBOOT_CONFIG_SKIP_LOWLEVEL_INIT
	select UBOOT_CONFIG_SYS_FSL_SRDS_1
	select UBOOT_CONFIG_SYS_HAS_SERDES
	select UBOOT_CONFIG_SYS_FSL_DDR
	select UBOOT_CONFIG_SYS_FSL_DDR_BE
	select UBOOT_CONFIG_SYS_FSL_DDR_VER_50
	select UBOOT_CONFIG_SYS_FSL_ERRATUM_A008336 if !TFABOOT
	select UBOOT_CONFIG_SYS_FSL_ERRATUM_A008511 if !TFABOOT
	select UBOOT_CONFIG_SYS_FSL_ERRATUM_A008850 if !TFABOOT
	select UBOOT_CONFIG_SYS_FSL_ERRATUM_A008997
	select UBOOT_CONFIG_SYS_FSL_ERRATUM_A009007
	select UBOOT_CONFIG_SYS_FSL_ERRATUM_A009008
	select UBOOT_CONFIG_SYS_FSL_ERRATUM_A009798
	select UBOOT_CONFIG_SYS_FSL_ERRATUM_A009801
	select UBOOT_CONFIG_SYS_FSL_ERRATUM_A009803 if !TFABOOT
	select UBOOT_CONFIG_SYS_FSL_ERRATUM_A009942 if !TFABOOT
	select UBOOT_CONFIG_SYS_FSL_ERRATUM_A010165 if !TFABOOT
	select UBOOT_CONFIG_SYS_FSL_ERRATUM_A010539
	select UBOOT_CONFIG_SYS_FSL_HAS_DDR4
	select UBOOT_CONFIG_SYS_FSL_SRDS_2
	select UBOOT_CONFIG_ARCH_EARLY_INIT_R
	select UBOOT_CONFIG_BOARD_EARLY_INIT_F
	select UBOOT_CONFIG_SYS_I2C_MXC
	select UBOOT_CONFIG_SYS_I2C_MXC_I2C1 if !DM_I2C
	select UBOOT_CONFIG_SYS_I2C_MXC_I2C2 if !DM_I2C
	select UBOOT_CONFIG_SYS_I2C_MXC_I2C3 if !DM_I2C
	select UBOOT_CONFIG_SYS_I2C_MXC_I2C4 if !DM_I2C
	imply ID_EEPROM
	imply SCSI
	imply SCSI_AHCI
	imply SPL_SYS_I2C_LEGACY

config UBOOT_CONFIG_ARCH_LS1088A
	bool
	select UBOOT_CONFIG_ARMV8_SET_SMPEN
	select UBOOT_CONFIG_ARM_ERRATA_855873 if !TFABOOT
	select UBOOT_CONFIG_FSL_LAYERSCAPE
	select UBOOT_CONFIG_FSL_LSCH3
	select UBOOT_CONFIG_GICV3
	select UBOOT_CONFIG_SKIP_LOWLEVEL_INIT
	select UBOOT_CONFIG_SYS_FSL_SRDS_1
	select UBOOT_CONFIG_SYS_HAS_SERDES
	select UBOOT_CONFIG_SYS_FSL_DDR
	select UBOOT_CONFIG_SYS_FSL_DDR_LE
	select UBOOT_CONFIG_SYS_FSL_DDR_VER_50
	select UBOOT_CONFIG_SYS_FSL_EC1
	select UBOOT_CONFIG_SYS_FSL_EC2
	select UBOOT_CONFIG_SYS_FSL_ERRATUM_A009803 if !TFABOOT
	select UBOOT_CONFIG_SYS_FSL_ERRATUM_A009942 if !TFABOOT
	select UBOOT_CONFIG_SYS_FSL_ERRATUM_A010165 if !TFABOOT
	select UBOOT_CONFIG_SYS_FSL_ERRATUM_A008511 if !TFABOOT
	select UBOOT_CONFIG_SYS_FSL_ERRATUM_A008850 if !TFABOOT
	select UBOOT_CONFIG_SYS_FSL_ERRATUM_A009007
	select UBOOT_CONFIG_SYS_FSL_HAS_CCI400
	select UBOOT_CONFIG_SYS_FSL_HAS_DDR4
	select UBOOT_CONFIG_SYS_FSL_HAS_RGMII
	select UBOOT_CONFIG_SYS_FSL_HAS_SEC
	select UBOOT_CONFIG_SYS_FSL_SEC_COMPAT_5
	select UBOOT_CONFIG_SYS_FSL_SEC_LE
	select UBOOT_CONFIG_SYS_FSL_SRDS_1
	select UBOOT_CONFIG_SYS_FSL_SRDS_2
	select UBOOT_CONFIG_FSL_TZASC_1
	select UBOOT_CONFIG_FSL_TZASC_400
	select UBOOT_CONFIG_FSL_TZPC_BP147
	select UBOOT_CONFIG_ARCH_EARLY_INIT_R
	select UBOOT_CONFIG_BOARD_EARLY_INIT_F
	select UBOOT_CONFIG_SYS_I2C_MXC
	select UBOOT_CONFIG_SYS_I2C_MXC_I2C1 if !TFABOOT
	select UBOOT_CONFIG_SYS_I2C_MXC_I2C2 if !TFABOOT
	select UBOOT_CONFIG_SYS_I2C_MXC_I2C3 if !TFABOOT
	select UBOOT_CONFIG_SYS_I2C_MXC_I2C4 if !TFABOOT
	select UBOOT_CONFIG_RESV_RAM if GIC_V3_ITS
	imply ID_EEPROM
	imply SCSI
	imply SPL_SYS_I2C_LEGACY
	imply PANIC_HANG

config UBOOT_CONFIG_ARCH_LS2080A
	bool
	select UBOOT_CONFIG_ARMV8_SET_SMPEN
	select UBOOT_CONFIG_ARM_ERRATA_826974
	select UBOOT_CONFIG_ARM_ERRATA_828024
	select UBOOT_CONFIG_ARM_ERRATA_829520
	select UBOOT_CONFIG_ARM_ERRATA_833471
	select UBOOT_CONFIG_FSL_LAYERSCAPE
	select UBOOT_CONFIG_FSL_LSCH3
	select UBOOT_CONFIG_GICV3
	select UBOOT_CONFIG_SKIP_LOWLEVEL_INIT
	select UBOOT_CONFIG_SYS_FSL_SRDS_1
	select UBOOT_CONFIG_SYS_HAS_SERDES
	select UBOOT_CONFIG_SYS_FSL_DDR
	select UBOOT_CONFIG_SYS_FSL_DDR_LE
	select UBOOT_CONFIG_SYS_FSL_DDR_VER_50
	select UBOOT_CONFIG_SYS_FSL_HAS_CCN504
	select UBOOT_CONFIG_SYS_FSL_HAS_DP_DDR
	select UBOOT_CONFIG_SYS_FSL_HAS_SEC
	select UBOOT_CONFIG_SYS_FSL_HAS_DDR4
	select UBOOT_CONFIG_SYS_FSL_SEC_COMPAT_5
	select UBOOT_CONFIG_SYS_FSL_SEC_LE
	select UBOOT_CONFIG_SYS_FSL_SRDS_2
	select UBOOT_CONFIG_FSL_TZASC_1
	select UBOOT_CONFIG_FSL_TZASC_2
	select UBOOT_CONFIG_FSL_TZASC_400
	select UBOOT_CONFIG_FSL_TZPC_BP147
	select UBOOT_CONFIG_SYS_FSL_ERRATUM_A008336 if !TFABOOT
	select UBOOT_CONFIG_SYS_FSL_ERRATUM_A008511 if !TFABOOT
	select UBOOT_CONFIG_SYS_FSL_ERRATUM_A008514 if !TFABOOT
	select UBOOT_CONFIG_SYS_FSL_ERRATUM_A008585
	select UBOOT_CONFIG_SYS_FSL_ERRATUM_A008997
	select UBOOT_CONFIG_SYS_FSL_ERRATUM_A009007
	select UBOOT_CONFIG_SYS_FSL_ERRATUM_A009008
	select UBOOT_CONFIG_SYS_FSL_ERRATUM_A009635
	select UBOOT_CONFIG_SYS_FSL_ERRATUM_A009663 if !TFABOOT
	select UBOOT_CONFIG_SYS_FSL_ERRATUM_A009798
	select UBOOT_CONFIG_SYS_FSL_ERRATUM_A009801
	select UBOOT_CONFIG_SYS_FSL_ERRATUM_A009803 if !TFABOOT
	select UBOOT_CONFIG_SYS_FSL_ERRATUM_A009942 if !TFABOOT
	select UBOOT_CONFIG_SYS_FSL_ERRATUM_A010165 if !TFABOOT
	select UBOOT_CONFIG_SYS_FSL_ERRATUM_A009203
	select UBOOT_CONFIG_ARCH_EARLY_INIT_R
	select UBOOT_CONFIG_BOARD_EARLY_INIT_F
	select UBOOT_CONFIG_SYS_I2C_MXC
	select UBOOT_CONFIG_SYS_I2C_MXC_I2C1 if !TFABOOT
	select UBOOT_CONFIG_SYS_I2C_MXC_I2C2 if !TFABOOT
	select UBOOT_CONFIG_SYS_I2C_MXC_I2C3 if !TFABOOT
	select UBOOT_CONFIG_SYS_I2C_MXC_I2C4 if !TFABOOT
	select UBOOT_CONFIG_RESV_RAM if GIC_V3_ITS
	imply DISTRO_DEFAULTS
	imply ID_EEPROM
	imply PANIC_HANG
	imply SPL_SYS_I2C_LEGACY

config UBOOT_CONFIG_ARCH_LX2162A
	bool
	select UBOOT_CONFIG_ARMV8_SET_SMPEN
	select UBOOT_CONFIG_FSL_LAYERSCAPE
	select UBOOT_CONFIG_FSL_LSCH3
	select UBOOT_CONFIG_GICV3
	select UBOOT_CONFIG_NXP_LSCH3_2
	select UBOOT_CONFIG_SYS_HAS_SERDES
	select UBOOT_CONFIG_SYS_FSL_SRDS_1
	select UBOOT_CONFIG_SYS_FSL_SRDS_2
	select UBOOT_CONFIG_SYS_FSL_DDR
	select UBOOT_CONFIG_SYS_FSL_DDR_LE
	select UBOOT_CONFIG_SYS_FSL_DDR_VER_50
	select UBOOT_CONFIG_SYS_FSL_EC1
	select UBOOT_CONFIG_SYS_FSL_EC2
	select UBOOT_CONFIG_SYS_FSL_ERRATUM_A050204
	select UBOOT_CONFIG_SYS_FSL_ERRATUM_A011334
	select UBOOT_CONFIG_SYS_FSL_ESDHC_UNRELIABLE_PULSE_DETECTION_WORKAROUND
	select UBOOT_CONFIG_SYS_FSL_HAS_RGMII
	select UBOOT_CONFIG_SYS_FSL_HAS_SEC
	select UBOOT_CONFIG_SYS_FSL_HAS_CCN508
	select UBOOT_CONFIG_SYS_FSL_HAS_DDR4
	select UBOOT_CONFIG_SYS_FSL_SEC_COMPAT_5
	select UBOOT_CONFIG_SYS_FSL_SEC_LE
	select UBOOT_CONFIG_ARCH_EARLY_INIT_R
	select UBOOT_CONFIG_BOARD_EARLY_INIT_F
	select UBOOT_CONFIG_SYS_I2C_MXC
	select UBOOT_CONFIG_RESV_RAM if GIC_V3_ITS
	imply DISTRO_DEFAULTS
	imply PANIC_HANG
	imply SCSI
	imply SCSI_AHCI
	imply SPL_SYS_I2C_LEGACY

config UBOOT_CONFIG_ARCH_LX2160A
	bool
	select UBOOT_CONFIG_ARMV8_SET_SMPEN
	select UBOOT_CONFIG_FSL_LAYERSCAPE
	select UBOOT_CONFIG_FSL_LSCH3
	select UBOOT_CONFIG_GICV3
	select UBOOT_CONFIG_HAS_FSL_XHCI_USB if USB_HOST
	select UBOOT_CONFIG_NXP_LSCH3_2
	select UBOOT_CONFIG_SYS_HAS_SERDES
	select UBOOT_CONFIG_SYS_FSL_SRDS_1
	select UBOOT_CONFIG_SYS_FSL_SRDS_2
	select UBOOT_CONFIG_SYS_NXP_SRDS_3
	select UBOOT_CONFIG_SYS_FSL_DDR
	select UBOOT_CONFIG_SYS_FSL_DDR_LE
	select UBOOT_CONFIG_SYS_FSL_DDR_VER_50
	select UBOOT_CONFIG_SYS_FSL_EC1
	select UBOOT_CONFIG_SYS_FSL_EC2
	select UBOOT_CONFIG_SYS_FSL_ERRATUM_A050204
	select UBOOT_CONFIG_SYS_FSL_ERRATUM_A011334
	select UBOOT_CONFIG_SYS_FSL_ESDHC_UNRELIABLE_PULSE_DETECTION_WORKAROUND
	select UBOOT_CONFIG_SYS_FSL_HAS_RGMII
	select UBOOT_CONFIG_SYS_FSL_HAS_SEC
	select UBOOT_CONFIG_SYS_FSL_HAS_CCN508
	select UBOOT_CONFIG_SYS_FSL_HAS_DDR4
	select UBOOT_CONFIG_SYS_FSL_SEC_COMPAT_5
	select UBOOT_CONFIG_SYS_FSL_SEC_LE
	select UBOOT_CONFIG_ARCH_EARLY_INIT_R
	select UBOOT_CONFIG_BOARD_EARLY_INIT_F
	select UBOOT_CONFIG_SYS_I2C_MXC
	select UBOOT_CONFIG_RESV_RAM if GIC_V3_ITS
	imply DISTRO_DEFAULTS
	imply ID_EEPROM
	imply PANIC_HANG
	imply SCSI
	imply SCSI_AHCI
	imply SPL_SYS_I2C_LEGACY

config UBOOT_CONFIG_FSL_LSCH2
	bool
	select UBOOT_CONFIG_SKIP_LOWLEVEL_INIT
	select UBOOT_CONFIG_SYS_FSL_HAS_CCI400
	select UBOOT_CONFIG_SYS_FSL_HAS_SEC
	select UBOOT_CONFIG_SYS_FSL_SEC_COMPAT_5
	select UBOOT_CONFIG_SYS_FSL_SEC_BE

config UBOOT_CONFIG_FSL_LSCH3
	select UBOOT_CONFIG_ARCH_MISC_INIT
	bool

config UBOOT_CONFIG_NXP_LSCH3_2
	bool

menu "Layerscape architecture"
	depends on UBOOT_CONFIG_FSL_LSCH2 || UBOOT_CONFIG_FSL_LSCH3

config UBOOT_CONFIG_FSL_LAYERSCAPE
	bool

config UBOOT_CONFIG_HAS_FEATURE_GIC64K_ALIGN
	bool
	default y if UBOOT_CONFIG_ARCH_LS1043A

config UBOOT_CONFIG_HAS_FEATURE_ENHANCED_MSI
	bool
	default y if UBOOT_CONFIG_ARCH_LS1043A

menu "Layerscape PPA"
config UBOOT_CONFIG_FSL_LS_PPA
	bool "FSL Layerscape PPA firmware support"
	depends on !UBOOT_CONFIG_ARMV8_PSCI
	select UBOOT_CONFIG_ARMV8_SEC_FIRMWARE_SUPPORT
	select UBOOT_CONFIG_SEC_FIRMWARE_ARMV8_PSCI
	select UBOOT_CONFIG_ARMV8_SEC_FIRMWARE_ERET_ADDR_REVERT if FSL_LSCH2
	help
	  The FSL Primary Protected Application (PPA) is a software component
	  which is loaded during boot stage, and then remains resident in RAM
	  and runs in the TrustZone after boot.
	  Say y to enable it.

config UBOOT_CONFIG_SPL_FSL_LS_PPA
	bool "FSL Layerscape PPA firmware support for SPL build"
	depends on !UBOOT_CONFIG_ARMV8_PSCI
	select UBOOT_CONFIG_SPL_ARMV8_SEC_FIRMWARE_SUPPORT
	select UBOOT_CONFIG_SEC_FIRMWARE_ARMV8_PSCI
	select UBOOT_CONFIG_ARMV8_SEC_FIRMWARE_ERET_ADDR_REVERT if FSL_LSCH2
	help
	  The FSL Primary Protected Application (PPA) is a software component
	  which is loaded during boot stage, and then remains resident in RAM
	  and runs in the TrustZone after boot. This is to load PPA during SPL
	  stage instead of the RAM version of U-Boot. Once PPA is initialized,
	  the rest of U-Boot (including RAM version) runs at EL2.
choice
	prompt "FSL Layerscape PPA firmware loading-media select"
	depends on UBOOT_CONFIG_FSL_LS_PPA
	default UBOOT_CONFIG_SYS_LS_PPA_FW_IN_MMC if UBOOT_CONFIG_SD_BOOT
	default UBOOT_CONFIG_SYS_LS_PPA_FW_IN_NAND if UBOOT_CONFIG_NAND_BOOT
	default UBOOT_CONFIG_SYS_LS_PPA_FW_IN_XIP

config UBOOT_CONFIG_SYS_LS_PPA_FW_IN_XIP
	bool "XIP"
	help
	  Say Y here if the PPA firmware locate at XIP flash, such
	  as NOR or QSPI flash.

config UBOOT_CONFIG_SYS_LS_PPA_FW_IN_MMC
	bool "eMMC or SD Card"
	help
	  Say Y here if the PPA firmware locate at eMMC/SD card.

config UBOOT_CONFIG_SYS_LS_PPA_FW_IN_NAND
	bool "NAND"
	help
	  Say Y here if the PPA firmware locate at NAND flash.

endchoice

config UBOOT_CONFIG_LS_PPA_ESBC_HDR_SIZE
	hex "Length of PPA ESBC header"
	depends on UBOOT_CONFIG_FSL_LS_PPA && UBOOT_CONFIG_CHAIN_OF_TRUST && !UBOOT_CONFIG_SYS_LS_PPA_FW_IN_XIP
	default 0x2000
	help
	  Length (in bytes) of PPA ESBC header to be copied from MMC/SD or
	  NAND to memory to validate PPA image.

endmenu

config UBOOT_CONFIG_SYS_FSL_ERRATUM_A008997
	bool "Workaround for USB PHY erratum A008997"

config UBOOT_CONFIG_SYS_FSL_ERRATUM_A009007
	bool
	help
	  Workaround for USB PHY erratum A009007

config UBOOT_CONFIG_SYS_FSL_ERRATUM_A009008
	bool "Workaround for USB PHY erratum A009008"

config UBOOT_CONFIG_SYS_FSL_ERRATUM_A009798
	bool "Workaround for USB PHY erratum A009798"

config UBOOT_CONFIG_SYS_FSL_ERRATUM_A050204
	bool "Workaround for USB PHY erratum A050204"
	help
	  USB3.0 Receiver needs to enable fixed equalization
	  for each of PHY instances in an SOC. This is similar
	  to erratum A-009007, but this one is for LX2160A and LX2162A,
	  and the register value is different.

config UBOOT_CONFIG_SYS_FSL_ERRATUM_A010315
	bool "Workaround for PCIe erratum A010315"

config UBOOT_CONFIG_SYS_FSL_ERRATUM_A010539
	bool "Workaround for PIN MUX erratum A010539"

config UBOOT_CONFIG_MAX_CPUS
	int "Maximum number of CPUs permitted for Layerscape"
	default 2 if UBOOT_CONFIG_ARCH_LS1028A
	default 4 if UBOOT_CONFIG_ARCH_LS1043A
	default 4 if UBOOT_CONFIG_ARCH_LS1046A
	default 16 if UBOOT_CONFIG_ARCH_LS2080A
	default 8 if UBOOT_CONFIG_ARCH_LS1088A
	default 16 if UBOOT_CONFIG_ARCH_LX2160A
	default 16 if UBOOT_CONFIG_ARCH_LX2162A
	default 1
	help
	  Set this number to the maximum number of possible CPUs in the SoC.
	  SoCs may have multiple clusters with each cluster may have multiple
	  ports. If some ports are reserved but higher ports are used for
	  cores, count the reserved ports. This will allocate enough memory
	  in spin table to properly handle all cores.

config UBOOT_CONFIG_EMC2305
	bool "Fan controller"
	help
	 Enable the EMC2305 fan controller for configuration of fan
	 speed.

config UBOOT_CONFIG_NXP_ESBC
	bool "NXP_ESBC"
	help
		Enable Freescale Secure Boot feature

config UBOOT_CONFIG_QSPI_AHB_INIT
	bool "Init the QSPI AHB bus"
	help
	  The default setting for QSPI AHB bus just support 3bytes addressing.
	  But some QSPI flash size up to 64MBytes, so initialize the QSPI AHB
	  bus for those flashes to support the full QSPI flash size.

config UBOOT_CONFIG_FSPI_AHB_EN_4BYTE
	bool "Enable 4-byte Fast Read command for AHB mode"
	help
	  The default setting for FlexSPI AHB bus just supports 3-byte addressing.
	  But some FlexSPI flash sizes are up to 64MBytes.
	  This flag enables fast read command for AHB mode and modifies required
	  LUT to support full FlexSPI flash.

config UBOOT_CONFIG_SYS_CCI400_OFFSET
	hex "Offset for CCI400 base"
	depends on UBOOT_CONFIG_SYS_FSL_HAS_CCI400
	default 0x3090000 if UBOOT_CONFIG_ARCH_LS1088A || UBOOT_CONFIG_ARCH_LS1028A
	default 0x180000 if UBOOT_CONFIG_FSL_LSCH2
	help
	  Offset for CCI400 base
	  CCI400 base addr = CCSRBAR + CCI400_OFFSET

config UBOOT_CONFIG_SYS_FSL_IFC_BANK_COUNT
	int "Maximum banks of Integrated flash controller"
	depends on UBOOT_CONFIG_ARCH_LS1043A || UBOOT_CONFIG_ARCH_LS1046A || UBOOT_CONFIG_ARCH_LS2080A || UBOOT_CONFIG_ARCH_LS1088A
	default 4 if UBOOT_CONFIG_ARCH_LS1043A
	default 4 if UBOOT_CONFIG_ARCH_LS1046A
	default 8 if UBOOT_CONFIG_ARCH_LS2080A || UBOOT_CONFIG_ARCH_LS1088A

config UBOOT_CONFIG_SYS_FSL_HAS_CCI400
	bool

config UBOOT_CONFIG_SYS_FSL_HAS_CCN504
	bool

config UBOOT_CONFIG_SYS_FSL_HAS_CCN508
	bool

config UBOOT_CONFIG_SYS_FSL_HAS_DP_DDR
	bool

config UBOOT_CONFIG_SYS_FSL_SRDS_1
	bool

config UBOOT_CONFIG_SYS_FSL_SRDS_2
	bool

config UBOOT_CONFIG_SYS_NXP_SRDS_3
	bool

config UBOOT_CONFIG_SYS_HAS_SERDES
	bool

config UBOOT_CONFIG_FSL_TZASC_1
	bool

config UBOOT_CONFIG_FSL_TZASC_2
	bool

config UBOOT_CONFIG_FSL_TZASC_400
	bool

config UBOOT_CONFIG_FSL_TZPC_BP147
	bool
endmenu

menu "Layerscape clock tree configuration"
	depends on UBOOT_CONFIG_FSL_LSCH2 || UBOOT_CONFIG_FSL_LSCH3

config UBOOT_CONFIG_SYS_FSL_CLK
	bool "Enable clock tree initialization"
	default y

config UBOOT_CONFIG_CLUSTER_CLK_FREQ
	int "Reference clock of core cluster"
	depends on UBOOT_CONFIG_ARCH_LS1012A
	default 100000000
	help
	  This number is the reference clock frequency of core PLL.
	  For most platforms, the core PLL and Platform PLL have the same
	  reference clock, but for some platforms, LS1012A for instance,
	  they are provided sepatately.

config UBOOT_CONFIG_SYS_FSL_PCLK_DIV
	int "Platform clock divider"
	default 1 if UBOOT_CONFIG_ARCH_LS1028A
	default 1 if UBOOT_CONFIG_ARCH_LS1043A
	default 1 if UBOOT_CONFIG_ARCH_LS1046A
	default 1 if UBOOT_CONFIG_ARCH_LS1088A
	default 2
	help
	  This is the divider that is used to derive Platform clock from
	  Platform PLL, in another word:
		Platform_clk = Platform_PLL_freq / this_divider

config UBOOT_CONFIG_SYS_FSL_DSPI_CLK_DIV
	int "DSPI clock divider"
	default 1 if UBOOT_CONFIG_ARCH_LS1043A
	default 2
	help
	  This is the divider that is used to derive DSPI clock from Platform
	  clock, in another word DSPI_clk = Platform_clk / this_divider.

config UBOOT_CONFIG_SYS_FSL_DUART_CLK_DIV
	int "DUART clock divider"
	default 1 if UBOOT_CONFIG_ARCH_LS1043A
	default 4 if UBOOT_CONFIG_ARCH_LX2160A
	default 4 if UBOOT_CONFIG_ARCH_LX2162A
	default 2
	help
	  This is the divider that is used to derive DUART clock from Platform
	  clock, in another word DUART_clk = Platform_clk / this_divider.

config UBOOT_CONFIG_SYS_FSL_I2C_CLK_DIV
	int "I2C clock divider"
	default 1 if UBOOT_CONFIG_ARCH_LS1043A
	default 4 if UBOOT_CONFIG_ARCH_LS1012A
	default 4 if UBOOT_CONFIG_ARCH_LS1028A
	default 8 if UBOOT_CONFIG_ARCH_LX2160A
	default 8 if UBOOT_CONFIG_ARCH_LX2162A
	default 8 if UBOOT_CONFIG_ARCH_LS1088A
	default 2
	help
	  This is the divider that is used to derive I2C clock from Platform
	  clock, in another word I2C_clk = Platform_clk / this_divider.

config UBOOT_CONFIG_SYS_FSL_IFC_CLK_DIV
	int "IFC clock divider"
	default 1 if UBOOT_CONFIG_ARCH_LS1043A
	default 4 if UBOOT_CONFIG_ARCH_LS1012A
	default 4 if UBOOT_CONFIG_ARCH_LS1028A
	default 8 if UBOOT_CONFIG_ARCH_LX2160A
	default 8 if UBOOT_CONFIG_ARCH_LX2162A
	default 8 if UBOOT_CONFIG_ARCH_LS1088A
	default 2
	help
	  This is the divider that is used to derive IFC clock from Platform
	  clock, in another word IFC_clk = Platform_clk / this_divider.

config UBOOT_CONFIG_SYS_FSL_LPUART_CLK_DIV
	int "LPUART clock divider"
	default 1 if UBOOT_CONFIG_ARCH_LS1043A
	default 2
	help
	  This is the divider that is used to derive LPUART clock from Platform
	  clock, in another word LPUART_clk = Platform_clk / this_divider.

config UBOOT_CONFIG_SYS_FSL_SDHC_CLK_DIV
	int "SDHC clock divider"
	default 1 if UBOOT_CONFIG_ARCH_LS1043A
	default 1 if UBOOT_CONFIG_ARCH_LS1012A
	default 2
	help
	  This is the divider that is used to derive SDHC clock from Platform
	  clock, in another word SDHC_clk = Platform_clk / this_divider.

config UBOOT_CONFIG_SYS_FSL_QMAN_CLK_DIV
	int "QMAN clock divider"
	default 1 if UBOOT_CONFIG_ARCH_LS1043A
	default 2
	help
	  This is the divider that is used to derive QMAN clock from Platform
	  clock, in another word QMAN_clk = Platform_clk / this_divider.
endmenu

config UBOOT_CONFIG_RESV_RAM
	bool
	help
	  Reserve memory from the top, tracked by gd->arch.resv_ram. This
	  reserved RAM can be used by special driver that resides in memory
	  after U-Boot exits. It's up to implementation to allocate and allow
	  access to this reserved memory. For example, the reserved RAM can
	  be at the high end of physical memory. The reserve RAM may be
	  excluded from memory bank(s) passed to OS, or marked as reserved.

config UBOOT_CONFIG_SYS_FSL_EC1
	bool
	help
	  Ethernet controller 1, this is connected to
	  MAC17 for LX2160A and LX2162A or to MAC3 for other SoCs
	  Provides DPAA2 capabilities

config UBOOT_CONFIG_SYS_FSL_EC2
	bool
	help
	  Ethernet controller 2, this is connected to
	  MAC18 for LX2160A and LX2162A or to MAC4 for other SoCs
	  Provides DPAA2 capabilities

config UBOOT_CONFIG_SYS_FSL_ERRATUM_A008336
	bool

config UBOOT_CONFIG_SYS_FSL_ERRATUM_A008514
	bool

config UBOOT_CONFIG_SYS_FSL_ERRATUM_A008585
	bool

config UBOOT_CONFIG_SYS_FSL_ERRATUM_A008850
	bool

config UBOOT_CONFIG_SYS_FSL_ERRATUM_A009203
	bool

config UBOOT_CONFIG_SYS_FSL_ERRATUM_A009635
	bool

config UBOOT_CONFIG_SYS_FSL_ERRATUM_A009660
	bool

config UBOOT_CONFIG_SYS_FSL_ERRATUM_A050382
	bool

config UBOOT_CONFIG_SYS_FSL_HAS_RGMII
	bool
	depends on UBOOT_CONFIG_SYS_FSL_EC1 || UBOOT_CONFIG_SYS_FSL_EC2

config UBOOT_CONFIG_SPL_LDSCRIPT
	default "arch/arm/cpu/armv8/u-boot-spl.lds" if UBOOT_CONFIG_ARCH_LS1043A || UBOOT_CONFIG_ARCH_LS1046A || UBOOT_CONFIG_ARCH_LS2080A

config UBOOT_CONFIG_HAS_FSL_XHCI_USB
	bool
	help
	  For some SoC (such as LS1043A and LS1046A), USB and QE-HDLC multiplex use
	  pins, select it when the pins are assigned to USB.

config UBOOT_CONFIG_SYS_FSL_BOOTROM_BASE
	hex
	depends on UBOOT_CONFIG_FSL_LSCH2
	default 0

config UBOOT_CONFIG_SYS_FSL_BOOTROM_SIZE
	hex
	depends on UBOOT_CONFIG_FSL_LSCH2
	default 0x1000000
```
