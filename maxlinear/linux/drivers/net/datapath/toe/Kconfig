## maxlinear/linux/drivers/net/datapath/toe/Kconfig
```kconfig
# SPDX-License-Identifier: GPL-2.0

config LGM_TOE
	tristate "TCP Offload Engine (TOE) Support"
	select SRAM
	depends on MXL_CBM
	help
		This driver supports TOE functions for the
		Lightning Mountain datapath.
```

## maxlinear/linux/drivers/net/datapath/vpn/Kconfig
```kconfig
config MXL_VPN
	tristate "Maxlinear VPN Driver"
	depends on m
	select SRAM
	select INET_ESP_OFFLOAD
	help
	  Driver for ARM-EM firmware in Maxlinear platform

config MXL_VPN_TEST
	depends on MXL_VPN
	bool "Enable unit test functions in mxl_vpn"
	help
	  This is to compile in some test features in mxl_vpn
```

## maxlinear/linux/drivers/net/directconnect_dp/Kconfig
```kconfig
#
# DirectConnect Datapath Driver
#
config DIRECTCONNECT_DP_API
	tristate "DirectConnect Datapath API framework"
	depends on DPM_DATAPATH
	help
	  DirectConnect Datapath API framework support

config MXL_UMT_INTERVAL_DEFAULT
	int "MXL UMT Interval default"
	default 20
	depends on SOC_LGM
	help
	  UMT Interval is set to 20 by default.
	  Change here to support emulator platforms

config WLAN_MAX_VAPS
	int "Maximum number of WLAN VAPs"
	default 32
	depends on SOC_LGM
	help
	  This option allows to configure maximum number of WLAN VAPs.
	  Maximum number of WLAN VAPs is set to 32 by default.
```

## maxlinear/linux/drivers/net/ethernet/mxl/Kconfig
```kconfig
#
# MaxLinear network device configuration
#

config NET_VENDOR_MXL
	bool "MaxLinear devices"
	default y
	help
	  If you have a network (Ethernet) card belonging to this class, say Y.

	  Note that the answer to this question doesn't directly affect the
	  kernel: saying N will just cause the configurator to skip all
	  the questions about Intel cards. If you say Y, you will be asked for
	  your specific card in the following questions.

if NET_VENDOR_MXL

config MXL_ETH
	tristate "MaxLinear Ethernet driver for GRX500/PRX300/LGM series"
	depends on (MXL_CBM || MXL_DATAPATH)
	select PHYLINK
	select SFP
	help
	Maxlinear Ethernet driver

if MXL_ETH

config MXL_ETH_THERMAL
	bool "ThermaL support for MaxLinear Ethernet driver"
	depends on MXL_ETH && THERMAL
	help
	Thermal support for the MaxLinear Ethernet driver

endif #MXL_ETH

config MXL_PON_HGU_VUNI
	tristate "Mxl PON HGU vUNI driver"
	depends on (INTEL_DATAPATH || MXL_CBM)
	help
	Mxl PON HGU vUNI driver.

endif # NET_VENDOR_MXL
```

## maxlinear/linux/drivers/net/qos_mgr/Kconfig
```kconfig
menu "QOS_MGR"

config QOS_MGR
        bool "QoS Manager"
        help
            QoS Manager
endmenu
```

## maxlinear/linux/drivers/tee/mxltee/Kconfig
```kconfig
# SPDX-License-Identifier: GPL-2.0
#
# MXL-TEE Trusted Execution Environment Configuration

config MXLTEE
	tristate "MXL-TEE"
	depends on SOC_MXL && SOC_LGM && MXL_ICC && MXL_MPS2 && MXL_SEC_GEN_POOL
	help
	  Enables MaxLinear's Trusted Execution Environment (TEE) driver.
	  This driver communicates with ARC-SEM TEP to perform secured operations.
```

## maxlinear/speedtest/speedtest-driver/src/Kconfig
```kconfig
#
# Speedtest driver
#

config SPEEDTEST_DRIVER
	tristate "Speed test driver"
	default m
	help
		Speedtest driver for HTTP upload and download.
```

## net/mcast_helper/Kconfig
```kconfig
#
# mcast_helper configuration
#

config MCAST_HELPER_PACKAGE
	tristate "Multicast Helper package enable"
	depends on BRIDGE
	help
	  mcast_helper support

config MCAST_HELPER_REG
	tristate "Multicast Helper Register Support"
	help
	  mcast_helper reg support

config MCAST_HELPER
	tristate "Multicast Helper support"
	help
	  mcast_helper support

config MCAST_HELPER_ACL
	tristate "Multicast Helper ACL support"
	depends on MCAST_HELPER
	help
	  mcast_helper ACL support
```

## open_uboot/config/api/Kconfig
```kconfig
menu "API"

config UBOOT_CONFIG_API
	bool "Enable U-Boot API"
	help
	  This option enables the U-Boot API. See api/README for more information.

endmenu
```

## open_uboot/config/arch/Kconfig
```kconfig
config UBOOT_CONFIG_CREATE_ARCH_SYMLINK
	bool

config UBOOT_CONFIG_HAVE_ARCH_IOREMAP
	bool

config UBOOT_CONFIG_NEEDS_MANUAL_RELOC
	bool

config UBOOT_CONFIG_SYS_CACHE_SHIFT_4
	bool

config UBOOT_CONFIG_SYS_CACHE_SHIFT_5
	bool

config UBOOT_CONFIG_SYS_CACHE_SHIFT_6
	bool

config UBOOT_CONFIG_SYS_CACHE_SHIFT_7
	bool

config UBOOT_CONFIG_SYS_CACHELINE_SIZE
	int
	default 128 if UBOOT_CONFIG_SYS_CACHE_SHIFT_7
	default 64 if UBOOT_CONFIG_SYS_CACHE_SHIFT_6
	default 32 if UBOOT_CONFIG_SYS_CACHE_SHIFT_5
	default 16 if UBOOT_CONFIG_SYS_CACHE_SHIFT_4
	# Fall-back for MIPS
	default 32 if UBOOT_CONFIG_MIPS

config UBOOT_CONFIG_LINKER_LIST_ALIGN
	int
	default 32 if UBOOT_CONFIG_SANDBOX
	default 8 if UBOOT_CONFIG_ARM64 || UBOOT_CONFIG_X86
	default 4
	help
	  Force the each linker list to be aligned to this boundary. This
	  is required if ll_entry_get() is used, since otherwise the linker
	  may add padding into the table, thus breaking it.
	  See linker_lists.rst for full details.

choice
	prompt "Architecture select"
	default UBOOT_CONFIG_SANDBOX

config UBOOT_CONFIG_ARC
	bool "ARC architecture"
	select UBOOT_CONFIG_ARC_TIMER
	select UBOOT_CONFIG_CLK
	select UBOOT_CONFIG_DM
	select UBOOT_CONFIG_HAVE_PRIVATE_LIBGCC
	select UBOOT_CONFIG_SUPPORT_OF_CONTROL
	select UBOOT_CONFIG_SYS_CACHE_SHIFT_7
	select UBOOT_CONFIG_TIMER

config UBOOT_CONFIG_ARM
	bool "ARM architecture"
	select UBOOT_CONFIG_ARCH_SUPPORTS_LTO
	select UBOOT_CONFIG_CREATE_ARCH_SYMLINK
	select UBOOT_CONFIG_HAVE_PRIVATE_LIBGCC if !ARM64
	select UBOOT_CONFIG_SUPPORT_OF_CONTROL

config UBOOT_CONFIG_M68K
	bool "M68000 architecture"
	select UBOOT_CONFIG_HAVE_PRIVATE_LIBGCC
	select UBOOT_CONFIG_NEEDS_MANUAL_RELOC
	select UBOOT_CONFIG_SYS_BOOT_GET_CMDLINE
	select UBOOT_CONFIG_SYS_BOOT_GET_KBD
	select UBOOT_CONFIG_SYS_CACHE_SHIFT_4
	select UBOOT_CONFIG_SUPPORT_OF_CONTROL

config UBOOT_CONFIG_MICROBLAZE
	bool "MicroBlaze architecture"
	select UBOOT_CONFIG_NEEDS_MANUAL_RELOC
	select UBOOT_CONFIG_SUPPORT_OF_CONTROL
	imply CMD_IRQ

config UBOOT_CONFIG_MIPS
	bool "MIPS architecture"
	select UBOOT_CONFIG_HAVE_ARCH_IOREMAP
	select UBOOT_CONFIG_HAVE_PRIVATE_LIBGCC
	select UBOOT_CONFIG_SUPPORT_OF_CONTROL

config UBOOT_CONFIG_NDS32
	bool "NDS32 architecture"
	select UBOOT_CONFIG_SUPPORT_OF_CONTROL

config UBOOT_CONFIG_NIOS2
	bool "Nios II architecture"
	select UBOOT_CONFIG_CPU
	select UBOOT_CONFIG_DM
	select UBOOT_CONFIG_OF_CONTROL
	select UBOOT_CONFIG_SUPPORT_OF_CONTROL
	imply CMD_DM

config UBOOT_CONFIG_PPC
	bool "PowerPC architecture"
	select UBOOT_CONFIG_HAVE_PRIVATE_LIBGCC
	select UBOOT_CONFIG_SUPPORT_OF_CONTROL
	select UBOOT_CONFIG_SYS_BOOT_GET_CMDLINE
	select UBOOT_CONFIG_SYS_BOOT_GET_KBD

config UBOOT_CONFIG_RISCV
	bool "RISC-V architecture"
	select UBOOT_CONFIG_CREATE_ARCH_SYMLINK
	select UBOOT_CONFIG_SUPPORT_OF_CONTROL
	select UBOOT_CONFIG_OF_CONTROL
	select UBOOT_CONFIG_DM
	imply DM_SERIAL
	imply DM_ETH
	imply DM_MMC
	imply DM_SPI
	imply DM_SPI_FLASH
	imply BLK
	imply CLK
	imply MTD
	imply TIMER
	imply CMD_DM
	imply SPL_DM
	imply SPL_OF_CONTROL
	imply SPL_LIBCOMMON_SUPPORT
	imply SPL_LIBGENERIC_SUPPORT
	imply SPL_SERIAL
	imply SPL_TIMER

config UBOOT_CONFIG_SANDBOX
	bool "Sandbox"
	select UBOOT_CONFIG_ARCH_SUPPORTS_LTO
	select UBOOT_CONFIG_BOARD_LATE_INIT
	select UBOOT_CONFIG_BZIP2
	select UBOOT_CONFIG_CMD_POWEROFF
	select UBOOT_CONFIG_DM
	select UBOOT_CONFIG_DM_GPIO
	select UBOOT_CONFIG_DM_I2C
	select UBOOT_CONFIG_DM_KEYBOARD
	select UBOOT_CONFIG_DM_MMC
	select UBOOT_CONFIG_DM_SERIAL
	select UBOOT_CONFIG_DM_SPI
	select UBOOT_CONFIG_DM_SPI_FLASH
	select UBOOT_CONFIG_GZIP_COMPRESSED
	select UBOOT_CONFIG_HAVE_BLOCK_DEVICE
	select UBOOT_CONFIG_LZO
	select UBOOT_CONFIG_OF_BOARD_SETUP
	select UBOOT_CONFIG_PCI_ENDPOINT
	select UBOOT_CONFIG_SPI
	select UBOOT_CONFIG_SUPPORT_OF_CONTROL
	select UBOOT_CONFIG_SYSRESET_CMD_POWEROFF
	select UBOOT_CONFIG_SYS_CACHE_SHIFT_4
	select UBOOT_CONFIG_IRQ
	select UBOOT_CONFIG_SUPPORT_EXTENSION_SCAN
	imply BITREVERSE
	select UBOOT_CONFIG_BLOBLIST
	imply LTO
	imply CMD_DM
	imply CMD_EXCEPTION
	imply CMD_GETTIME
	imply CMD_HASH
	imply CMD_IO
	imply CMD_IOTRACE
	imply CMD_LZMADEC
	imply CMD_SATA
	imply CMD_SF
	imply CMD_SF_TEST
	imply CRC32_VERIFY
	imply FAT_WRITE
	imply FIRMWARE
	imply HASH_VERIFY
	imply LZMA
	imply SCSI
	imply TEE
	imply AVB_VERIFY
	imply LIBAVB
	imply CMD_AVB
	imply SCP03
	imply CMD_SCP03
	imply UDP_FUNCTION_FASTBOOT
	imply VIRTIO_MMIO
	imply VIRTIO_PCI
	imply VIRTIO_SANDBOX
	imply VIRTIO_BLK
	imply VIRTIO_NET
	imply DM_SOUND
	imply PCI_SANDBOX_EP
	imply PCH
	imply PHYLIB
	imply DM_MDIO
	imply DM_MDIO_MUX
	imply ACPI_PMC
	imply ACPI_PMC_SANDBOX
	imply CMD_PMC
	imply CMD_CLONE
	imply SILENT_CONSOLE
	imply BOOTARGS_SUBST
	imply PHY_FIXED
	imply DM_DSA
	imply CMD_EXTENSION
	imply BINMAN

config UBOOT_CONFIG_SH
	bool "SuperH architecture"
	select UBOOT_CONFIG_HAVE_PRIVATE_LIBGCC
	select UBOOT_CONFIG_SUPPORT_OF_CONTROL

config UBOOT_CONFIG_X86
	bool "x86 architecture"
	select UBOOT_CONFIG_SUPPORT_SPL
	select UBOOT_CONFIG_SUPPORT_TPL
	select UBOOT_CONFIG_CREATE_ARCH_SYMLINK
	select UBOOT_CONFIG_DM
	select UBOOT_CONFIG_HAVE_ARCH_IOMAP
	select UBOOT_CONFIG_HAVE_PRIVATE_LIBGCC
	select UBOOT_CONFIG_OF_CONTROL
	select UBOOT_CONFIG_PCI if !VENDOR_MAXLINEAR
	select UBOOT_CONFIG_SUPPORT_OF_CONTROL
	select UBOOT_CONFIG_SYS_CACHE_SHIFT_6
	select UBOOT_CONFIG_TIMER
	select UBOOT_CONFIG_USE_PRIVATE_LIBGCC
	select UBOOT_CONFIG_X86_TSC_TIMER
	select UBOOT_CONFIG_IRQ if !VENDOR_MAXLINEAR
	imply HAS_ROM if X86_RESET_VECTOR && !UBOOT_CONFIG_VENDOR_MAXLINEAR
	imply BLK
	imply CMD_DM
	imply CMD_FPGA_LOADMK
	imply CMD_GETTIME
	imply CMD_IO
	imply CMD_IRQ
	imply CMD_PCI
	imply CMD_SF
	imply CMD_SF_TEST
	imply CMD_ZBOOT
	imply DM_ETH
	imply DM_GPIO
	imply DM_KEYBOARD
	imply DM_MMC
	imply DM_RTC
	imply DM_SCSI
	imply DM_SERIAL
	imply DM_SPI
	imply DM_SPI_FLASH
	imply DM_USB
	imply DM_VIDEO
	imply SYSRESET
	imply SPL_SYSRESET
	imply SYSRESET_X86
	imply USB_ETHER_ASIX
	imply USB_ETHER_SMSC95XX
	imply USB_HOST_ETHER
	imply PCH
	imply RTC_MC146818 if !VENDOR_MAXLINEAR
	imply ACPIGEN if !QEMU
	imply SYSINFO if GENERATE_SMBIOS_TABLE
	imply SYSINFO_SMBIOS if GENERATE_SMBIOS_TABLE

	# Thing to enable for when SPL/TPL are enabled: SPL
	imply SPL_DM
	imply SPL_OF_LIBFDT
	imply SPL_DRIVERS_MISC
	imply SPL_GPIO
	imply SPL_PINCTRL
	imply SPL_LIBCOMMON_SUPPORT
	imply SPL_LIBGENERIC_SUPPORT
	imply SPL_SERIAL
	imply SPL_SPI_FLASH_SUPPORT
	imply SPL_SPI
	imply SPL_OF_CONTROL
	imply SPL_TIMER
	imply SPL_REGMAP
	imply SPL_SYSCON
	# TPL
	imply TPL_DM
	imply TPL_DRIVERS_MISC
	imply TPL_GPIO
	imply TPL_PINCTRL
	imply TPL_LIBCOMMON_SUPPORT
	imply TPL_LIBGENERIC_SUPPORT
	imply TPL_SERIAL
	imply TPL_OF_CONTROL
	imply TPL_TIMER
	imply TPL_REGMAP
	imply TPL_SYSCON

config UBOOT_CONFIG_XTENSA
	bool "Xtensa architecture"
	select UBOOT_CONFIG_CREATE_ARCH_SYMLINK
	select UBOOT_CONFIG_SUPPORT_OF_CONTROL

endchoice

config UBOOT_CONFIG_SYS_ARCH
	string
	help
	  This option should contain the architecture name to build the
	  appropriate arch/<CONFIG_SYS_ARCH> directory.
	  All the architectures should specify this option correctly.

config UBOOT_CONFIG_SYS_CPU
	string
	help
	  This option should contain the CPU name to build the correct
	  arch/<CONFIG_SYS_ARCH>/cpu/<CONFIG_SYS_CPU> directory.

	  This is optional.  For those targets without the CPU directory,
	  leave this option empty.

config UBOOT_CONFIG_SYS_SOC
	string
	help
	  This option should contain the SoC name to build the directory
	  arch/<CONFIG_SYS_ARCH>/cpu/<CONFIG_SYS_CPU>/<CONFIG_SYS_SOC>.

	  This is optional.  For those targets without the SoC directory,
	  leave this option empty.

config UBOOT_CONFIG_SYS_VENDOR
	string
	help
	  This option should contain the vendor name of the target board.
	  If it is set and
	  board/<CONFIG_SYS_VENDOR>/common/Makefile exists, the vendor common
	  directory is compiled.
	  If CONFIG_SYS_BOARD is also set, the sources under
	  board/<CONFIG_SYS_VENDOR>/<CONFIG_SYS_BOARD> directory are compiled.

	  This is optional.  For those targets without the vendor directory,
	  leave this option empty.

config UBOOT_CONFIG_SYS_BOARD
	string
	help
	  This option should contain the name of the target board.
	  If it is set, either board/<CONFIG_SYS_VENDOR>/<CONFIG_SYS_BOARD>
	  or board/<CONFIG_SYS_BOARD> directory is compiled depending on
	  whether CONFIG_SYS_VENDOR is set or not.

	  This is optional.  For those targets without the board directory,
	  leave this option empty.

config UBOOT_CONFIG_SYS_CONFIG_NAME
	string
	help
	  This option should contain the base name of board header file.
	  The header file include/configs/<CONFIG_SYS_CONFIG_NAME>.h
	  should be included from include/config.h.

config UBOOT_CONFIG_SYS_DISABLE_DCACHE_OPS
	bool
	help
	 This option disables dcache flush and dcache invalidation
	 operations. For example, on coherent systems where cache
	 operatios are not required, enable this option to avoid them.
	 Note that, its up to the individual architectures to implement
	 this functionality.

config UBOOT_CONFIG_SKIP_LOWLEVEL_INIT
	bool "Skip the calls to certain low level initialization functions"
	depends on UBOOT_CONFIG_ARM || UBOOT_CONFIG_NDS32 || UBOOT_CONFIG_MIPS || UBOOT_CONFIG_RISCV
	help
	  If enabled, then certain low level initializations (like setting up
	  the memory controller) are omitted and/or U-Boot does not relocate
	  itself into RAM.
	  Normally this variable MUST NOT be defined. The only exception is
	  when U-Boot is loaded (to RAM) by some other boot loader or by a
	  debugger which performs these initializations itself.

config UBOOT_CONFIG_SPL_SKIP_LOWLEVEL_INIT
	bool "Skip the calls to certain low level initialization functions"
	depends on UBOOT_CONFIG_SPL && (ARM || UBOOT_CONFIG_NDS32 || UBOOT_CONFIG_MIPS || UBOOT_CONFIG_RISCV)
	help
	  If enabled, then certain low level initializations (like setting up
	  the memory controller) are omitted and/or U-Boot does not relocate
	  itself into RAM.
	  Normally this variable MUST NOT be defined. The only exception is
	  when U-Boot is loaded (to RAM) by some other boot loader or by a
	  debugger which performs these initializations itself.

config UBOOT_CONFIG_TPL_SKIP_LOWLEVEL_INIT
	bool "Skip the calls to certain low level initialization functions"
	depends on UBOOT_CONFIG_SPL && UBOOT_CONFIG_ARM
	help
	  If enabled, then certain low level initializations (like setting up
	  the memory controller) are omitted and/or U-Boot does not relocate
	  itself into RAM.
	  Normally this variable MUST NOT be defined. The only exception is
	  when U-Boot is loaded (to RAM) by some other boot loader or by a
	  debugger which performs these initializations itself.

config UBOOT_CONFIG_SKIP_LOWLEVEL_INIT_ONLY
	bool "Skip the call to lowlevel_init during early boot ONLY"
	depends on UBOOT_CONFIG_ARM
	help
	  This allows just the call to lowlevel_init() to be skipped. The
	  normal CP15 init (such as enabling the instruction cache) is still
	  performed.

config UBOOT_CONFIG_SPL_SKIP_LOWLEVEL_INIT_ONLY
	bool "Skip the call to lowlevel_init during early boot ONLY"
	depends on UBOOT_CONFIG_SPL && UBOOT_CONFIG_ARM
	help
	  This allows just the call to lowlevel_init() to be skipped. The
	  normal CP15 init (such as enabling the instruction cache) is still
	  performed.

config UBOOT_CONFIG_TPL_SKIP_LOWLEVEL_INIT_ONLY
	bool "Skip the call to lowlevel_init during early boot ONLY"
	depends on UBOOT_CONFIG_TPL && UBOOT_CONFIG_ARM
	help
	  This allows just the call to lowlevel_init() to be skipped. The
	  normal CP15 init (such as enabling the instruction cache) is still
	  performed.

source "arc/Kconfig"
source "arm/Kconfig"
source "m68k/Kconfig"
source "microblaze/Kconfig"
source "mips/Kconfig"
source "nds32/Kconfig"
source "nios2/Kconfig"
source "powerpc/Kconfig"
source "sandbox/Kconfig"
source "sh/Kconfig"
source "x86/Kconfig"
source "xtensa/Kconfig"
source "riscv/Kconfig"
```
