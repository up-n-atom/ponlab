## open_uboot/config/arch/arm/mach-imx/imx8/Kconfig
```kconfig
if UBOOT_CONFIG_ARCH_IMX8

config UBOOT_CONFIG_AHAB_BOOT
	bool "Support i.MX8 AHAB features"
	imply CMD_DEKBLOB
	help
	  This option enables the support for AHAB secure boot.

config UBOOT_CONFIG_IMX8
	bool

config UBOOT_CONFIG_MU_BASE_SPL
	hex "MU base address used in SPL"
	default 0x5d1b0000
	help
	  SPL runs in EL3 mode, it use MU0_A to communicate with SCU.
	  So we could not reuse the one in dts which is for normal U-Boot.

config UBOOT_CONFIG_IMX8QM
	select UBOOT_CONFIG_IMX8
	select UBOOT_CONFIG_SUPPORT_SPL
	select UBOOT_CONFIG_SPL_RECOVER_DATA_SECTION
	bool

config UBOOT_CONFIG_IMX8QXP
	select UBOOT_CONFIG_IMX8
	select UBOOT_CONFIG_SUPPORT_SPL
	select UBOOT_CONFIG_SPL_RECOVER_DATA_SECTION
	bool

config UBOOT_CONFIG_SYS_SOC
	default "imx8"

config UBOOT_CONFIG_BOOTAUX_RESERVED_MEM_BASE
	hex "i.MX auxiliary core dram memory base"
	default 0

config UBOOT_CONFIG_BOOTAUX_RESERVED_MEM_SIZE
	hex "i.MX auxiliary core dram memory size"
	default 0

choice
	prompt "i.MX8 board select"
	optional

config UBOOT_CONFIG_TARGET_APALIS_IMX8
	bool "Support Apalis iMX8 module"
	select UBOOT_CONFIG_BOARD_LATE_INIT
	select UBOOT_CONFIG_IMX8QM

config UBOOT_CONFIG_TARGET_COLIBRI_IMX8X
	bool "Support Colibri iMX8X module"
	select UBOOT_CONFIG_BOARD_LATE_INIT
	select UBOOT_CONFIG_IMX8QXP

config UBOOT_CONFIG_TARGET_APALIS_IMX8X
	bool "Support Apalis iMX8X module"
	select UBOOT_CONFIG_BOARD_LATE_INIT
	select UBOOT_CONFIG_IMX8QXP

config UBOOT_CONFIG_TARGET_DENEB
	bool "Support i.MX8QXP Capricorn Deneb board"
	select UBOOT_CONFIG_BOARD_LATE_INIT
	select UBOOT_CONFIG_IMX8QXP

config UBOOT_CONFIG_TARGET_GIEDI
	bool "Support i.MX8QXP Capricorn Giedi board"
	select UBOOT_CONFIG_BOARD_LATE_INIT
	select UBOOT_CONFIG_IMX8QXP

config UBOOT_CONFIG_TARGET_IMX8QM_MEK
	bool "Support i.MX8QM MEK board"
	select UBOOT_CONFIG_BOARD_LATE_INIT
	select UBOOT_CONFIG_IMX8QM

config UBOOT_CONFIG_TARGET_CONGA_QMX8
	bool "Support congatec conga-QMX8 board"
	select UBOOT_CONFIG_BOARD_LATE_INIT
	select UBOOT_CONFIG_SUPPORT_SPL
	select UBOOT_CONFIG_IMX8QM

config UBOOT_CONFIG_TARGET_IMX8QM_ROM7720_A1
	bool "Support i.MX8QM ROM-7720-A1"
	select UBOOT_CONFIG_BOARD_LATE_INIT
	select UBOOT_CONFIG_SUPPORT_SPL
	select UBOOT_CONFIG_IMX8QM

config UBOOT_CONFIG_TARGET_IMX8QXP_MEK
	bool "Support i.MX8QXP MEK board"
	select UBOOT_CONFIG_BOARD_LATE_INIT
	select UBOOT_CONFIG_IMX8QXP

endchoice

source "../../../../board/freescale/imx8qm_mek/Kconfig"
source "../../../../board/freescale/imx8qxp_mek/Kconfig"
source "../../../../board/congatec/cgtqmx8/Kconfig"
source "../../../../board/advantech/imx8qm_rom7720_a1/Kconfig"
source "../../../../board/toradex/apalis-imx8/Kconfig"
source "../../../../board/toradex/colibri-imx8x/Kconfig"
source "../../../../board/toradex/apalis-imx8x/Kconfig"
source "../../../../board/siemens/capricorn/Kconfig"

config UBOOT_CONFIG_IMX_SNVS_SEC_SC
	bool "Support SNVS configuration"
	help
	  Allow to configure the SNVS via SCU API to configure tampers and secure
	  violation.

config UBOOT_CONFIG_IMX_SNVS_SEC_SC_AUTO
	bool "Support SNVS configuration command"
	depends on UBOOT_CONFIG_IMX_SNVS_SEC_SC
	help
	  This configuration will apply the selected configurations automatically
	  at boot.

endif
```

## open_uboot/config/arch/arm/mach-imx/imx8ulp/Kconfig
```kconfig
if UBOOT_CONFIG_ARCH_IMX8ULP

config UBOOT_CONFIG_IMX8ULP
	bool
	select UBOOT_CONFIG_ARMV8_SPL_EXCEPTION_VECTORS

config UBOOT_CONFIG_SYS_SOC
	default "imx8ulp"

choice
	prompt "i.MX8ULP board select"
	optional

config UBOOT_CONFIG_TARGET_IMX8ULP_EVK
	bool "imx8ulp_evk"
	select UBOOT_CONFIG_IMX8ULP
	select UBOOT_CONFIG_SUPPORT_SPL

endchoice

source "../../../../board/freescale/imx8ulp_evk/Kconfig"

endif
```

## open_uboot/config/arch/arm/mach-imx/mx3/Kconfig
```kconfig
if UBOOT_CONFIG_ARCH_MX31

config UBOOT_CONFIG_MX31
       bool
       default y
choice
	prompt "MX31 board select"
	optional

config UBOOT_CONFIG_TARGET_MX31PDK
	bool "Support the i.MX31 PDK board from Freescale/NXP"
	select UBOOT_CONFIG_BOARD_EARLY_INIT_F
	select UBOOT_CONFIG_BOARD_LATE_INIT
	select UBOOT_CONFIG_SUPPORT_SPL

endchoice

config UBOOT_CONFIG_MX31_HCLK_FREQ
       int "i.MX31 HCLK frequency"
       default 26000000
       help
         Frequency in Hz of the high frequency input clock. Typically
	 26000000 Hz.

config UBOOT_CONFIG_MX31_CLK32
       int "i.MX31 CLK32 Frequency"
       default 32768
       help
         Frequency in Hz of the low frequency input clock. Typically
	 32768 or 32000 Hz.


endif
```

## open_uboot/config/arch/arm/mach-imx/mx5/Kconfig
```kconfig
if UBOOT_CONFIG_ARCH_MX5

config UBOOT_CONFIG_MX5
	bool
	default y
	select UBOOT_CONFIG_GPT_TIMER

config UBOOT_CONFIG_MX51
	bool
	select UBOOT_CONFIG_ARM_CORTEX_A8_CVE_2017_5715
	select UBOOT_CONFIG_SYS_FSL_ERRATUM_ESDHC_A001

config UBOOT_CONFIG_MX53
	bool
	select UBOOT_CONFIG_ARM_CORTEX_A8_CVE_2017_5715

choice
	prompt "MX5 board select"
	optional

config UBOOT_CONFIG_TARGET_KP_IMX53
	bool "Support K+P imx53 board"
	select UBOOT_CONFIG_BOARD_LATE_INIT
	select UBOOT_CONFIG_DM
	select UBOOT_CONFIG_DM_ETH
	select UBOOT_CONFIG_DM_GPIO
	select UBOOT_CONFIG_DM_I2C
	select UBOOT_CONFIG_DM_PMIC
	select UBOOT_CONFIG_DM_SERIAL
	select UBOOT_CONFIG_DM_MMC
	select UBOOT_CONFIG_BLK
	select UBOOT_CONFIG_DM_REGULATOR
	select UBOOT_CONFIG_MX53
	imply CMD_DM

config UBOOT_CONFIG_TARGET_M53MENLO
	bool "Support m53menlo"
	select UBOOT_CONFIG_MX53
	select UBOOT_CONFIG_SUPPORT_SPL

config UBOOT_CONFIG_TARGET_MX51EVK
	bool "Support mx51evk"
	select UBOOT_CONFIG_BOARD_LATE_INIT
	select UBOOT_CONFIG_MX51

config UBOOT_CONFIG_TARGET_MX53CX9020
	bool "Support CX9020"
	select UBOOT_CONFIG_BOARD_LATE_INIT
	select UBOOT_CONFIG_DM
	select UBOOT_CONFIG_DM_SERIAL
	select UBOOT_CONFIG_MX53
	imply CMD_DM

config UBOOT_CONFIG_TARGET_MX53LOCO
	bool "Support mx53loco"
	select UBOOT_CONFIG_BOARD_LATE_INIT
	select UBOOT_CONFIG_MX53

config UBOOT_CONFIG_TARGET_MX53PPD
	bool "Support mx53ppd"
	select UBOOT_CONFIG_MX53
	help
	  Enable support for the GE Healthcare PPD.

config UBOOT_CONFIG_TARGET_USBARMORY
	bool "Support USB armory"
	select UBOOT_CONFIG_MX53

endchoice

config UBOOT_CONFIG_SYS_SOC
	default "mx5"

source "../../../../board/beckhoff/mx53cx9020/Kconfig"
source "../../../../board/freescale/mx51evk/Kconfig"
source "../../../../board/freescale/mx53loco/Kconfig"
source "../../../../board/ge/mx53ppd/Kconfig"
source "../../../../board/inversepath/usbarmory/Kconfig"
source "../../../../board/k+p/kp_imx53/Kconfig"
source "../../../../board/menlo/m53menlo/Kconfig"

endif
```

## open_uboot/config/arch/arm/mach-imx/mxs/Kconfig
```kconfig
if UBOOT_CONFIG_ARCH_MX23

config UBOOT_CONFIG_MX23
	bool
	default y

choice
	prompt "MX23 board select"
	optional

config UBOOT_CONFIG_TARGET_MX23_OLINUXINO
	bool "Support mx23_olinuxino"
	select UBOOT_CONFIG_BOARD_EARLY_INIT_F

config UBOOT_CONFIG_TARGET_MX23EVK
	bool "Support mx23evk"
	select UBOOT_CONFIG_BOARD_EARLY_INIT_F

config UBOOT_CONFIG_TARGET_XFI3
	bool "Support xfi3"

endchoice

config UBOOT_CONFIG_SYS_SOC
	default "mxs"

source "../../../../board/olimex/mx23_olinuxino/Kconfig"
source "../../../../board/freescale/mx23evk/Kconfig"

endif

if UBOOT_CONFIG_ARCH_MX28

config UBOOT_CONFIG_MX28
	bool
	default y

choice
	prompt "MX28 board select"
	optional

config UBOOT_CONFIG_TARGET_MX28EVK
	bool "Support mx28evk"
	select UBOOT_CONFIG_BOARD_EARLY_INIT_F

config UBOOT_CONFIG_TARGET_XEA
	bool "Support XEA"

endchoice

config UBOOT_CONFIG_SYS_SOC
	default "mxs"

source "../../../../board/freescale/mx28evk/Kconfig"
source "../../../../board/liebherr/xea/Kconfig"

endif
```

## open_uboot/config/arch/arm/mach-ipq40xx/Kconfig
```kconfig
if UBOOT_CONFIG_ARCH_IPQ40XX

config UBOOT_CONFIG_SYS_SOC
	default "ipq40xx"

config UBOOT_CONFIG_SYS_MALLOC_F_LEN
	default 0x2000

config UBOOT_CONFIG_SYS_TEXT_BASE
	default 0x87300000

config UBOOT_CONFIG_NR_DRAM_BANKS
	default 1

endif
```

## open_uboot/config/arch/arm/mach-kirkwood/Kconfig
```kconfig
if UBOOT_CONFIG_ARCH_KIRKWOOD

choice
	prompt "Marvell Kirkwood board select"
	optional

config UBOOT_CONFIG_TARGET_OPENRD
	bool "Marvell OpenRD Board"

config UBOOT_CONFIG_TARGET_DREAMPLUG
	bool "DreamPlug Board"

config UBOOT_CONFIG_TARGET_DS109
	bool "Synology DS109"

config UBOOT_CONFIG_TARGET_GURUPLUG
	bool "GuruPlug Board"

config UBOOT_CONFIG_TARGET_SHEEVAPLUG
	bool "SheevaPlug Board"

config UBOOT_CONFIG_TARGET_LSXL
	bool "lsxl Board"

config UBOOT_CONFIG_TARGET_POGO_E02
	bool "pogo_e02 Board"

config UBOOT_CONFIG_TARGET_DNS325
	bool "dns325 Board"

config UBOOT_CONFIG_TARGET_ICONNECT
	bool "iconnect Board"

config UBOOT_CONFIG_TARGET_KM_KIRKWOOD
	bool "KM Kirkwood Board"
	select UBOOT_CONFIG_VENDOR_KM

config UBOOT_CONFIG_TARGET_NET2BIG_V2
	bool "LaCie 2Big Network v2 NAS Board"

config UBOOT_CONFIG_TARGET_NETSPACE_V2
	bool "LaCie netspace_v2 Board"

config UBOOT_CONFIG_TARGET_IB62X0
	bool "ib62x0 Board"

config UBOOT_CONFIG_TARGET_DOCKSTAR
	bool "Dockstar Board"

config UBOOT_CONFIG_TARGET_GOFLEXHOME
	bool "GoFlex Home Board"

config UBOOT_CONFIG_TARGET_NAS220
	bool "BlackArmor NAS220"

config UBOOT_CONFIG_TARGET_NSA310S
	bool "Zyxel NSA310S"

config UBOOT_CONFIG_TARGET_SBx81LIFKW
	bool "Allied Telesis SBx81GS24/SBx81GT40/SBx81XS6/SBx81XS16"

config UBOOT_CONFIG_TARGET_SBx81LIFXCAT
	bool "Allied Telesis SBx81GP24/SBx81GT24"

endchoice

config UBOOT_CONFIG_SYS_SOC
	default "kirkwood"

source "../../../board/Marvell/openrd/Kconfig"
source "../../../board/Marvell/dreamplug/Kconfig"
source "../../../board/Synology/ds109/Kconfig"
source "../../../board/Marvell/guruplug/Kconfig"
source "../../../board/Marvell/sheevaplug/Kconfig"
source "../../../board/buffalo/lsxl/Kconfig"
source "../../../board/cloudengines/pogo_e02/Kconfig"
source "../../../board/d-link/dns325/Kconfig"
source "../../../board/iomega/iconnect/Kconfig"
source "../../../board/keymile/Kconfig"
source "../../../board/LaCie/net2big_v2/Kconfig"
source "../../../board/LaCie/netspace_v2/Kconfig"
source "../../../board/raidsonic/ib62x0/Kconfig"
source "../../../board/Seagate/dockstar/Kconfig"
source "../../../board/Seagate/goflexhome/Kconfig"
source "../../../board/Seagate/nas220/Kconfig"
source "../../../board/zyxel/nsa310s/Kconfig"
source "../../../board/alliedtelesis/SBx81LIFKW/Kconfig"
source "../../../board/alliedtelesis/SBx81LIFXCAT/Kconfig"

endif
```

## open_uboot/config/arch/arm/mach-lpc32xx/Kconfig
```kconfig
if UBOOT_CONFIG_ARCH_LPC32XX

config UBOOT_CONFIG_SYS_SOC
	default "lpc32xx"

choice
	prompt "NXP LPC32xx board select"

config UBOOT_CONFIG_TARGET_DEVKIT3250
	bool "Timll DevKit3250"

config UBOOT_CONFIG_TARGET_WORK_92105
	bool "Work Microwave Work_92105"

config UBOOT_CONFIG_TARGET_EA_LPC3250DEVKITV2
	bool "Embedded Artists LPC3250 Developer's Kit v2"

endchoice

source "../../../board/timll/devkit3250/Kconfig"
source "../../../board/work-microwave/work_92105/Kconfig"
source "../../../board/ea/ea-lpc3250devkitv2/Kconfig"

endif
```
