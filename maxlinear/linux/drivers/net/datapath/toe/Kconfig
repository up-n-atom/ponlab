## open_uboot/config/arch/arm/mach-at91/Kconfig
```kconfig
if UBOOT_CONFIG_ARCH_AT91

config UBOOT_CONFIG_AT91FAMILY
	def_bool y

config UBOOT_CONFIG_AT91SAM9260
	bool
	select UBOOT_CONFIG_CPU_ARM926EJS

config UBOOT_CONFIG_AT91SAM9G20
	bool
	select UBOOT_CONFIG_CPU_ARM926EJS

config UBOOT_CONFIG_AT91SAM9XE
	bool
	select UBOOT_CONFIG_CPU_ARM926EJS

config UBOOT_CONFIG_AT91SAM9261
	bool
	select UBOOT_CONFIG_CPU_ARM926EJS

config UBOOT_CONFIG_AT91SAM9263
	bool
	select UBOOT_CONFIG_CPU_ARM926EJS

config UBOOT_CONFIG_AT91SAM9G45
	bool
	select UBOOT_CONFIG_CPU_ARM926EJS

config UBOOT_CONFIG_AT91SAM9M10G45
	bool
	select UBOOT_CONFIG_CPU_ARM926EJS

config UBOOT_CONFIG_AT91SAM9N12
	bool
	select UBOOT_CONFIG_CPU_ARM926EJS

config UBOOT_CONFIG_AT91SAM9RL
	bool
	select UBOOT_CONFIG_CPU_ARM926EJS

config UBOOT_CONFIG_AT91SAM9X5
	bool
	select UBOOT_CONFIG_CPU_ARM926EJS

config UBOOT_CONFIG_SAM9X60
	bool
	select UBOOT_CONFIG_CPU_ARM926EJS

config UBOOT_CONFIG_SAMA7G5
	bool
	select UBOOT_CONFIG_CPU_V7A

config UBOOT_CONFIG_SAMA5D2
	bool
	select UBOOT_CONFIG_CPU_V7A
	select UBOOT_CONFIG_ATMEL_SFR

config UBOOT_CONFIG_SAMA5D3
	bool
	select UBOOT_CONFIG_CPU_V7A

config UBOOT_CONFIG_SAMA5D4
	bool
	select UBOOT_CONFIG_CPU_V7A
	select UBOOT_CONFIG_ATMEL_SFR

choice
	prompt "Atmel AT91 board select"
	optional

config UBOOT_CONFIG_TARGET_AT91SAM9260EK
	bool "Atmel at91sam9260 reference board"
	select UBOOT_CONFIG_AT91SAM9260
	select UBOOT_CONFIG_BOARD_EARLY_INIT_F

config UBOOT_CONFIG_TARGET_ETHERNUT5
	bool "Ethernut5 board"
	select UBOOT_CONFIG_AT91SAM9XE

config UBOOT_CONFIG_TARGET_SNAPPER9260
	bool "Support snapper9260"
	select UBOOT_CONFIG_AT91SAM9260
	select UBOOT_CONFIG_DM
	select UBOOT_CONFIG_DM_GPIO
	select UBOOT_CONFIG_DM_SERIAL
	imply CMD_DM

config UBOOT_CONFIG_TARGET_GURNARD
	bool "Support gurnard"
	select UBOOT_CONFIG_AT91SAM9G45
	select UBOOT_CONFIG_BOARD_LATE_INIT
	select UBOOT_CONFIG_DM
	select UBOOT_CONFIG_DM_ETH
	select UBOOT_CONFIG_DM_GPIO
	select UBOOT_CONFIG_DM_SERIAL
	select UBOOT_CONFIG_DM_SPI
	select UBOOT_CONFIG_SPI
	imply CMD_DM

config UBOOT_CONFIG_TARGET_AT91SAM9261EK
	bool "Atmel at91sam9261 reference board"
	select UBOOT_CONFIG_AT91SAM9261
	select UBOOT_CONFIG_BOARD_EARLY_INIT_F

config UBOOT_CONFIG_TARGET_PM9261
	bool "Ronetix pm9261 board"
	select UBOOT_CONFIG_AT91SAM9261

config UBOOT_CONFIG_TARGET_AT91SAM9263EK
	bool "Atmel at91sam9263 reference board"
	select UBOOT_CONFIG_AT91SAM9263
	select UBOOT_CONFIG_BOARD_EARLY_INIT_F

config UBOOT_CONFIG_TARGET_USB_A9263
	bool "Caloa USB A9260 board"
	select UBOOT_CONFIG_AT91SAM9263

config UBOOT_CONFIG_TARGET_PM9263
	bool "Ronetix pm9263 board"
	select UBOOT_CONFIG_AT91SAM9263

config UBOOT_CONFIG_TARGET_AT91SAM9M10G45EK
	bool "Atmel AT91SAM9M10G45-EK board"
	select UBOOT_CONFIG_AT91SAM9M10G45
	select UBOOT_CONFIG_BOARD_EARLY_INIT_F
	select UBOOT_CONFIG_SUPPORT_SPL

config UBOOT_CONFIG_TARGET_PM9G45
	bool "Ronetix pm9g45 board"
	select UBOOT_CONFIG_AT91SAM9G45

config UBOOT_CONFIG_TARGET_AT91SAM9N12EK
	bool "Atmel AT91SAM9N12-EK board"
	select UBOOT_CONFIG_AT91SAM9N12
	select UBOOT_CONFIG_BOARD_EARLY_INIT_F
	select UBOOT_CONFIG_SUPPORT_SPL

config UBOOT_CONFIG_TARGET_AT91SAM9RLEK
	bool "Atmel at91sam9rl reference board"
	select UBOOT_CONFIG_AT91SAM9RL
	select UBOOT_CONFIG_BOARD_EARLY_INIT_F

config UBOOT_CONFIG_TARGET_AT91SAM9X5EK
	bool "Atmel AT91SAM9X5-EK board"
	select UBOOT_CONFIG_AT91SAM9X5
	select UBOOT_CONFIG_BOARD_EARLY_INIT_F
	select UBOOT_CONFIG_BOARD_LATE_INIT
	select UBOOT_CONFIG_SUPPORT_SPL

config UBOOT_CONFIG_TARGET_GARDENA_SMART_GATEWAY_AT91SAM
	bool "GARDENA smart Gateway (AT91SAM)"
	select UBOOT_CONFIG_AT91SAM9X5
	select UBOOT_CONFIG_BOARD_EARLY_INIT_F
	select UBOOT_CONFIG_BOARD_LATE_INIT
	select UBOOT_CONFIG_SUPPORT_SPL

config UBOOT_CONFIG_TARGET_SAM9X60EK
	bool "SAM9X60-EK board"
	select UBOOT_CONFIG_SAM9X60
	select UBOOT_CONFIG_BOARD_EARLY_INIT_F
	select UBOOT_CONFIG_BOARD_LATE_INIT

config UBOOT_CONFIG_TARGET_SAMA5D2_PTC_EK
	bool "SAMA5D2 PTC EK board"
	select UBOOT_CONFIG_BOARD_EARLY_INIT_F
	select UBOOT_CONFIG_SAMA5D2
	select UBOOT_CONFIG_BOARD_LATE_INIT

config UBOOT_CONFIG_TARGET_SAMA5D2_XPLAINED
	bool "SAMA5D2 Xplained board"
	select UBOOT_CONFIG_BOARD_EARLY_INIT_F
	select UBOOT_CONFIG_BOARD_LATE_INIT
	select UBOOT_CONFIG_SAMA5D2
	select UBOOT_CONFIG_SUPPORT_SPL

config UBOOT_CONFIG_TARGET_SAMA5D27_SOM1_EK
	bool "SAMA5D27 SOM1 EK board"
	select UBOOT_CONFIG_BOARD_EARLY_INIT_F
	select UBOOT_CONFIG_BOARD_LATE_INIT
	select UBOOT_CONFIG_CPU_V7A
	select UBOOT_CONFIG_SUPPORT_SPL
	select UBOOT_CONFIG_ATMEL_SFR
	help
	  The SAMA5D27 SOM1 embeds SAMA5D2 SiP(System in Package),
	  a 64Mbit QSPI flash, KSZ8081 Phy and a Mac-address EEPROM
	  24AA02E48. The SAMA5D2 SiP integrates the ARM Cortex-A5
	  processor-based SAMA5D2 MPU with up to 1 Gbit DDR2-SDRAM
	  in a single package.

config UBOOT_CONFIG_TARGET_SAMA5D27_WLSOM1_EK
	bool "SAMA5D27 WLSOM1 EK board"
	select UBOOT_CONFIG_SAMA5D2
	select UBOOT_CONFIG_BOARD_EARLY_INIT_F
	select UBOOT_CONFIG_BOARD_LATE_INIT
	select UBOOT_CONFIG_CPU_V7A
	select UBOOT_CONFIG_SUPPORT_SPL
	help
	  The SAMA5D27 WLSOM1 embeds SAMA5D2 SiP (System in Package),
	  a 64Mbit QSPI flash with Mac-address, KSZ8081 Phy. A wireless
	  module providing bluetooth and wifi is also embedded.
	  The SAMA5D2 SiP integrates the ARM Cortex-A5
	  processor-based SAMA5D2 MPU with 2 Gbit LPDDR2-SDRAM
	  in a single package.

config UBOOT_CONFIG_TARGET_SAMA5D2_ICP
	bool "SAMA5D2 Industrial Connectivity Platform (ICP)"
	select UBOOT_CONFIG_SAMA5D2
	select UBOOT_CONFIG_SUPPORT_SPL
	select UBOOT_CONFIG_BOARD_EARLY_INIT_F
	select UBOOT_CONFIG_BOARD_LATE_INIT
	help
	  The SAMA5D2 ICP embeds SAMA5D27 rev. C SoC, together with
	  a 64Mbit QSPI flash, 3xMikrobus connectors, 4xUSB ,
	  EtherCat and WILC3000 devices on board.

config UBOOT_CONFIG_TARGET_SAMA5D3_XPLAINED
	bool "SAMA5D3 Xplained board"
	select UBOOT_CONFIG_BOARD_EARLY_INIT_F
	select UBOOT_CONFIG_SAMA5D3
	select UBOOT_CONFIG_SUPPORT_SPL
	select UBOOT_CONFIG_BOARD_LATE_INIT

config UBOOT_CONFIG_TARGET_SAMA5D3XEK
	bool "SAMA5D3X-EK board"
	select UBOOT_CONFIG_BOARD_EARLY_INIT_F
	select UBOOT_CONFIG_BOARD_LATE_INIT
	select UBOOT_CONFIG_SAMA5D3
	select UBOOT_CONFIG_SUPPORT_SPL

config UBOOT_CONFIG_TARGET_SAMA5D4_XPLAINED
	bool "SAMA5D4 Xplained board"
	select UBOOT_CONFIG_BOARD_EARLY_INIT_F
	select UBOOT_CONFIG_BOARD_LATE_INIT
	select UBOOT_CONFIG_SAMA5D4
	select UBOOT_CONFIG_SUPPORT_SPL

config UBOOT_CONFIG_TARGET_SAMA5D4EK
	bool "SAMA5D4 Evaluation Kit"
	select UBOOT_CONFIG_BOARD_EARLY_INIT_F
	select UBOOT_CONFIG_BOARD_LATE_INIT
	select UBOOT_CONFIG_SAMA5D4
	select UBOOT_CONFIG_SUPPORT_SPL

config UBOOT_CONFIG_TARGET_MEESC
	bool "Support meesc"
	select UBOOT_CONFIG_AT91SAM9263

config UBOOT_CONFIG_TARGET_CORVUS
	bool "Support corvus"
	select UBOOT_CONFIG_AT91SAM9M10G45
	select UBOOT_CONFIG_DM
	select UBOOT_CONFIG_DM_ETH
	select UBOOT_CONFIG_DM_GPIO
	select UBOOT_CONFIG_DM_SERIAL
	select UBOOT_CONFIG_SUPPORT_SPL
	imply CMD_DM

config UBOOT_CONFIG_TARGET_SAMA7G5EK
       bool "SAMA7G5 EK board"
       select UBOOT_CONFIG_SAMA7G5
       select UBOOT_CONFIG_BOARD_EARLY_INIT_F
       select UBOOT_CONFIG_BOARD_LATE_INIT


config UBOOT_CONFIG_TARGET_TAURUS
	bool "Support taurus"
	select UBOOT_CONFIG_AT91SAM9G20
	select UBOOT_CONFIG_DM
	select UBOOT_CONFIG_DM_ETH
	select UBOOT_CONFIG_DM_GPIO
	select UBOOT_CONFIG_DM_SERIAL
	select UBOOT_CONFIG_DM_SPI
	select UBOOT_CONFIG_SPI
	select UBOOT_CONFIG_SUPPORT_SPL
	imply CMD_DM

config UBOOT_CONFIG_TARGET_SMARTWEB
	bool "Support smartweb"
	select UBOOT_CONFIG_AT91SAM9260
	select UBOOT_CONFIG_DM
	select UBOOT_CONFIG_DM_ETH
	select UBOOT_CONFIG_DM_GPIO
	select UBOOT_CONFIG_DM_SERIAL
	select UBOOT_CONFIG_SUPPORT_SPL
	imply CMD_DM

config UBOOT_CONFIG_TARGET_VINCO
	bool "Support VINCO"
	select UBOOT_CONFIG_DM
	select UBOOT_CONFIG_DM_SPI
	select UBOOT_CONFIG_SAMA5D4
	select UBOOT_CONFIG_SPI
	select UBOOT_CONFIG_SUPPORT_SPL
	imply CMD_DM

endchoice

config UBOOT_CONFIG_ATMEL_SFR
	bool

config UBOOT_CONFIG_SYS_SOC
	default "at91"

source "../../../board/atmel/at91sam9260ek/Kconfig"
source "../../../board/atmel/at91sam9261ek/Kconfig"
source "../../../board/atmel/at91sam9263ek/Kconfig"
source "../../../board/atmel/at91sam9m10g45ek/Kconfig"
source "../../../board/atmel/at91sam9n12ek/Kconfig"
source "../../../board/atmel/at91sam9rlek/Kconfig"
source "../../../board/atmel/at91sam9x5ek/Kconfig"
source "../../../board/atmel/sam9x60ek/Kconfig"
source "../../../board/atmel/sama7g5ek/Kconfig"
source "../../../board/atmel/sama5d2_ptc_ek/Kconfig"
source "../../../board/atmel/sama5d2_xplained/Kconfig"
source "../../../board/atmel/sama5d27_som1_ek/Kconfig"
source "../../../board/atmel/sama5d27_wlsom1_ek/Kconfig"
source "../../../board/atmel/sama5d2_icp/Kconfig"
source "../../../board/atmel/sama5d3_xplained/Kconfig"
source "../../../board/atmel/sama5d3xek/Kconfig"
source "../../../board/atmel/sama5d4_xplained/Kconfig"
source "../../../board/atmel/sama5d4ek/Kconfig"
source "../../../board/bluewater/gurnard/Kconfig"
source "../../../board/bluewater/snapper9260/Kconfig"
source "../../../board/calao/usb_a9263/Kconfig"
source "../../../board/egnite/ethernut5/Kconfig"
source "../../../board/esd/meesc/Kconfig"
source "../../../board/gardena/smart-gateway-at91sam/Kconfig"
source "../../../board/l+g/vinco/Kconfig"
source "../../../board/ronetix/pm9261/Kconfig"
source "../../../board/ronetix/pm9263/Kconfig"
source "../../../board/ronetix/pm9g45/Kconfig"
source "../../../board/siemens/corvus/Kconfig"
source "../../../board/siemens/taurus/Kconfig"
source "../../../board/siemens/smartweb/Kconfig"

config UBOOT_CONFIG_SPL_LDSCRIPT
	default "arch/arm/mach-at91/arm926ejs/u-boot-spl.lds" if UBOOT_CONFIG_CPU_ARM926EJS
	default "arch/arm/mach-at91/armv7/u-boot-spl.lds" if UBOOT_CONFIG_CPU_V7A

endif
```

## open_uboot/config/arch/arm/mach-bcmstb/Kconfig
```kconfig
if UBOOT_CONFIG_ARCH_BCMSTB

config UBOOT_CONFIG_TARGET_BCM7445
	bool "Broadcom 7445 TSBL"
	depends on UBOOT_CONFIG_ARCH_BCMSTB
	help
	  Support for the Broadcom 7445 SoC.  This port assumes BOLT
	  is acting as the second stage bootloader, and U-Boot is
	  acting as the third stage bootloader (TSBL), loaded by BOLT.

config UBOOT_CONFIG_TARGET_BCM7260
	bool "Broadcom 7260 TSBL"
	depends on UBOOT_CONFIG_ARCH_BCMSTB
	help
	  Support for the Broadcom 7260 SoC.  This port assumes BOLT
	  is acting as the second stage bootloader, and U-Boot is
	  acting as the third stage bootloader (TSBL), loaded by BOLT.

config UBOOT_CONFIG_SYS_CPU
	default "armv7"

config UBOOT_CONFIG_SYS_BOARD
	default "bcmstb"

config UBOOT_CONFIG_SYS_VENDOR
	default "broadcom"

config UBOOT_CONFIG_SYS_SOC
	default "bcmstb"

config UBOOT_CONFIG_SYS_CONFIG_NAME
	default "bcm7445" if UBOOT_CONFIG_TARGET_BCM7445
	default "bcm7260" if UBOOT_CONFIG_TARGET_BCM7260

config UBOOT_CONFIG_SYS_FDT_SAVE_ADDRESS
	hex "Address to which the prior stage provided DTB will be copied"
	default 0x1f00000

config UBOOT_CONFIG_BCMSTB_SDHCI_INDEX
	int "Index of preferred BCMSTB SDHCI alias in DTB"
	default 1

endif
```

## open_uboot/config/arch/arm/mach-davinci/Kconfig
```kconfig
if UBOOT_CONFIG_ARCH_DAVINCI

choice
	prompt "DaVinci board select"
	optional

config UBOOT_CONFIG_TARGET_DA850EVM
	bool "DA850 EVM board"
	select UBOOT_CONFIG_MACH_DAVINCI_DA850_EVM
	select UBOOT_CONFIG_SOC_DA850
	select UBOOT_CONFIG_SUPPORT_SPL

config UBOOT_CONFIG_TARGET_OMAPL138_LCDK
	bool "OMAPL138 LCDK"
	select UBOOT_CONFIG_SOC_DA8XX
	select UBOOT_CONFIG_SUPPORT_SPL
	select UBOOT_CONFIG_SPL_BOARD_INIT

config UBOOT_CONFIG_TARGET_LEGOEV3
	bool "LEGO MINDSTORMS EV3"
	select UBOOT_CONFIG_MACH_DAVINCI_DA850_EVM
	select UBOOT_CONFIG_SOC_DA850

endchoice

config UBOOT_CONFIG_SYS_SOC
	default "davinci"

config UBOOT_CONFIG_DA850_LOWLEVEL
	bool "Enable Lowlevel DA850 initialization"
	depends on UBOOT_CONFIG_SOC_DA850

config UBOOT_CONFIG_SYS_DA850_PLL_INIT
	bool

config UBOOT_CONFIG_SYS_DA850_DDR_INIT
	bool

config UBOOT_CONFIG_SOC_DA850
	bool
	select UBOOT_CONFIG_SOC_DA8XX

config UBOOT_CONFIG_SOC_DA8XX
	bool
	select UBOOT_CONFIG_SYS_DA850_DDR_INIT if SUPPORT_SPL || UBOOT_CONFIG_DA850_LOWLEVEL
	select UBOOT_CONFIG_SYS_DA850_PLL_INIT if SUPPORT_SPL || UBOOT_CONFIG_DA850_LOWLEVEL

config UBOOT_CONFIG_MACH_DAVINCI_DA850_EVM
	bool

if UBOOT_CONFIG_SYS_DA850_PLL_INIT
comment "DA850 PLL Initialization Parameters"

config UBOOT_CONFIG_SYS_DV_CLKMODE
	int "PLLCTL Clock Mode"
	default 0
	help
	  Set PLLCTL Clock Mode bit as External Clock or On Chip oscillator

config UBOOT_CONFIG_SYS_DA850_PLL0_POSTDIV
	int "PLLC0 PLL Post-Divider"
	default 1
	help
	  Value written to PLLC0 PLL Post-Divider Control Register

config UBOOT_CONFIG_SYS_DA850_PLL0_PLLDIV1
	hex "PLLC0 Divider 1"
	default 0x8000
	help
	  Value written to PLLC0 Divider 1 register

config UBOOT_CONFIG_SYS_DA850_PLL0_PLLDIV2
	hex "PLLC0 Divider 2"
	default 0x8001
	help
	  Value written to PLLC0 Divider 2 register

config UBOOT_CONFIG_SYS_DA850_PLL0_PLLDIV3
	hex "PLLC0 Divider 3"
	default 0x8002
	help
	  Value written to PLLC0 Divider 3 register

config UBOOT_CONFIG_SYS_DA850_PLL0_PLLDIV4
	hex "PLLC0 Divider 4"
	default 0x8003
	help
	  Value written to PLLC0 Divider 4 register

config UBOOT_CONFIG_SYS_DA850_PLL0_PLLDIV5
	hex "PLLC0 Divider 5"
	default 0x8002
	help
	  Value written to PLLC0 Divider 5 register

config UBOOT_CONFIG_SYS_DA850_PLL0_PLLDIV6
	hex "PLLC0 Divider 6"
	default 0x8000
	help
	  Value written to PLLC0 Divider 6 register

config UBOOT_CONFIG_SYS_DA850_PLL0_PLLDIV7
	hex "PLLC0 Divider 7"
	default 0x8005
	help
	  Value written to PLLC0 Divider 7 register

config UBOOT_CONFIG_SYS_DA850_PLL1_POSTDIV
	hex "PLLC1 PLL Post-Divider"
	default 1
	help
	  Value written to PLLC1 PLL Post-Divider Control Register

config UBOOT_CONFIG_SYS_DA850_PLL1_PLLDIV1
	hex "PLLC1 Divider 2"
	default 0x8000
	help
	  Value written to PLLC1 Divider 1 register

config UBOOT_CONFIG_SYS_DA850_PLL1_PLLDIV2
	hex "PLLC1 Divider 2"
	default 0x8001
	help
	  Value written to PLLC1 Divider 2 register

config UBOOT_CONFIG_SYS_DA850_PLL1_PLLDIV3
	hex "PLLC1 Divider 3"
	default 0x8002
	help
	  Value written to PLLC1 Divider 3 register

endif

source "../../../board/davinci/da8xxevm/Kconfig"
source "../../../board/lego/ev3/Kconfig"

config UBOOT_CONFIG_SPL_LDSCRIPT
	default "board/davinci/da8xxevm/u-boot-spl-da850evm.lds"

endif
```

## open_uboot/config/arch/arm/mach-highbank/Kconfig
```kconfig
if UBOOT_CONFIG_ARCH_HIGHBANK

config UBOOT_CONFIG_SYS_BOARD
	default "highbank"

config UBOOT_CONFIG_SYS_SOC
	default "highbank"

config UBOOT_CONFIG_SYS_CONFIG_NAME
	default "highbank"

endif
```
