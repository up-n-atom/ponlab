## maxlinear/feed_uboot/open_uboot/config/board/sifive/unleashed/Kconfig
```kconfig
if UBOOT_CONFIG_TARGET_SIFIVE_UNLEASHED

config UBOOT_CONFIG_SYS_BOARD
	default "unleashed"

config UBOOT_CONFIG_SYS_VENDOR
	default "sifive"

config UBOOT_CONFIG_SYS_CPU
	default "fu540"

config UBOOT_CONFIG_SYS_CONFIG_NAME
	default "sifive-unleashed"

config UBOOT_CONFIG_SYS_TEXT_BASE
	default 0x80200000 if UBOOT_CONFIG_SPL
	default 0x80000000 if ! UBOOT_CONFIG_RISCV_SMODE
	default 0x80200000 if UBOOT_CONFIG_RISCV_SMODE

config UBOOT_CONFIG_SPL_TEXT_BASE
	default 0x08000000

config UBOOT_CONFIG_SPL_OPENSBI_LOAD_ADDR
	default 0x80000000

config UBOOT_CONFIG_BOARD_SPECIFIC_OPTIONS # dummy
	def_bool y
	select UBOOT_CONFIG_SIFIVE_FU540
	select UBOOT_CONFIG_ENV_IS_IN_SPI_FLASH
	select UBOOT_CONFIG_BINMAN
	select UBOOT_CONFIG_RESET_SIFIVE
	imply CMD_DHCP
	imply CMD_EXT2
	imply CMD_EXT4
	imply CMD_FAT
	imply CMD_FS_GENERIC
	imply CMD_GPT
	imply PARTITION_TYPE_GUID
	imply CMD_NET
	imply CMD_PING
	imply CMD_SF
	imply DOS_PARTITION
	imply EFI_PARTITION
	imply IP_DYN
	imply ISO_PARTITION
	imply PHY_LIB
	imply PHY_MSCC
	imply SPI_FLASH
	imply SPI_FLASH_ISSI
	imply SYSRESET
	imply SYSRESET_GPIO
	imply CMD_I2C

endif
```

## maxlinear/feed_uboot/open_uboot/config/board/silinux/ek874/Kconfig
```kconfig
if UBOOT_CONFIG_TARGET_SILINUX_EK874

config UBOOT_CONFIG_SYS_SOC
	default "rmobile"

config UBOOT_CONFIG_SYS_BOARD
	default "ek874"

config UBOOT_CONFIG_SYS_VENDOR
	default "silinux"

config UBOOT_CONFIG_SYS_CONFIG_NAME
	default "silinux-ek874"

endif
```

## maxlinear/feed_uboot/open_uboot/config/board/somlabs/visionsom-6ull/Kconfig
```kconfig
if UBOOT_CONFIG_TARGET_SOMLABS_VISIONSOM_6ULL

config UBOOT_CONFIG_SYS_BOARD
	default "visionsom-6ull"

config UBOOT_CONFIG_SYS_VENDOR
	default "somlabs"

config UBOOT_CONFIG_SYS_CONFIG_NAME
	default "somlabs_visionsom_6ull"

config UBOOT_CONFIG_IMX_CONFIG
	default "board/somlabs/visionsom-6ull/imximage.cfg"

endif
```

## maxlinear/feed_uboot/open_uboot/config/board/st/stm32h743-disco/Kconfig
```kconfig
if UBOOT_CONFIG_TARGET_STM32H743_DISCO

config UBOOT_CONFIG_SYS_BOARD
	string
	default "stm32h743-disco"

config UBOOT_CONFIG_SYS_VENDOR
	string
	default "st"

config UBOOT_CONFIG_SYS_SOC
	string
	default "stm32h7"

config UBOOT_CONFIG_SYS_CONFIG_NAME
	string
	default "stm32h743-disco"

endif
```

## maxlinear/feed_uboot/open_uboot/config/board/st/stm32h750-art-pi/Kconfig
```kconfig
if UBOOT_CONFIG_TARGET_STM32H750_ART_PI

config UBOOT_CONFIG_SYS_BOARD
	string
	default "stm32h750-art-pi"

config UBOOT_CONFIG_SYS_VENDOR
	string
	default "st"

config UBOOT_CONFIG_SYS_SOC
	string
	default "stm32h7"

config UBOOT_CONFIG_SYS_CONFIG_NAME
	string
	default "stm32h750-art-pi"

endif
```

## maxlinear/feed_uboot/open_uboot/config/board/st/stv0991/Kconfig
```kconfig
if UBOOT_CONFIG_TARGET_STV0991

config UBOOT_CONFIG_SYS_BOARD
	default "stv0991"

config UBOOT_CONFIG_SYS_VENDOR
	default "st"

config UBOOT_CONFIG_SYS_SOC
	default "stv0991"

config UBOOT_CONFIG_SYS_CONFIG_NAME
	default "stv0991"

endif
```

## maxlinear/feed_uboot/open_uboot/config/board/synopsys/axs10x/Kconfig
```kconfig
if UBOOT_CONFIG_TARGET_AXS101 || UBOOT_CONFIG_TARGET_AXS103

config UBOOT_CONFIG_SYS_BOARD
	default "axs10x"

config UBOOT_CONFIG_SYS_VENDOR
	default "synopsys"

config UBOOT_CONFIG_SYS_CONFIG_NAME
	default "axs10x"

endif
```

## maxlinear/feed_uboot/open_uboot/config/board/synopsys/emsdp/Kconfig
```kconfig
if UBOOT_CONFIG_TARGET_EMSDP

config UBOOT_CONFIG_SYS_BOARD
	default "emsdp"

config UBOOT_CONFIG_SYS_VENDOR
	default "synopsys"

config UBOOT_CONFIG_SYS_CONFIG_NAME
	default "emsdp"

endif
```

## maxlinear/feed_uboot/open_uboot/config/board/synopsys/hsdk/Kconfig
```kconfig
if UBOOT_CONFIG_TARGET_HSDK

config UBOOT_CONFIG_SYS_BOARD
	default "hsdk"

config UBOOT_CONFIG_SYS_VENDOR
	default "synopsys"

config UBOOT_CONFIG_SYS_CONFIG_NAME
	default "hsdk" if UBOOT_CONFIG_BOARD_HSDK
	default "hsdk-4xd" if UBOOT_CONFIG_BOARD_HSDK_4XD

choice
	prompt "HSDK board type"
	default UBOOT_CONFIG_BOARD_HSDK

config UBOOT_CONFIG_BOARD_HSDK
	bool "ARC HS Development Kit"
	help
	  ARC HS Development Kit based on quard core ARC HS38 processor

config UBOOT_CONFIG_BOARD_HSDK_4XD
	bool "ARC HS4x/HS4xD Development Kit"
	help
	  ARC HS4x/HS4xD Development Kit based on quard core ARC HS48/HS47D
	  processor

endchoice

endif
```

## maxlinear/feed_uboot/open_uboot/config/board/synopsys/nsim/Kconfig
```kconfig
if UBOOT_CONFIG_TARGET_NSIM

config UBOOT_CONFIG_SYS_BOARD
	default "nsim"

config UBOOT_CONFIG_SYS_VENDOR
	default "synopsys"

config UBOOT_CONFIG_SYS_CONFIG_NAME
	default "nsim"

config UBOOT_CONFIG_NSIM_BOARD_CPPFLAGS
	string "board arc-specific compiler options"
	help
	  For nSIM we allow to set custom arc-specific compiler options
	  (like -mcpu=) instead of hardcoding them in its makefile as nSIM
	  target is used for representing targets without fixed CPU version
	  like FPGA-based boards and software simulators.
	  This variable takes space separated compiler options list.

endif
```

## maxlinear/feed_uboot/open_uboot/config/board/sysam/amcore/Kconfig
```kconfig
if UBOOT_CONFIG_TARGET_AMCORE

config UBOOT_CONFIG_SYS_CPU
        string
        default "mcf530x"

config UBOOT_CONFIG_SYS_BOARD
        string
        default "amcore"

config UBOOT_CONFIG_SYS_VENDOR
        string
        default "sysam"

config UBOOT_CONFIG_SYS_CONFIG_NAME
        string
        default "amcore"

endif
```

## maxlinear/feed_uboot/open_uboot/config/board/sysam/stmark2/Kconfig
```kconfig
if UBOOT_CONFIG_TARGET_STMARK2

config UBOOT_CONFIG_SYS_CPU
	default "mcf5445x"

config UBOOT_CONFIG_SYS_BOARD
	default "stmark2"

config UBOOT_CONFIG_SYS_VENDOR
	default "sysam"

config UBOOT_CONFIG_SYS_CONFIG_NAME
	default "stmark2"

endif
```

## maxlinear/feed_uboot/open_uboot/config/board/technexion/pico-imx7d/Kconfig
```kconfig
if UBOOT_CONFIG_TARGET_PICO_IMX7D

config UBOOT_CONFIG_SYS_BOARD
	default "pico-imx7d"

config UBOOT_CONFIG_SYS_VENDOR
	default "technexion"

config UBOOT_CONFIG_SYS_SOC
	default "mx7"

config UBOOT_CONFIG_SYS_CONFIG_NAME
	default "pico-imx7d"

endif
```

## maxlinear/feed_uboot/open_uboot/config/board/theobroma-systems/lion_rk3368/Kconfig
```kconfig
if UBOOT_CONFIG_TARGET_LION_RK3368

config UBOOT_CONFIG_SYS_BOARD
	default "lion_rk3368"

config UBOOT_CONFIG_SYS_VENDOR
	default "theobroma-systems"

config UBOOT_CONFIG_SYS_CONFIG_NAME
	default "lion_rk3368"

config UBOOT_CONFIG_BOARD_SPECIFIC_OPTIONS # dummy
	def_bool y

config UBOOT_CONFIG_ENV_SIZE
	default 0x2000

config UBOOT_CONFIG_ENV_OFFSET
	default 0x3c000 if UBOOT_CONFIG_ENV_IS_IN_SPI_FLASH

endif
```

## maxlinear/feed_uboot/open_uboot/config/board/ti/am57xx/Kconfig
```kconfig
if UBOOT_CONFIG_TARGET_AM57XX_EVM

config UBOOT_CONFIG_SYS_BOARD
	default "am57xx"

config UBOOT_CONFIG_SYS_VENDOR
	default "ti"

config UBOOT_CONFIG_SYS_CONFIG_NAME
	default "am57xx_evm"

source "../../../board/ti/common/Kconfig"

endif
```

## maxlinear/feed_uboot/open_uboot/config/board/ti/am64x/Kconfig
```kconfig
# SPDX-License-Identifier: GPL-2.0+
#
# Copyright (C) 2020-2021 Texas Instruments Incorporated - https://www.ti.com/

choice
	prompt "K3 AM64 based boards"
	optional

config UBOOT_CONFIG_TARGET_AM642_A53_EVM
	bool "TI K3 based AM642 EVM running on A53"
	select UBOOT_CONFIG_ARM64
	select UBOOT_CONFIG_SOC_K3_AM642
	imply BOARD
	imply SPL_BOARD
	imply TI_I2C_BOARD_DETECT

config UBOOT_CONFIG_TARGET_AM642_R5_EVM
	bool "TI K3 based AM642 EVM running on R5"
	select UBOOT_CONFIG_CPU_V7R
	select UBOOT_CONFIG_SYS_THUMB_BUILD
	select UBOOT_CONFIG_K3_LOAD_SYSFW
	select UBOOT_CONFIG_SOC_K3_AM642
	select UBOOT_CONFIG_RAM
	select UBOOT_CONFIG_SPL_RAM
	select UBOOT_CONFIG_K3_DDRSS
	imply SYS_K3_SPL_ATF
	imply TI_I2C_BOARD_DETECT

endchoice

if UBOOT_CONFIG_TARGET_AM642_A53_EVM

config UBOOT_CONFIG_SYS_BOARD
       default "am64x"

config UBOOT_CONFIG_SYS_VENDOR
       default "ti"

config UBOOT_CONFIG_SYS_CONFIG_NAME
       default "am64x_evm"

source "../../../board/ti/common/Kconfig"

endif

if UBOOT_CONFIG_TARGET_AM642_R5_EVM

config UBOOT_CONFIG_SYS_BOARD
       default "am64x"

config UBOOT_CONFIG_SYS_VENDOR
       default "ti"

config UBOOT_CONFIG_SYS_CONFIG_NAME
       default "am64x_evm"

config UBOOT_CONFIG_SPL_LDSCRIPT
	default "arch/arm/mach-omap2/u-boot-spl.lds"

source "../../../board/ti/common/Kconfig"

endif
```

## maxlinear/feed_uboot/open_uboot/config/board/ti/am65x/Kconfig
```kconfig
# SPDX-License-Identifier: GPL-2.0+
#
# Copyright (C) 2017-2018 Texas Instruments Incorporated - http://www.ti.com/
#	Lokesh Vutla <lokeshvutla@ti.com>

choice
	prompt "K3 AM65 based boards"
	optional

config UBOOT_CONFIG_TARGET_AM654_A53_EVM
	bool "TI K3 based AM654 EVM running on A53"
	select UBOOT_CONFIG_ARM64
	select UBOOT_CONFIG_SOC_K3_AM6
	select UBOOT_CONFIG_SYS_DISABLE_DCACHE_OPS
	select UBOOT_CONFIG_BOARD_LATE_INIT
	imply TI_I2C_BOARD_DETECT

config UBOOT_CONFIG_TARGET_AM654_R5_EVM
	bool "TI K3 based AM654 EVM running on R5"
	select UBOOT_CONFIG_CPU_V7R
	select UBOOT_CONFIG_SYS_THUMB_BUILD
	select UBOOT_CONFIG_SOC_K3_AM6
	select UBOOT_CONFIG_K3_LOAD_SYSFW
	select UBOOT_CONFIG_K3_AM654_DDRSS
	imply SYS_K3_SPL_ATF
	imply TI_I2C_BOARD_DETECT

endchoice

if UBOOT_CONFIG_TARGET_AM654_A53_EVM

config UBOOT_CONFIG_SYS_BOARD
       default "am65x"

config UBOOT_CONFIG_SYS_VENDOR
       default "ti"

config UBOOT_CONFIG_SYS_CONFIG_NAME
       default "am65x_evm"

source "../../../board/ti/common/Kconfig"

endif

if UBOOT_CONFIG_TARGET_AM654_R5_EVM

config UBOOT_CONFIG_SYS_BOARD
       default "am65x"

config UBOOT_CONFIG_SYS_VENDOR
       default "ti"

config UBOOT_CONFIG_SYS_CONFIG_NAME
       default "am65x_evm"

config UBOOT_CONFIG_SPL_LDSCRIPT
	default "arch/arm/mach-omap2/u-boot-spl.lds"

source "../../../board/ti/common/Kconfig"

endif
```

## maxlinear/feed_uboot/open_uboot/config/board/ti/dra7xx/Kconfig
```kconfig
if UBOOT_CONFIG_TARGET_DRA7XX_EVM

config UBOOT_CONFIG_SYS_BOARD
	default "dra7xx"

config UBOOT_CONFIG_SYS_VENDOR
	default "ti"

config UBOOT_CONFIG_SYS_CONFIG_NAME
	default "dra7xx_evm"

source "../../../board/ti/common/Kconfig"

endif
```

## maxlinear/feed_uboot/open_uboot/config/board/ti/j721e/Kconfig
```kconfig
# SPDX-License-Identifier: GPL-2.0+
#
# Copyright (C) 2018-2019 Texas Instruments Incorporated - http://www.ti.com/
#	Lokesh Vutla <lokeshvutla@ti.com>

choice
	prompt "K3 J721E based boards"
	optional

config UBOOT_CONFIG_TARGET_J721E_A72_EVM
	bool "TI K3 based J721E EVM running on A72"
	select UBOOT_CONFIG_ARM64
	select UBOOT_CONFIG_SOC_K3_J721E
	select UBOOT_CONFIG_BOARD_LATE_INIT
	imply TI_I2C_BOARD_DETECT
	select UBOOT_CONFIG_SYS_DISABLE_DCACHE_OPS

config UBOOT_CONFIG_TARGET_J721E_R5_EVM
	bool "TI K3 based J721E EVM running on R5"
	select UBOOT_CONFIG_CPU_V7R
	select UBOOT_CONFIG_SYS_THUMB_BUILD
	select UBOOT_CONFIG_SOC_K3_J721E
	select UBOOT_CONFIG_K3_LOAD_SYSFW
	select UBOOT_CONFIG_RAM
	select UBOOT_CONFIG_SPL_RAM
	select UBOOT_CONFIG_K3_DDRSS
	imply SYS_K3_SPL_ATF
	imply TI_I2C_BOARD_DETECT

config UBOOT_CONFIG_TARGET_J7200_A72_EVM
	bool "TI K3 based J7200 EVM running on A72"
	select UBOOT_CONFIG_ARM64
	select UBOOT_CONFIG_SOC_K3_J721E
	select UBOOT_CONFIG_BOARD_LATE_INIT
	imply TI_I2C_BOARD_DETECT
	select UBOOT_CONFIG_SYS_DISABLE_DCACHE_OPS

config UBOOT_CONFIG_TARGET_J7200_R5_EVM
	bool "TI K3 based J7200 EVM running on R5"
	select UBOOT_CONFIG_CPU_V7R
	select UBOOT_CONFIG_SYS_THUMB_BUILD
	select UBOOT_CONFIG_SOC_K3_J721E
	select UBOOT_CONFIG_K3_LOAD_SYSFW
	select UBOOT_CONFIG_RAM
	select UBOOT_CONFIG_SPL_RAM
	select UBOOT_CONFIG_K3_DDRSS
	imply SYS_K3_SPL_ATF
	imply TI_I2C_BOARD_DETECT

endchoice

if UBOOT_CONFIG_TARGET_J721E_A72_EVM

config UBOOT_CONFIG_SYS_BOARD
       default "j721e"

config UBOOT_CONFIG_SYS_VENDOR
       default "ti"

config UBOOT_CONFIG_SYS_CONFIG_NAME
       default "j721e_evm"

source "../../../board/ti/common/Kconfig"

endif

if UBOOT_CONFIG_TARGET_J721E_R5_EVM

config UBOOT_CONFIG_SYS_BOARD
       default "j721e"

config UBOOT_CONFIG_SYS_VENDOR
       default "ti"

config UBOOT_CONFIG_SYS_CONFIG_NAME
       default "j721e_evm"

config UBOOT_CONFIG_SPL_LDSCRIPT
	default "arch/arm/mach-omap2/u-boot-spl.lds"

source "../../../board/ti/common/Kconfig"

endif

if UBOOT_CONFIG_TARGET_J7200_A72_EVM

config UBOOT_CONFIG_SYS_BOARD
       default "j721e"

config UBOOT_CONFIG_SYS_VENDOR
       default "ti"

config UBOOT_CONFIG_SYS_CONFIG_NAME
       default "j721e_evm"

source "../../../board/ti/common/Kconfig"

endif

if UBOOT_CONFIG_TARGET_J7200_R5_EVM

config UBOOT_CONFIG_SYS_BOARD
       default "j721e"

config UBOOT_CONFIG_SYS_VENDOR
       default "ti"

config UBOOT_CONFIG_SYS_CONFIG_NAME
       default "j721e_evm"

config UBOOT_CONFIG_SPL_LDSCRIPT
	default "arch/arm/mach-omap2/u-boot-spl.lds"

source "../../../board/ti/common/Kconfig"

endif
```

## maxlinear/feed_uboot/open_uboot/config/board/timll/devkit8000/Kconfig
```kconfig
if UBOOT_CONFIG_TARGET_DEVKIT8000

config UBOOT_CONFIG_SYS_BOARD
	default "devkit8000"

config UBOOT_CONFIG_SYS_VENDOR
	default "timll"

config UBOOT_CONFIG_SYS_CONFIG_NAME
	default "devkit8000"

endif
```

## maxlinear/feed_uboot/open_uboot/config/board/toradex/colibri-imx8x/Kconfig
```kconfig
if UBOOT_CONFIG_TARGET_COLIBRI_IMX8X

config UBOOT_CONFIG_SYS_BOARD
	default "colibri-imx8x"

config UBOOT_CONFIG_SYS_VENDOR
	default "toradex"

config UBOOT_CONFIG_SYS_CONFIG_NAME
	default "colibri-imx8x"

config UBOOT_CONFIG_TDX_CFG_BLOCK
	default y

config UBOOT_CONFIG_TDX_HAVE_MMC
	default y

config UBOOT_CONFIG_TDX_CFG_BLOCK_DEV
	default "0"

config UBOOT_CONFIG_TDX_CFG_BLOCK_PART
	default "1"

# Toradex config block in eMMC, at the end of 1st "boot sector"
config UBOOT_CONFIG_TDX_CFG_BLOCK_OFFSET
	default "-512"

config UBOOT_CONFIG_IMX_CONFIG
	default "board/toradex/colibri-imx8x/colibri-imx8x-imximage.cfg"

source "../../../board/toradex/common/Kconfig"

endif
```

## maxlinear/feed_uboot/open_uboot/config/board/udoo/Kconfig
```kconfig
if UBOOT_CONFIG_TARGET_UDOO

config UBOOT_CONFIG_SYS_BOARD
	default "udoo"

config UBOOT_CONFIG_SYS_CONFIG_NAME
	default "udoo"

endif
```

## maxlinear/feed_uboot/open_uboot/config/board/udoo/neo/Kconfig
```kconfig
if UBOOT_CONFIG_TARGET_UDOO_NEO

config UBOOT_CONFIG_SYS_VENDOR
	default "udoo"

config UBOOT_CONFIG_SYS_BOARD
	default "neo"

config UBOOT_CONFIG_SYS_CONFIG_NAME
	default "udoo_neo"

endif
```

## maxlinear/feed_uboot/open_uboot/config/board/vamrs/rock960_rk3399/Kconfig
```kconfig
if UBOOT_CONFIG_TARGET_ROCK960_RK3399

config UBOOT_CONFIG_SYS_BOARD
	default "rock960_rk3399"

config UBOOT_CONFIG_SYS_VENDOR
	default "vamrs"

config UBOOT_CONFIG_SYS_CONFIG_NAME
	default "rock960_rk3399"

config UBOOT_CONFIG_BOARD_SPECIFIC_OPTIONS # dummy
	def_bool y

endif
```

## maxlinear/feed_uboot/open_uboot/config/board/variscite/dart_6ul/Kconfig
```kconfig
if UBOOT_CONFIG_TARGET_DART_6UL

config UBOOT_CONFIG_SYS_BOARD
	default "dart_6ul"

config UBOOT_CONFIG_SYS_VENDOR
	default "variscite"

config UBOOT_CONFIG_SYS_CONFIG_NAME
	default "dart_6ul"

endif
```
