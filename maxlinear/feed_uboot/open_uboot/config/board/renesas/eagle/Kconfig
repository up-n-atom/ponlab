## maxlinear/feed_uboot/open_uboot/config/board/renesas/eagle/Kconfig
```kconfig
if UBOOT_CONFIG_TARGET_EAGLE

config UBOOT_CONFIG_SYS_SOC
	default "rmobile"

config UBOOT_CONFIG_SYS_BOARD
	default "eagle"

config UBOOT_CONFIG_SYS_VENDOR
	default "renesas"

config UBOOT_CONFIG_SYS_CONFIG_NAME
	default "eagle"

endif
```

## maxlinear/feed_uboot/open_uboot/config/board/renesas/gose/Kconfig
```kconfig
if UBOOT_CONFIG_TARGET_GOSE

config UBOOT_CONFIG_SYS_BOARD
	default "gose"

config UBOOT_CONFIG_SYS_VENDOR
	default "renesas"

config UBOOT_CONFIG_SYS_CONFIG_NAME
	default "gose"

endif
```

## maxlinear/feed_uboot/open_uboot/config/board/renesas/lager/Kconfig
```kconfig
if UBOOT_CONFIG_TARGET_LAGER

config UBOOT_CONFIG_SYS_BOARD
	default "lager"

config UBOOT_CONFIG_SYS_VENDOR
	default "renesas"

config UBOOT_CONFIG_SYS_CONFIG_NAME
	default "lager"

endif
```

## maxlinear/feed_uboot/open_uboot/config/board/renesas/r2dplus/Kconfig
```kconfig
if UBOOT_CONFIG_TARGET_R2DPLUS

config UBOOT_CONFIG_SYS_BOARD
	default "r2dplus"

config UBOOT_CONFIG_SYS_VENDOR
	default "renesas"

config UBOOT_CONFIG_SYS_CONFIG_NAME
	default "r2dplus"

endif
```

## maxlinear/feed_uboot/open_uboot/config/board/renesas/silk/Kconfig
```kconfig
if UBOOT_CONFIG_TARGET_SILK

config UBOOT_CONFIG_SYS_BOARD
	default "silk"

config UBOOT_CONFIG_SYS_VENDOR
	default "renesas"

config UBOOT_CONFIG_SYS_CONFIG_NAME
	default "silk"

endif
```

## maxlinear/feed_uboot/open_uboot/config/board/rockchip/evb_px30/Kconfig
```kconfig
if UBOOT_CONFIG_TARGET_EVB_PX30

config UBOOT_CONFIG_SYS_BOARD
	default "evb_px30"

config UBOOT_CONFIG_SYS_VENDOR
	default "rockchip"

config UBOOT_CONFIG_SYS_CONFIG_NAME
	default "evb_px30"

config UBOOT_CONFIG_BOARD_SPECIFIC_OPTIONS # dummy
	def_bool y

endif
```

## maxlinear/feed_uboot/open_uboot/config/board/rockchip/evb_rv1108/Kconfig
```kconfig
if UBOOT_CONFIG_TARGET_EVB_RV1108

config UBOOT_CONFIG_SYS_BOARD
	default "evb_rv1108"

config UBOOT_CONFIG_SYS_VENDOR
	default "rockchip"

config UBOOT_CONFIG_SYS_CONFIG_NAME
	default "evb_rv1108"

config UBOOT_CONFIG_BOARD_SPECIFIC_OPTIONS # dummy
	def_bool y

endif
```

## maxlinear/feed_uboot/open_uboot/config/board/rockchip/tinker_rk3288/Kconfig
```kconfig
if UBOOT_CONFIG_TARGET_TINKER_RK3288

config UBOOT_CONFIG_SYS_BOARD
	default "tinker_rk3288"

config UBOOT_CONFIG_SYS_VENDOR
	default "rockchip"

config UBOOT_CONFIG_SYS_CONFIG_NAME
	default "tinker_rk3288"

config UBOOT_CONFIG_BOARD_SPECIFIC_OPTIONS # dummy
	def_bool y

endif
```

## maxlinear/feed_uboot/open_uboot/config/board/ronetix/pm9263/Kconfig
```kconfig
if UBOOT_CONFIG_TARGET_PM9263

config UBOOT_CONFIG_SYS_BOARD
	default "pm9263"

config UBOOT_CONFIG_SYS_VENDOR
	default "ronetix"

config UBOOT_CONFIG_SYS_CONFIG_NAME
	default "pm9263"

endif
```

## maxlinear/feed_uboot/open_uboot/config/board/sagem/f@st1704/Kconfig
```kconfig
if UBOOT_CONFIG_BOARD_SAGEM_FAST1704

config UBOOT_CONFIG_SYS_BOARD
	default "f@st1704"

config UBOOT_CONFIG_SYS_VENDOR
	default "sagem"

config UBOOT_CONFIG_SYS_CONFIG_NAME
	default "sagem_f@st1704"

endif
```

## maxlinear/feed_uboot/open_uboot/config/board/samsung/axy17lte/Kconfig
```kconfig
config UBOOT_CONFIG_SYS_CONFIG_NAME
	string "Board configuration name"
	default "exynos78x0-common.h"
	help
	  This option contains information about board configuration name.
	  Based on this option include/configs/<CONFIG_SYS_CONFIG_NAME>.h header
	  will be used for board configuration.

if UBOOT_CONFIG_TARGET_A5Y17LTE
config UBOOT_CONFIG_SYS_BOARD
	default "axy17lte"
	help
	  a5y17lte is a production board for SM-A520F phone on Exynos7880 SoC.

config UBOOT_CONFIG_SYS_VENDOR
	default "samsung"

config UBOOT_CONFIG_SYS_CONFIG_NAME
	default "a5y17lte"

config UBOOT_CONFIG_EXYNOS7880
    bool "Exynos 7880 SOC support"
    default y
endif

if UBOOT_CONFIG_TARGET_A7Y17LTE
config UBOOT_CONFIG_SYS_BOARD
	default "axy17lte"
	help
	  a5y17lte is a production board for SM-A520F phone on Exynos7880 SoC.

config UBOOT_CONFIG_SYS_VENDOR
	default "samsung"

config UBOOT_CONFIG_SYS_CONFIG_NAME
	default "a5y17lte"

config UBOOT_CONFIG_EXYNOS7880
    bool "Exynos 7880 SOC support"
    default y
endif

if UBOOT_CONFIG_TARGET_A3Y17LTE
config UBOOT_CONFIG_SYS_BOARD
	default "axy17lte"
	help
	  a3y17lte is a production board for SM-A520F phone on Exynos7880 SoC.

config UBOOT_CONFIG_SYS_VENDOR
	default "samsung"

config UBOOT_CONFIG_SYS_CONFIG_NAME
	default "a3y17lte"

config UBOOT_CONFIG_EXYNOS7870
    bool "Exynos 7870 SOC support"
    default y
endif
```

## maxlinear/feed_uboot/open_uboot/config/board/samsung/odroid/Kconfig
```kconfig
if UBOOT_CONFIG_TARGET_ODROID

config UBOOT_CONFIG_SYS_BOARD
	default "odroid"

config UBOOT_CONFIG_SYS_VENDOR
	default "samsung"

config UBOOT_CONFIG_SYS_CONFIG_NAME
	default "odroid"

endif
```

## maxlinear/feed_uboot/open_uboot/config/board/samsung/origen/Kconfig
```kconfig
if UBOOT_CONFIG_TARGET_ORIGEN

config UBOOT_CONFIG_SYS_BOARD
	default "origen"

config UBOOT_CONFIG_SYS_VENDOR
	default "samsung"

config UBOOT_CONFIG_SYS_CONFIG_NAME
	default "origen"

endif
```

## maxlinear/feed_uboot/open_uboot/config/board/samsung/smdk5250/Kconfig
```kconfig
if UBOOT_CONFIG_TARGET_SMDK5250

config UBOOT_CONFIG_SYS_BOARD
	default "smdk5250"

config UBOOT_CONFIG_SYS_VENDOR
	default "samsung"

config UBOOT_CONFIG_SYS_CONFIG_NAME
	default "smdk5250"

endif

if UBOOT_CONFIG_TARGET_SNOW

config UBOOT_CONFIG_SYS_BOARD
	default "smdk5250"

config UBOOT_CONFIG_SYS_VENDOR
	default "samsung"

config UBOOT_CONFIG_SYS_CONFIG_NAME
	default "snow"

endif

if UBOOT_CONFIG_TARGET_SPRING

config UBOOT_CONFIG_SYS_BOARD
	default "smdk5250"

config UBOOT_CONFIG_SYS_VENDOR
	default "samsung"

config UBOOT_CONFIG_SYS_CONFIG_NAME
	default "spring"

endif
```

## maxlinear/feed_uboot/open_uboot/config/board/samsung/smdk5420/Kconfig
```kconfig
if UBOOT_CONFIG_TARGET_ODROID_XU3

config UBOOT_CONFIG_SYS_BOARD
	default "smdk5420"

config UBOOT_CONFIG_SYS_VENDOR
	default "samsung"

config UBOOT_CONFIG_SYS_CONFIG_NAME
	default "odroid_xu3"

endif

if UBOOT_CONFIG_TARGET_PEACH_PI

config UBOOT_CONFIG_SYS_BOARD
	default "smdk5420"

config UBOOT_CONFIG_SYS_VENDOR
	default "samsung"

config UBOOT_CONFIG_SYS_CONFIG_NAME
	default "peach-pi"

endif

if UBOOT_CONFIG_TARGET_PEACH_PIT

config UBOOT_CONFIG_SYS_BOARD
	default "smdk5420"

config UBOOT_CONFIG_SYS_VENDOR
	default "samsung"

config UBOOT_CONFIG_SYS_CONFIG_NAME
	default "peach-pit"

endif

if UBOOT_CONFIG_TARGET_SMDK5420

config UBOOT_CONFIG_SYS_BOARD
	default "smdk5420"

config UBOOT_CONFIG_SYS_VENDOR
	default "samsung"

config UBOOT_CONFIG_SYS_CONFIG_NAME
	default "smdk5420"

endif
```

## maxlinear/feed_uboot/open_uboot/config/board/samsung/smdkc100/Kconfig
```kconfig
if UBOOT_CONFIG_TARGET_SMDKC100

config UBOOT_CONFIG_SYS_BOARD
	default "smdkc100"

config UBOOT_CONFIG_SYS_VENDOR
	default "samsung"

config UBOOT_CONFIG_SYS_SOC
	default "s5pc1xx"

config UBOOT_CONFIG_SYS_CONFIG_NAME
	default "smdkc100"

endif
```

## maxlinear/feed_uboot/open_uboot/config/board/samsung/smdkv310/Kconfig
```kconfig
if UBOOT_CONFIG_TARGET_SMDKV310

config UBOOT_CONFIG_SYS_BOARD
	default "smdkv310"

config UBOOT_CONFIG_SYS_VENDOR
	default "samsung"

config UBOOT_CONFIG_SYS_CONFIG_NAME
	default "smdkv310"

endif
```

## maxlinear/feed_uboot/open_uboot/config/board/samsung/trats2/Kconfig
```kconfig
if UBOOT_CONFIG_TARGET_TRATS2

config UBOOT_CONFIG_SYS_BOARD
	default "trats2"

config UBOOT_CONFIG_SYS_VENDOR
	default "samsung"

config UBOOT_CONFIG_SYS_CONFIG_NAME
	default "trats2"

endif
```

## maxlinear/feed_uboot/open_uboot/config/board/samsung/universal_c210/Kconfig
```kconfig
if UBOOT_CONFIG_TARGET_S5PC210_UNIVERSAL

config UBOOT_CONFIG_SYS_BOARD
	default "universal_c210"

config UBOOT_CONFIG_SYS_VENDOR
	default "samsung"

config UBOOT_CONFIG_SYS_CONFIG_NAME
	default "s5pc210_universal"

endif
```

## maxlinear/feed_uboot/open_uboot/config/board/seeed/linkit-smart-7688/Kconfig
```kconfig
if UBOOT_CONFIG_BOARD_LINKIT_SMART_7688

config UBOOT_CONFIG_SYS_BOARD
	default "linkit-smart-7688"

config UBOOT_CONFIG_SYS_VENDOR
	default "seeed"

config UBOOT_CONFIG_SYS_CONFIG_NAME
	default "linkit-smart-7688"

endif
```

## maxlinear/feed_uboot/open_uboot/config/board/seeed/npi_imx6ull/Kconfig
```kconfig
if UBOOT_CONFIG_TARGET_NPI_IMX6ULL

config UBOOT_CONFIG_SYS_BOARD
	default "npi_imx6ull"

config UBOOT_CONFIG_SYS_VENDOR
	default "seeed"

config UBOOT_CONFIG_SYS_CONFIG_NAME
	default "npi_imx6ull"

endif
```

## maxlinear/feed_uboot/open_uboot/config/board/siemens/corvus/Kconfig
```kconfig
if UBOOT_CONFIG_TARGET_CORVUS

config UBOOT_CONFIG_SYS_BOARD
	default "corvus"

config UBOOT_CONFIG_SYS_VENDOR
	default "siemens"

config UBOOT_CONFIG_SYS_CONFIG_NAME
	default "corvus"

endif
```

## maxlinear/feed_uboot/open_uboot/config/board/siemens/pxm2/Kconfig
```kconfig
if UBOOT_CONFIG_TARGET_PXM2

config UBOOT_CONFIG_SYS_BOARD
	default "pxm2"

config UBOOT_CONFIG_SYS_VENDOR
	default "siemens"

config UBOOT_CONFIG_SYS_SOC
	default "am33xx"

config UBOOT_CONFIG_SYS_CONFIG_NAME
	default "pxm2"

endif
```

## maxlinear/feed_uboot/open_uboot/config/board/siemens/rut/Kconfig
```kconfig
if UBOOT_CONFIG_TARGET_RUT

config UBOOT_CONFIG_SYS_BOARD
	default "rut"

config UBOOT_CONFIG_SYS_VENDOR
	default "siemens"

config UBOOT_CONFIG_SYS_SOC
	default "am33xx"

config UBOOT_CONFIG_SYS_CONFIG_NAME
	default "rut"

endif
```

## maxlinear/feed_uboot/open_uboot/config/board/siemens/smartweb/Kconfig
```kconfig
if UBOOT_CONFIG_TARGET_SMARTWEB

config UBOOT_CONFIG_SYS_BOARD
	default "smartweb"

config UBOOT_CONFIG_SYS_VENDOR
	default "siemens"

config UBOOT_CONFIG_SYS_CONFIG_NAME
	default "smartweb"

endif
```
