## maxlinear/feed_uboot/open_uboot/config/board/freescale/ls1088a/Kconfig
```kconfig
if UBOOT_CONFIG_TARGET_LS1088AQDS

config UBOOT_CONFIG_SYS_BOARD
	default "ls1088a"

config UBOOT_CONFIG_SYS_VENDOR
	default "freescale"

config UBOOT_CONFIG_SYS_SOC
	default "fsl-layerscape"

config UBOOT_CONFIG_SYS_CONFIG_NAME
	default "ls1088aqds"

if UBOOT_CONFIG_FSL_LS_PPA
config UBOOT_CONFIG_SYS_LS_PPA_FW_ADDR
        hex "PPA Firmware Addr"
	default 0x20400000 if UBOOT_CONFIG_SYS_LS_PPA_FW_IN_XIP
	default 0x400000 if UBOOT_CONFIG_SYS_LS_PPA_FW_IN_MMC || UBOOT_CONFIG_SYS_LS_PPA_FW_IN_NAND

if UBOOT_CONFIG_CHAIN_OF_TRUST
config UBOOT_CONFIG_SYS_LS_PPA_ESBC_ADDR
	hex "PPA Firmware HDR Addr"
	default 0x20680000 if UBOOT_CONFIG_SYS_LS_PPA_FW_IN_XIP
	default 0x680000 if UBOOT_CONFIG_SYS_LS_PPA_FW_IN_MMC || UBOOT_CONFIG_SYS_LS_PPA_FW_IN_NAND
endif
endif

source "../../../board/freescale/common/Kconfig"
endif

if UBOOT_CONFIG_TARGET_LS1088ARDB

config UBOOT_CONFIG_SYS_BOARD
	default "ls1088a"

config UBOOT_CONFIG_SYS_VENDOR
	default "freescale"

config UBOOT_CONFIG_SYS_SOC
	default "fsl-layerscape"

config UBOOT_CONFIG_SYS_CONFIG_NAME
	default "ls1088ardb"

if UBOOT_CONFIG_FSL_LS_PPA
config UBOOT_CONFIG_SYS_LS_PPA_FW_ADDR
        hex "PPA Firmware Addr"
	default 0x20400000 if UBOOT_CONFIG_SYS_LS_PPA_FW_IN_XIP
	default 0x400000 if UBOOT_CONFIG_SYS_LS_PPA_FW_IN_MMC || UBOOT_CONFIG_SYS_LS_PPA_FW_IN_NAND

if UBOOT_CONFIG_CHAIN_OF_TRUST
config UBOOT_CONFIG_SYS_LS_PPA_ESBC_ADDR
	hex "PPA Firmware HDR Addr"
	default 0x20680000 if UBOOT_CONFIG_SYS_LS_PPA_FW_IN_XIP
	default 0x680000 if UBOOT_CONFIG_SYS_LS_PPA_FW_IN_MMC || UBOOT_CONFIG_SYS_LS_PPA_FW_IN_NAND
endif
endif

source "../../../board/freescale/common/Kconfig"
endif
```

## maxlinear/feed_uboot/open_uboot/config/board/freescale/lx2160a/Kconfig
```kconfig
if UBOOT_CONFIG_TARGET_LX2160ARDB

config UBOOT_CONFIG_SYS_BOARD
	default "lx2160a"

config UBOOT_CONFIG_SYS_VENDOR
	default "freescale"

config UBOOT_CONFIG_SYS_SOC
	default "fsl-layerscape"

config UBOOT_CONFIG_SYS_CONFIG_NAME
	default "lx2160ardb"

source "../../../board/freescale/common/Kconfig"
endif

if UBOOT_CONFIG_TARGET_LX2160AQDS

config UBOOT_CONFIG_SYS_BOARD
	default "lx2160a"

config UBOOT_CONFIG_SYS_VENDOR
	default "freescale"

config UBOOT_CONFIG_SYS_SOC
	default "fsl-layerscape"

config UBOOT_CONFIG_SYS_CONFIG_NAME
	default "lx2160aqds"

source "../../../board/freescale/common/Kconfig"
endif

if UBOOT_CONFIG_TARGET_LX2162AQDS

config UBOOT_CONFIG_SYS_BOARD
	default "lx2160a"

config UBOOT_CONFIG_SYS_VENDOR
	default "freescale"

config UBOOT_CONFIG_SYS_SOC
	default "fsl-layerscape"

config UBOOT_CONFIG_SYS_CONFIG_NAME
	default "lx2162aqds"

source "../../../board/freescale/common/Kconfig"
endif
```

## maxlinear/feed_uboot/open_uboot/config/board/freescale/m5208evbe/Kconfig
```kconfig
if UBOOT_CONFIG_TARGET_M5208EVBE

config UBOOT_CONFIG_SYS_CPU
	default "mcf52x2"

config UBOOT_CONFIG_SYS_BOARD
	default "m5208evbe"

config UBOOT_CONFIG_SYS_VENDOR
	default "freescale"

config UBOOT_CONFIG_SYS_CONFIG_NAME
	default "M5208EVBE"

endif
```

## maxlinear/feed_uboot/open_uboot/config/board/freescale/m5235evb/Kconfig
```kconfig
if UBOOT_CONFIG_TARGET_M5235EVB

config UBOOT_CONFIG_SYS_CPU
	default "mcf523x"

config UBOOT_CONFIG_SYS_BOARD
	default "m5235evb"

config UBOOT_CONFIG_SYS_VENDOR
	default "freescale"

config UBOOT_CONFIG_SYS_CONFIG_NAME
	default "M5235EVB"

endif
```

## maxlinear/feed_uboot/open_uboot/config/board/freescale/m5249evb/Kconfig
```kconfig
if UBOOT_CONFIG_TARGET_M5249EVB

config UBOOT_CONFIG_SYS_CPU
	default "mcf52x2"

config UBOOT_CONFIG_SYS_BOARD
	default "m5249evb"

config UBOOT_CONFIG_SYS_VENDOR
	default "freescale"

config UBOOT_CONFIG_SYS_CONFIG_NAME
	default "M5249EVB"

endif
```

## maxlinear/feed_uboot/open_uboot/config/board/freescale/m5272c3/Kconfig
```kconfig
if UBOOT_CONFIG_TARGET_M5272C3

config UBOOT_CONFIG_SYS_CPU
	default "mcf52x2"

config UBOOT_CONFIG_SYS_BOARD
	default "m5272c3"

config UBOOT_CONFIG_SYS_VENDOR
	default "freescale"

config UBOOT_CONFIG_SYS_CONFIG_NAME
	default "M5272C3"

endif
```

## maxlinear/feed_uboot/open_uboot/config/board/freescale/m5275evb/Kconfig
```kconfig
if UBOOT_CONFIG_TARGET_M5275EVB

config UBOOT_CONFIG_SYS_CPU
	default "mcf52x2"

config UBOOT_CONFIG_SYS_BOARD
	default "m5275evb"

config UBOOT_CONFIG_SYS_VENDOR
	default "freescale"

config UBOOT_CONFIG_SYS_CONFIG_NAME
	default "M5275EVB"

endif
```

## maxlinear/feed_uboot/open_uboot/config/board/freescale/m5282evb/Kconfig
```kconfig
if UBOOT_CONFIG_TARGET_M5282EVB

config UBOOT_CONFIG_SYS_CPU
	default "mcf52x2"

config UBOOT_CONFIG_SYS_BOARD
	default "m5282evb"

config UBOOT_CONFIG_SYS_VENDOR
	default "freescale"

config UBOOT_CONFIG_SYS_CONFIG_NAME
	default "M5282EVB"

endif
```

## maxlinear/feed_uboot/open_uboot/config/board/freescale/m53017evb/Kconfig
```kconfig
if UBOOT_CONFIG_TARGET_M53017EVB

config UBOOT_CONFIG_SYS_CPU
	default "mcf532x"

config UBOOT_CONFIG_SYS_BOARD
	default "m53017evb"

config UBOOT_CONFIG_SYS_VENDOR
	default "freescale"

config UBOOT_CONFIG_SYS_CONFIG_NAME
	default "M53017EVB"

endif
```

## maxlinear/feed_uboot/open_uboot/config/board/freescale/m5329evb/Kconfig
```kconfig
if UBOOT_CONFIG_TARGET_M5329EVB

config UBOOT_CONFIG_SYS_CPU
	default "mcf532x"

config UBOOT_CONFIG_SYS_BOARD
	default "m5329evb"

config UBOOT_CONFIG_SYS_VENDOR
	default "freescale"

config UBOOT_CONFIG_SYS_CONFIG_NAME
	default "M5329EVB"

endif
```

## maxlinear/feed_uboot/open_uboot/config/board/freescale/mx23evk/Kconfig
```kconfig
if UBOOT_CONFIG_TARGET_MX23EVK

config UBOOT_CONFIG_SYS_BOARD
	default "mx23evk"

config UBOOT_CONFIG_SYS_VENDOR
	default "freescale"

config UBOOT_CONFIG_SYS_SOC
	default "mxs"

config UBOOT_CONFIG_SYS_CONFIG_NAME
	default "mx23evk"

endif
```

## maxlinear/feed_uboot/open_uboot/config/board/freescale/mx28evk/Kconfig
```kconfig
if UBOOT_CONFIG_TARGET_MX28EVK

config UBOOT_CONFIG_SYS_BOARD
	default "mx28evk"

config UBOOT_CONFIG_SYS_VENDOR
	default "freescale"

config UBOOT_CONFIG_SYS_SOC
	default "mxs"

config UBOOT_CONFIG_SYS_CONFIG_NAME
	default "mx28evk"

endif
```

## maxlinear/feed_uboot/open_uboot/config/board/freescale/mx53loco/Kconfig
```kconfig
if UBOOT_CONFIG_TARGET_MX53LOCO

config UBOOT_CONFIG_SYS_BOARD
	default "mx53loco"

config UBOOT_CONFIG_SYS_VENDOR
	default "freescale"

config UBOOT_CONFIG_SYS_SOC
	default "mx5"

config UBOOT_CONFIG_SYS_CONFIG_NAME
	default "mx53loco"

config UBOOT_CONFIG_IMX_CONFIG
	default "board/freescale/mx53loco/imximage.cfg"

endif
```

## maxlinear/feed_uboot/open_uboot/config/board/freescale/mx6sabresd/Kconfig
```kconfig
if UBOOT_CONFIG_TARGET_MX6SABRESD

config UBOOT_CONFIG_SYS_BOARD
	default "mx6sabresd"

config UBOOT_CONFIG_SYS_VENDOR
	default "freescale"

config UBOOT_CONFIG_SYS_CONFIG_NAME
	default "mx6sabresd"

endif
```

## maxlinear/feed_uboot/open_uboot/config/board/freescale/mx7dsabresd/Kconfig
```kconfig
if UBOOT_CONFIG_TARGET_MX7DSABRESD

config UBOOT_CONFIG_SYS_BOARD
	default "mx7dsabresd"

config UBOOT_CONFIG_SYS_VENDOR
	default "freescale"

config UBOOT_CONFIG_SYS_CONFIG_NAME
	default "mx7dsabresd"

config UBOOT_CONFIG_IMX_CONFIG
	default "board/freescale/mx7dsabresd/imximage.cfg"

endif
```

## maxlinear/feed_uboot/open_uboot/config/board/freescale/p1_p2_rdb_pc/Kconfig
```kconfig
if UBOOT_CONFIG_TARGET_P1020RDB_PC	|| \
	TARGET_P1020RDB_PD	|| \
	TARGET_P2020RDB

config UBOOT_CONFIG_SYS_BOARD
	default "p1_p2_rdb_pc"

config UBOOT_CONFIG_SYS_VENDOR
	default "freescale"

config UBOOT_CONFIG_SYS_CONFIG_NAME
	default "p1_p2_rdb_pc"

endif
```

## maxlinear/feed_uboot/open_uboot/config/board/freescale/t208xrdb/Kconfig
```kconfig
if UBOOT_CONFIG_TARGET_T2080RDB

config UBOOT_CONFIG_SYS_BOARD
	default "t208xrdb"

config UBOOT_CONFIG_SYS_VENDOR
	default "freescale"

config UBOOT_CONFIG_SYS_CONFIG_NAME
	default "T208xRDB"

config UBOOT_CONFIG_T2080RDB_REV_D
	bool "Support for T2080RDB revisions D and up"

source "../../../board/freescale/common/Kconfig"

endif
```

## maxlinear/feed_uboot/open_uboot/config/board/freescale/t4rdb/Kconfig
```kconfig
if UBOOT_CONFIG_TARGET_T4240RDB

config UBOOT_CONFIG_SYS_BOARD
	default "t4rdb"

config UBOOT_CONFIG_SYS_VENDOR
	default "freescale"

config UBOOT_CONFIG_SYS_CONFIG_NAME
	default "T4240RDB"

source "../../../board/freescale/common/Kconfig"

endif
```

## maxlinear/feed_uboot/open_uboot/config/board/friendlyarm/nanopi2/Kconfig
```kconfig
if UBOOT_CONFIG_TARGET_NANOPI2

config UBOOT_CONFIG_SYS_BOARD
	default "nanopi2"

config UBOOT_CONFIG_SYS_VENDOR
	default "friendlyarm"

config UBOOT_CONFIG_SYS_CONFIG_NAME
	default "s5p4418_nanopi2"

endif
```

## maxlinear/feed_uboot/open_uboot/config/board/gardena/smart-gateway-at91sam/Kconfig
```kconfig
if UBOOT_CONFIG_TARGET_GARDENA_SMART_GATEWAY_AT91SAM

config UBOOT_CONFIG_SYS_BOARD
	default "smart-gateway-at91sam"

config UBOOT_CONFIG_SYS_VENDOR
	default "gardena"

config UBOOT_CONFIG_SYS_CONFIG_NAME
	default "gardena-smart-gateway-at91sam"

endif
```

## maxlinear/feed_uboot/open_uboot/config/board/gardena/smart-gateway-mt7688/Kconfig
```kconfig
if UBOOT_CONFIG_BOARD_GARDENA_SMART_GATEWAY_MT7688

config UBOOT_CONFIG_SYS_BOARD
	default "smart-gateway-mt7688"

config UBOOT_CONFIG_SYS_VENDOR
	default "gardena"

config UBOOT_CONFIG_SYS_CONFIG_NAME
	default "gardena-smart-gateway-mt7688"

endif
```

## maxlinear/feed_uboot/open_uboot/config/board/geekbuying/geekbox/Kconfig
```kconfig
if UBOOT_CONFIG_TARGET_GEEKBOX

config UBOOT_CONFIG_SYS_BOARD
	default "geekbox"

config UBOOT_CONFIG_SYS_VENDOR
	default "geekbuying"

config UBOOT_CONFIG_SYS_CONFIG_NAME
	default "geekbox"

config UBOOT_CONFIG_BOARD_SPECIFIC_OPTIONS # dummy
	def_bool y

endif
```

## maxlinear/feed_uboot/open_uboot/config/board/google/chromebook_coral/Kconfig
```kconfig
if UBOOT_CONFIG_TARGET_CHROMEBOOK_CORAL

config UBOOT_CONFIG_SYS_BOARD
	default "chromebook_coral"

config UBOOT_CONFIG_SYS_VENDOR
	default "google"

config UBOOT_CONFIG_SYS_SOC
	default "apollolake"

config UBOOT_CONFIG_SYS_CONFIG_NAME
	default "chromebook_coral"

config UBOOT_CONFIG_SYS_TEXT_BASE
	default 0xffe00000

config UBOOT_CONFIG_BOARD_SPECIFIC_OPTIONS # dummy
	def_bool y
	select UBOOT_CONFIG_X86_RESET_VECTOR
	select UBOOT_CONFIG_USE_EARLY_BOARD_INIT
	select UBOOT_CONFIG_INTEL_APOLLOLAKE
	select UBOOT_CONFIG_BOARD_ROMSIZE_KB_16384

config UBOOT_CONFIG_PCIE_ECAM_BASE
	default 0xe0000000

config UBOOT_CONFIG_EARLY_POST_CROS_EC
	bool "Enable early post to Chrome OS EC"
	help
	  Allow post codes to be sent to the Chroem OS EC early during boot,
	  to enable monitoring of the boot and debugging when things go wrong.
	  With this option enabled, the EC console can be used to watch post
	  codes the first part of boot.

config UBOOT_CONFIG_SYS_CAR_ADDR
	hex
	default 0xfef00000

config UBOOT_CONFIG_SYS_CAR_SIZE
	hex
	default 0xc0000

endif
```

## maxlinear/feed_uboot/open_uboot/config/board/google/chromebox_panther/Kconfig
```kconfig
if UBOOT_CONFIG_TARGET_CHROMEBOX_PANTHER

config UBOOT_CONFIG_SYS_BOARD
	default "chromebox_panther"

config UBOOT_CONFIG_SYS_VENDOR
	default "google"

config UBOOT_CONFIG_SYS_SOC
	default "ivybridge"

config UBOOT_CONFIG_SYS_CONFIG_NAME
	default "chromebox_panther"

config UBOOT_CONFIG_SYS_TEXT_BASE
	default 0xfff00000

# Panther actually uses haswell, not ivybridge, so this is just a placeholder
config UBOOT_CONFIG_BOARD_SPECIFIC_OPTIONS # dummy
	def_bool y
	select UBOOT_CONFIG_X86_RESET_VECTOR
	select UBOOT_CONFIG_NORTHBRIDGE_INTEL_IVYBRIDGE
	select UBOOT_CONFIG_HAVE_INTEL_ME
	select UBOOT_CONFIG_BOARD_ROMSIZE_KB_8192
	select UBOOT_CONFIG_SPI_FLASH_WINBOND

config UBOOT_CONFIG_SYS_CAR_ADDR
	hex
	default 0xff7e0000

config UBOOT_CONFIG_SYS_CAR_SIZE
	hex
	default 0x20000

endif
```

## maxlinear/feed_uboot/open_uboot/config/board/google/imx8mq_phanbell/Kconfig
```kconfig
if UBOOT_CONFIG_TARGET_IMX8MQ_PHANBELL

config UBOOT_CONFIG_SYS_BOARD
	default "imx8mq_phanbell"

config UBOOT_CONFIG_SYS_VENDOR
	default "google"

config UBOOT_CONFIG_SYS_CONFIG_NAME
	default "imx8mq_phanbell"

config UBOOT_CONFIG_IMX_CONFIG
	default "arch/arm/mach-imx/imx8m/imximage.cfg"

endif
```
