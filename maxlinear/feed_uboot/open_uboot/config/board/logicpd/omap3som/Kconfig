## maxlinear/feed_uboot/open_uboot/config/board/logicpd/omap3som/Kconfig
```kconfig
if UBOOT_CONFIG_TARGET_OMAP3_LOGIC

config UBOOT_CONFIG_SYS_BOARD
	default "omap3som"

config UBOOT_CONFIG_SYS_VENDOR
	default "logicpd"

config UBOOT_CONFIG_SYS_CONFIG_NAME
	default "omap3_logic"

source "../../../board/ti/common/Kconfig"

endif
```

## maxlinear/feed_uboot/open_uboot/config/board/menlo/m53menlo/Kconfig
```kconfig
if UBOOT_CONFIG_TARGET_M53MENLO

config UBOOT_CONFIG_SYS_BOARD
	default "m53menlo"

config UBOOT_CONFIG_SYS_VENDOR
	default "menlo"

config UBOOT_CONFIG_SYS_SOC
	default "mx5"

config UBOOT_CONFIG_SYS_CONFIG_NAME
	default "m53menlo"

config UBOOT_CONFIG_IMX_CONFIG
	default "board/menlo/m53menlo/imximage.cfg"

endif
```

## maxlinear/feed_uboot/open_uboot/config/board/microchip/mpfs_icicle/Kconfig
```kconfig
if UBOOT_CONFIG_TARGET_MICROCHIP_ICICLE

config UBOOT_CONFIG_SYS_BOARD
	default "mpfs_icicle"

config UBOOT_CONFIG_SYS_VENDOR
	default "microchip"

config UBOOT_CONFIG_SYS_CPU
	default "generic"

config UBOOT_CONFIG_SYS_CONFIG_NAME
	default "microchip_mpfs_icicle"

config UBOOT_CONFIG_SYS_TEXT_BASE
	default 0x80000000 if ! UBOOT_CONFIG_RISCV_SMODE
	default 0x80200000 if UBOOT_CONFIG_RISCV_SMODE

config UBOOT_CONFIG_BOARD_SPECIFIC_OPTIONS # dummy
	def_bool y
	select UBOOT_CONFIG_GENERIC_RISCV
	select UBOOT_CONFIG_BOARD_EARLY_INIT_F
	select UBOOT_CONFIG_BOARD_LATE_INIT
	imply SMP
	imply CLK_CCF
	imply CLK_MPFS
	imply SYS_NS16550
	imply CMD_DHCP
	imply CMD_EXT2
	imply CMD_EXT4
	imply CMD_FAT
	imply CMD_FS_GENERIC
	imply CMD_NET
	imply CMD_PING
	imply CMD_MMC
	imply DOS_PARTITION
	imply EFI_PARTITION
	imply IP_DYN
	imply ISO_PARTITION
	imply MACB
	imply MII
	imply PHY_LIB
	imply PHY_VITESSE
	imply MMC
	imply MMC_WRITE
	imply MMC_SDHCI
	imply MMC_SDHCI_CADENCE
	imply MMC_SDHCI_ADMA
	imply MMC_HS200_SUPPORT
	imply CMD_I2C
	imply DM_I2C
	imply SYS_I2C_MICROCHIP

endif
```

## maxlinear/feed_uboot/open_uboot/config/board/microchip/pic32mzda/Kconfig
```kconfig
if UBOOT_CONFIG_TARGET_PIC32MZDASK

config UBOOT_CONFIG_SYS_BOARD
	default "pic32mzda"

config UBOOT_CONFIG_SYS_VENDOR
	default "microchip"

config UBOOT_CONFIG_SYS_CONFIG_NAME
	default "pic32mzdask"

config UBOOT_CONFIG_SYS_TEXT_BASE
	default 0x9d004000

endif
```

## maxlinear/feed_uboot/open_uboot/config/board/mqmaker/miqi_rk3288/Kconfig
```kconfig
if UBOOT_CONFIG_TARGET_MIQI_RK3288

config UBOOT_CONFIG_SYS_BOARD
	default "miqi_rk3288"

config UBOOT_CONFIG_SYS_VENDOR
	default "mqmaker"

config UBOOT_CONFIG_SYS_CONFIG_NAME
	default "miqi_rk3288"

config UBOOT_CONFIG_BOARD_SPECIFIC_OPTIONS # dummy
	def_bool y

endif
```

## maxlinear/feed_uboot/open_uboot/config/board/mscc/luton/Kconfig
```kconfig
# SPDX-License-Identifier: (GPL-2.0+ OR MIT)

if UBOOT_CONFIG_SOC_LUTON

config UBOOT_CONFIG_SYS_VENDOR
	default "mscc"

config UBOOT_CONFIG_SYS_BOARD
	default "luton"

config UBOOT_CONFIG_SYS_CONFIG_NAME
	default "luton"

endif
```

## maxlinear/feed_uboot/open_uboot/config/board/mscc/serval/Kconfig
```kconfig
# SPDX-License-Identifier: (GPL-2.0+ OR MIT)

config UBOOT_CONFIG_SYS_VENDOR
	default "mscc"

if UBOOT_CONFIG_SOC_SERVAL

config UBOOT_CONFIG_SYS_BOARD
	default "serval"

config UBOOT_CONFIG_SYS_CONFIG_NAME
	default "serval"

endif
```

## maxlinear/feed_uboot/open_uboot/config/board/netgear/dgnd3700v2/Kconfig
```kconfig
if UBOOT_CONFIG_BOARD_NETGEAR_DGND3700V2

config UBOOT_CONFIG_SYS_BOARD
	default "dgnd3700v2"

config UBOOT_CONFIG_SYS_VENDOR
	default "netgear"

config UBOOT_CONFIG_SYS_CONFIG_NAME
	default "netgear_dgnd3700v2"

endif
```

## maxlinear/feed_uboot/open_uboot/config/board/nvidia/harmony/Kconfig
```kconfig
if UBOOT_CONFIG_TARGET_HARMONY

config UBOOT_CONFIG_SYS_BOARD
	default "harmony"

config UBOOT_CONFIG_SYS_VENDOR
	default "nvidia"

config UBOOT_CONFIG_SYS_CONFIG_NAME
	default "harmony"

endif
```

## maxlinear/feed_uboot/open_uboot/config/board/nvidia/nyan-big/Kconfig
```kconfig
if UBOOT_CONFIG_TARGET_NYAN_BIG

config UBOOT_CONFIG_SYS_BOARD
	default "nyan-big"

config UBOOT_CONFIG_SYS_VENDOR
	default "nvidia"

config UBOOT_CONFIG_SYS_CONFIG_NAME
	default "nyan-big"

endif
```

## maxlinear/feed_uboot/open_uboot/config/board/nvidia/p2771-0000/Kconfig
```kconfig
# Copyright (c) 2016, NVIDIA CORPORATION.
#
# SPDX-License-Identifier: GPL-2.0

if UBOOT_CONFIG_TARGET_P2771_0000

config UBOOT_CONFIG_SYS_BOARD
	default "p2771-0000"

config UBOOT_CONFIG_SYS_VENDOR
	default "nvidia"

config UBOOT_CONFIG_SYS_CONFIG_NAME
	default "p2771-0000"

endif
```

## maxlinear/feed_uboot/open_uboot/config/board/nvidia/p3450-0000/Kconfig
```kconfig
if UBOOT_CONFIG_TARGET_P3450_0000

config UBOOT_CONFIG_SYS_BOARD
	default "p3450-0000"

config UBOOT_CONFIG_SYS_VENDOR
	default "nvidia"

config UBOOT_CONFIG_SYS_CONFIG_NAME
	default "p3450-0000"

endif
```

## maxlinear/feed_uboot/open_uboot/config/board/nvidia/seaboard/Kconfig
```kconfig
if UBOOT_CONFIG_TARGET_SEABOARD

config UBOOT_CONFIG_SYS_BOARD
	default "seaboard"

config UBOOT_CONFIG_SYS_VENDOR
	default "nvidia"

config UBOOT_CONFIG_SYS_CONFIG_NAME
	default "seaboard"

endif
```

## maxlinear/feed_uboot/open_uboot/config/board/nvidia/venice2/Kconfig
```kconfig
if UBOOT_CONFIG_TARGET_VENICE2

config UBOOT_CONFIG_SYS_BOARD
	default "venice2"

config UBOOT_CONFIG_SYS_VENDOR
	default "nvidia"

config UBOOT_CONFIG_SYS_CONFIG_NAME
	default "venice2"

endif
```

## maxlinear/feed_uboot/open_uboot/config/board/nvidia/ventana/Kconfig
```kconfig
if UBOOT_CONFIG_TARGET_VENTANA

config UBOOT_CONFIG_SYS_BOARD
	default "ventana"

config UBOOT_CONFIG_SYS_VENDOR
	default "nvidia"

config UBOOT_CONFIG_SYS_CONFIG_NAME
	default "ventana"

endif
```

## maxlinear/feed_uboot/open_uboot/config/board/olimex/mx23_olinuxino/Kconfig
```kconfig
if UBOOT_CONFIG_TARGET_MX23_OLINUXINO

config UBOOT_CONFIG_SYS_BOARD
	default "mx23_olinuxino"

config UBOOT_CONFIG_SYS_VENDOR
	default "olimex"

config UBOOT_CONFIG_SYS_SOC
	default "mxs"

config UBOOT_CONFIG_SYS_CONFIG_NAME
	default "mx23_olinuxino"

endif
```

## maxlinear/feed_uboot/open_uboot/config/board/openpiton/riscv64/Kconfig
```kconfig
if UBOOT_CONFIG_TARGET_OPENPITON_RISCV64

config UBOOT_CONFIG_SYS_BOARD
	default "riscv64"

config UBOOT_CONFIG_SYS_VENDOR
	default "openpiton"

config UBOOT_CONFIG_SYS_CPU
	default "generic"

config UBOOT_CONFIG_SYS_CONFIG_NAME
	default "openpiton-riscv64"

config UBOOT_CONFIG_SYS_TEXT_BASE
	default 0x81000000 if UBOOT_CONFIG_SPL
	default 0x80000000 if ! UBOOT_CONFIG_RISCV_SMODE
	default 0x81000000 if UBOOT_CONFIG_RISCV_SMODE

config UBOOT_CONFIG_SPL_TEXT_BASE
	default 0x82000000

config UBOOT_CONFIG_SPL_OPENSBI_LOAD_ADDR
	default 0x80000000

config UBOOT_CONFIG_BOARD_SPECIFIC_OPTIONS # dummy
	def_bool y
	select UBOOT_CONFIG_ARCH_EARLY_INIT_R
	select UBOOT_CONFIG_SUPPORT_SPL
	imply CPU_RISCV
	imply RISCV_TIMER
	imply SPL_SIFIVE_CLINT
	imply CMD_CPU
	imply SPL_CPU_SUPPORT
	imply SPL_SMP
	imply SPL_MMC
	imply SMP
	imply SPL_RISCV_MMODE

endif
```

## maxlinear/feed_uboot/open_uboot/config/board/phytec/phycore_imx8mm/Kconfig
```kconfig
if UBOOT_CONFIG_TARGET_PHYCORE_IMX8MM

config UBOOT_CONFIG_SYS_BOARD
	default "phycore_imx8mm"

config UBOOT_CONFIG_SYS_VENDOR
	default "phytec"

config UBOOT_CONFIG_SYS_CONFIG_NAME
	default "phycore_imx8mm"

config UBOOT_CONFIG_IMX_CONFIG
	default "board/phytec/phycore_imx8mm/imximage-8mm-sd.cfg"

endif
```

## maxlinear/feed_uboot/open_uboot/config/board/phytec/phycore_imx8mp/Kconfig
```kconfig
if UBOOT_CONFIG_TARGET_PHYCORE_IMX8MP

config UBOOT_CONFIG_SYS_BOARD
	default "phycore_imx8mp"

config UBOOT_CONFIG_SYS_VENDOR
	default "phytec"

config UBOOT_CONFIG_SYS_CONFIG_NAME
	default "phycore_imx8mp"

config UBOOT_CONFIG_IMX_CONFIG
	default "board/phytec/phycore_imx8mp/imximage-8mp-sd.cfg"

endif
```

## maxlinear/feed_uboot/open_uboot/config/board/phytec/phycore_rk3288/Kconfig
```kconfig
if UBOOT_CONFIG_TARGET_PHYCORE_RK3288

config UBOOT_CONFIG_SYS_BOARD
	default "phycore_rk3288"

config UBOOT_CONFIG_SYS_VENDOR
	default "phytec"

config UBOOT_CONFIG_SYS_CONFIG_NAME
	default "phycore_rk3288"

config UBOOT_CONFIG_BOARD_SPECIFIC_OPTIONS # dummy
	def_bool y

endif
```

## maxlinear/feed_uboot/open_uboot/config/board/pine64/pinebook-pro-rk3399/Kconfig
```kconfig
if UBOOT_CONFIG_TARGET_PINEBOOK_PRO_RK3399

config UBOOT_CONFIG_SYS_BOARD
	default "pinebook-pro-rk3399"

config UBOOT_CONFIG_SYS_VENDOR
	default "pine64"

config UBOOT_CONFIG_SYS_CONFIG_NAME
	default "pinebook-pro-rk3399"

config UBOOT_CONFIG_BOARD_SPECIFIC_OPTIONS
	def_bool y

endif
```

## maxlinear/feed_uboot/open_uboot/config/board/radxa/rock/Kconfig
```kconfig
if UBOOT_CONFIG_TARGET_ROCK

config UBOOT_CONFIG_SYS_BOARD
	default "rock"

config UBOOT_CONFIG_SYS_VENDOR
	default "radxa"

config UBOOT_CONFIG_SYS_CONFIG_NAME
	default "rock"

config UBOOT_CONFIG_BOARD_SPECIFIC_OPTIONS # dummy
	def_bool y

endif
```

## maxlinear/feed_uboot/open_uboot/config/board/radxa/rock2/Kconfig
```kconfig
if UBOOT_CONFIG_TARGET_ROCK2

config UBOOT_CONFIG_SYS_BOARD
	default "rock2"

config UBOOT_CONFIG_SYS_VENDOR
	default "radxa"

config UBOOT_CONFIG_SYS_CONFIG_NAME
	default "rock2"

config UBOOT_CONFIG_BOARD_SPECIFIC_OPTIONS # dummy
	def_bool y

endif
```

## maxlinear/feed_uboot/open_uboot/config/board/renesas/alt/Kconfig
```kconfig
if UBOOT_CONFIG_TARGET_ALT

config UBOOT_CONFIG_SYS_BOARD
	default "alt"

config UBOOT_CONFIG_SYS_VENDOR
	default "renesas"

config UBOOT_CONFIG_SYS_CONFIG_NAME
	default "alt"

endif
```

## maxlinear/feed_uboot/open_uboot/config/board/renesas/draak/Kconfig
```kconfig
if UBOOT_CONFIG_TARGET_DRAAK

config UBOOT_CONFIG_SYS_SOC
	default "rmobile"

config UBOOT_CONFIG_SYS_BOARD
	default "draak"

config UBOOT_CONFIG_SYS_VENDOR
	default "renesas"

config UBOOT_CONFIG_SYS_CONFIG_NAME
	default "draak"

endif
```
