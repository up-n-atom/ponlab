## maxlinear/feed_uboot/open_uboot/config/board/vocore/vocore2/Kconfig
```kconfig
if UBOOT_CONFIG_BOARD_VOCORE2

config UBOOT_CONFIG_SYS_BOARD
	default "vocore2"

config UBOOT_CONFIG_SYS_VENDOR
	default "vocore"

config UBOOT_CONFIG_SYS_CONFIG_NAME
	default "vocore2"

endif
```

## maxlinear/feed_uboot/open_uboot/config/board/wandboard/Kconfig
```kconfig
if UBOOT_CONFIG_TARGET_WANDBOARD

config UBOOT_CONFIG_SYS_BOARD
	default "wandboard"

config UBOOT_CONFIG_SYS_CONFIG_NAME
	default "wandboard"

endif
```

## maxlinear/feed_uboot/open_uboot/config/board/warp/Kconfig
```kconfig
if UBOOT_CONFIG_TARGET_WARP

config UBOOT_CONFIG_SYS_BOARD
	default "warp"

config UBOOT_CONFIG_SYS_CONFIG_NAME
	default "warp"

config UBOOT_CONFIG_IMX_CONFIG
	default "board/warp/imximage.cfg"

endif
```

## maxlinear/feed_uboot/open_uboot/config/board/work-microwave/work_92105/Kconfig
```kconfig
if UBOOT_CONFIG_TARGET_WORK_92105

config UBOOT_CONFIG_SYS_BOARD
	default "work_92105"

config UBOOT_CONFIG_SYS_VENDOR
	default "work-microwave"

config UBOOT_CONFIG_SYS_CONFIG_NAME
	default "work_92105"

config UBOOT_CONFIG_CMD_HD44760
	bool "Enable 'hd44780' LCD-control command"
	help
	  This controls the LCD driver.

config UBOOT_CONFIG_CMD_MAX6957
	bool "Enable 'max6957aax' PMIC command"
	help
	  DEPRECATED: Needs conversion to driver model.

	  This allows PMIC registers to be read and written.

endif
```

## maxlinear/feed_uboot/open_uboot/config/board/xilinx/versal/Kconfig
```kconfig
# Copyright (c) 2020, Xilinx, Inc.
#
# SPDX-License-Identifier: GPL-2.0

if UBOOT_CONFIG_ARCH_VERSAL

config UBOOT_CONFIG_CMD_VERSAL
	bool "Enable Versal specific commands"
	default y
	depends on UBOOT_CONFIG_ZYNQMP_FIRMWARE
	help
	  Enable Versal specific commands.

endif
```

## maxlinear/feed_uboot/open_uboot/config/cmd/mvebu/Kconfig
```kconfig
menu "MVEBU commands"
depends on UBOOT_CONFIG_ARCH_MVEBU

config UBOOT_CONFIG_CMD_MVEBU_BUBT
	bool "bubt"
	select UBOOT_CONFIG_SHA256 if ARMADA_3700
	help
	  bubt - Burn a u-boot image to flash
	  For details about bubt command please see the documentation
	  in doc/mvebu/cmd/bubt.txt

choice
	prompt "Flash for image"
	default UBOOT_CONFIG_MVEBU_SPI_BOOT

config UBOOT_CONFIG_MVEBU_NAND_BOOT
	bool "NAND flash boot"
	depends on UBOOT_CONFIG_NAND_PXA3XX
	help
	  Enable boot from NAND flash.
	  Allow usage of NAND flash as a target for "bubt" command
	  For details about bubt command please see the documentation
	  in doc/mvebu/cmd/bubt.txt

config UBOOT_CONFIG_MVEBU_SPI_BOOT
	bool "SPI flash boot"
	depends on UBOOT_CONFIG_SPI_FLASH
	help
	  Enable boot from SPI flash.
	  Allow usage of SPI flash as a target for "bubt" command
	  For details about bubt command please see the documentation
	  in doc/mvebu/cmd/bubt.txt

config UBOOT_CONFIG_MVEBU_MMC_BOOT
	bool "eMMC flash boot"
	depends on UBOOT_CONFIG_MVEBU_MMC || UBOOT_CONFIG_MMC_SDHCI_XENON
	help
	  Enable boot from eMMC boot partition
	  Allow usage of eMMC/SD device as a target for "bubt" command
	  For details about bubt command please see the documentation
	  in doc/mvebu/cmd/bubt.txt

endchoice

config UBOOT_CONFIG_MVEBU_UBOOT_DFLT_NAME
	string "Default image name for bubt command"
	default "flash-image.bin"
	help
	  This option should contain a default file name to be used with
	  MVEBU "bubt" command if the source file name is omitted

config UBOOT_CONFIG_CMD_MVEBU_COMPHY_RX_TRAINING
	bool "mvebu_comphy_rx_training"
	depends on UBOOT_CONFIG_ARMADA_8K
	help
	  Perform COMPHY RX training sequence

endmenu
```

## maxlinear/feed_uboot/open_uboot/config/drivers/Kconfig
```kconfig
menu "Device Drivers"

source "core/Kconfig"

# types of drivers sorted in alphabetical order

source "adc/Kconfig"

source "ata/Kconfig"

source "axi/Kconfig"

source "bus/Kconfig"

source "block/Kconfig"

source "bootcount/Kconfig"

source "button/Kconfig"

source "cache/Kconfig"

source "clk/Kconfig"

source "cpu/Kconfig"

source "crypto/Kconfig"

source "ddr/Kconfig"

source "demo/Kconfig"

source "ddr/fsl/Kconfig"

source "dfu/Kconfig"

source "dma/Kconfig"

source "fastboot/Kconfig"

source "firmware/Kconfig"

source "fpga/Kconfig"

source "gpio/Kconfig"

source "hwspinlock/Kconfig"

source "i2c/Kconfig"

source "input/Kconfig"

source "iommu/Kconfig"

source "led/Kconfig"

source "mailbox/Kconfig"

source "memory/Kconfig"

source "misc/Kconfig"

source "mmc/Kconfig"

source "mtd/Kconfig"

source "mux/Kconfig"

source "net/Kconfig"

source "nvme/Kconfig"

source "pci/Kconfig"

source "pci_endpoint/Kconfig"

source "pch/Kconfig"

source "phy/Kconfig"

source "phy/allwinner/Kconfig"

source "phy/marvell/Kconfig"

source "phy/socionext/Kconfig"

source "pinctrl/Kconfig"

source "power/Kconfig"

source "pwm/Kconfig"

source "qe/Kconfig"

source "ram/Kconfig"

source "reboot-mode/Kconfig"

source "remoteproc/Kconfig"

source "reset/Kconfig"

source "rng/Kconfig"

source "rtc/Kconfig"

source "scsi/Kconfig"

source "serial/Kconfig"

source "smem/Kconfig"

source "sound/Kconfig"

source "soc/Kconfig"

source "spi/Kconfig"

source "spmi/Kconfig"

source "sysinfo/Kconfig"

source "sysreset/Kconfig"

source "tee/Kconfig"

source "thermal/Kconfig"

source "timer/Kconfig"

source "tpm/Kconfig"

source "usb/Kconfig"

source "ufs/Kconfig"

source "video/Kconfig"

source "virtio/Kconfig"

source "w1/Kconfig"

source "w1-eeprom/Kconfig"

source "watchdog/Kconfig"

source "xen/Kconfig"

config UBOOT_CONFIG_PHYS_TO_BUS
	bool "Custom physical to bus address mapping"
	help
	  Some SoCs use a different address map for CPU physical addresses and
	  peripheral DMA master accesses. If yours does, select this option in
	  your platform's Kconfig, and implement the appropriate mapping
	  functions in your platform's support code.

endmenu
```

## maxlinear/feed_uboot/open_uboot/config/drivers/ata/Kconfig
```kconfig
config UBOOT_CONFIG_AHCI
	bool "Support SATA controllers with driver model"
	depends on UBOOT_CONFIG_DM
	help
	  This enables a uclass for disk controllers in U-Boot. Various driver
	  types can use this, such as AHCI/SATA. It does not provide any standard
	  operations at present. The block device interface has not been converted
	  to driver model.

config UBOOT_CONFIG_SATA
	bool "Support SATA controllers"
	select UBOOT_CONFIG_HAVE_BLOCK_DEVICE
	help
	  This enables support for SATA (Serial Advanced Technology
	  Attachment), a serial bus standard for connecting to hard drives and
	  other storage devices.

	  SATA replaces PATA (originally just ATA), which stands for Parallel AT
	  Attachment, where AT refers to an IBM AT (Advanced Technology)
	  computer released in 1984.

	  See also CMD_SATA which provides command-line support.

config UBOOT_CONFIG_LIBATA
	bool
	help
	  Select this to build and link the libata helper functions.

config UBOOT_CONFIG_SCSI_AHCI
	bool "Enable SCSI interface to SATA devices"
	select UBOOT_CONFIG_LIBATA
	help
	  Enable this to allow interfacing SATA devices via the SCSI layer.

menu "SATA/SCSI device support"

config UBOOT_CONFIG_AHCI_PCI
	bool "Support for PCI-based AHCI controller"
	depends on UBOOT_CONFIG_PCI
	depends on UBOOT_CONFIG_DM_SCSI
	help
	  Enables support for the PCI-based AHCI controller.

config UBOOT_CONFIG_SPL_AHCI_PCI
	bool "Support for PCI-based AHCI controller for SPL"
	depends on UBOOT_CONFIG_SPL
	depends on UBOOT_CONFIG_SPL_PCI
	depends on UBOOT_CONFIG_SPL_SATA_SUPPORT && UBOOT_CONFIG_DM_SCSI

config UBOOT_CONFIG_SATA_CEVA
	bool "Ceva Sata controller"
	depends on UBOOT_CONFIG_AHCI
	depends on UBOOT_CONFIG_DM_SCSI
	help
	  This option enables Ceva Sata controller hard IP available on Xilinx
	  ZynqMP. Support up to 2 external devices. Complient with SATA 3.1 and
	  AHCI 1.3 specifications with hot-plug detect feature.


config UBOOT_CONFIG_DWC_AHCI
	bool "Enable Synopsys DWC AHCI driver support"
	select UBOOT_CONFIG_SCSI_AHCI
	select UBOOT_CONFIG_PHY
	depends on UBOOT_CONFIG_DM_SCSI
	help
	  Enable this driver to support Sata devices through
	  Synopsys DWC AHCI module.

config UBOOT_CONFIG_DWC_AHSATA
	bool "Enable DWC AHSATA driver support"
	select UBOOT_CONFIG_LIBATA
	depends on UBOOT_CONFIG_BLK
	help
	  Enable this driver to support the DWC AHSATA SATA controller found
	  in i.MX5 and i.MX6 SoCs.

config UBOOT_CONFIG_DWC_AHSATA_AHCI
	bool "Enable DWC AHSATA AHCI driver support"
	depends on UBOOT_CONFIG_DWC_AHSATA
	depends on UBOOT_CONFIG_AHCI
	default y
	help
	  Enable this option unless you need your private ahci implementation

config UBOOT_CONFIG_FSL_SATA
	bool "Enable Freescale SATA controller driver support"
	select UBOOT_CONFIG_AHCI
	select UBOOT_CONFIG_LIBATA
	depends on UBOOT_CONFIG_BLK
	help
	  Enable this driver to support the SATA controller found in
	  some Freescale PowerPC SoCs.

config UBOOT_CONFIG_SATA_MV
	bool "Enable Marvell SATA controller driver support"
	select UBOOT_CONFIG_AHCI
	select UBOOT_CONFIG_LIBATA
	depends on UBOOT_CONFIG_BLK
	help
	  Enable this driver to support the SATA controller found in
	  some Marvell SoCs.

config UBOOT_CONFIG_SATA_SIL
	bool "Enable Silicon Image SIL3131 / SIL3132 / SIL3124 SATA driver support"
	select UBOOT_CONFIG_AHCI
	select UBOOT_CONFIG_LIBATA
	depends on UBOOT_CONFIG_BLK
	help
	  Enable this driver to support the SIL3131, SIL3132 and SIL3124
	  SATA controllers.

config UBOOT_CONFIG_SATA_SIL3114
	bool "Enable Silicon Image SIL3114 SATA driver support"
	select UBOOT_CONFIG_LIBATA
	help
	  Enable this driver to support the SIL3114 SATA controllers.

config UBOOT_CONFIG_SUNXI_AHCI
	bool "Enable Allwinner SATA driver support"
	depends on UBOOT_CONFIG_AHCI
	default y if UBOOT_CONFIG_ARCH_SUNXI
	help
	  Enable this driver to support the SATA controllers found in the
	  Allwinner A10, A20 and R40 SoCs.

config UBOOT_CONFIG_AHCI_MVEBU
	bool "Marvell EBU AHCI SATA support"
	depends on UBOOT_CONFIG_ARCH_MVEBU || UBOOT_CONFIG_ARCH_OCTEON
	depends on UBOOT_CONFIG_AHCI
	select UBOOT_CONFIG_SCSI_AHCI
	select UBOOT_CONFIG_DM_SCSI
	help
	  This option enables support for the Marvell EBU SoC's
	  onboard AHCI SATA.

	  If unsure, say N.

config UBOOT_CONFIG_MTK_AHCI
	bool "Enable Mediatek AHCI driver support"
	depends on UBOOT_CONFIG_AHCI
	help
	  Enable this driver to support Sata devices through
	  Mediatek AHCI controller (e.g. MT7622).

endmenu
```

## maxlinear/feed_uboot/open_uboot/config/drivers/axi/Kconfig
```kconfig
menuconfig UBOOT_CONFIG_AXI
	bool "AXI bus drivers"
	help
	  Support AXI (Advanced eXtensible Interface) busses, a on-chip
	  interconnect specification for managing functional blocks in SoC
	  designs, which is also often used in designs involving FPGAs (e.g.
	  communication with IP cores in Xilinx FPGAs).

	  These types of busses expose a virtual address space that can be
	  accessed using different address widths (8, 16, and 32 are supported
	  for now).

	  Other similar bus architectures may be compatible as well.

if UBOOT_CONFIG_AXI

config UBOOT_CONFIG_IHS_AXI
	bool "Enable IHS AXI driver"
	depends on UBOOT_CONFIG_DM
	help
	  Support for gdsys Integrated Hardware Systems Advanced eXtensible
	  Interface (IHS AXI) bus on a gdsys IHS FPGA used to communicate with
	  IP cores in the FPGA (e.g. video transmitter cores).

config UBOOT_CONFIG_AXI_SANDBOX
	bool "Enable AXI sandbox driver"
	depends on UBOOT_CONFIG_DM
	help
	  Support AXI (Advanced eXtensible Interface) emulation for the sandbox
	  environment.

endif
```

## maxlinear/feed_uboot/open_uboot/config/drivers/bus/Kconfig
```kconfig
# SPDX-License-Identifier: GPL-2.0
#
# Bus Devices
#

menu "Bus devices"

config UBOOT_CONFIG_TI_PWMSS
	bool
	default y if UBOOT_CONFIG_ARCH_OMAP2PLUS && UBOOT_CONFIG_PWM_TI_EHRPWM
	help
	  PWM Subsystem driver support for AM33xx SOC.

config UBOOT_CONFIG_TI_SYSC
	bool "TI sysc interconnect target module driver"
	depends on UBOOT_CONFIG_ARCH_OMAP2PLUS
	help
	  Generic driver for Texas Instruments interconnect target module
	  found on many TI SoCs.

config UBOOT_CONFIG_UNIPHIER_SYSTEM_BUS
	bool "UniPhier System Bus driver"
	depends on UBOOT_CONFIG_ARCH_UNIPHIER
	default y
	help
	  Support for UniPhier System Bus, a simple external bus.  This is
	  needed to use on-board devices connected to UniPhier SoCs.

endmenu
```

## maxlinear/feed_uboot/open_uboot/config/drivers/clk/exynos/Kconfig
```kconfig
config UBOOT_CONFIG_CLK_EXYNOS
	bool
	select UBOOT_CONFIG_CLK
	help
	  This enables support for common clock driver API on Samsung
	  Exynos SoCs.

menu "Clock drivers for Exynos SoCs"
	depends on UBOOT_CONFIG_CLK_EXYNOS

config UBOOT_CONFIG_CLK_EXYNOS7420
	bool "Clock driver for Samsung's Exynos7420 SoC"
	default y
	help
	  This enables common clock driver support for platforms based
	  on Samsung Exynos7420 SoC.

endmenu
```

## maxlinear/feed_uboot/open_uboot/config/drivers/clk/imx/Kconfig
```kconfig
config UBOOT_CONFIG_SPL_CLK_IMX6Q
	bool "SPL clock support for i.MX6Q"
	depends on UBOOT_CONFIG_ARCH_MX6 && UBOOT_CONFIG_SPL
	select UBOOT_CONFIG_SPL_CLK
	select UBOOT_CONFIG_SPL_CLK_CCF
	help
	  This enables SPL DM/DTS support for clock driver in i.MX6Q platforms.

config UBOOT_CONFIG_CLK_IMX6Q
	bool "Clock support for i.MX6Q"
	depends on UBOOT_CONFIG_ARCH_MX6
	select UBOOT_CONFIG_CLK
	select UBOOT_CONFIG_CLK_CCF
	help
	  This enables DM/DTS support for clock driver in i.MX6Q platforms.

config UBOOT_CONFIG_CLK_IMX8
	bool "Clock support for i.MX8"
	depends on UBOOT_CONFIG_ARCH_IMX8
	select UBOOT_CONFIG_CLK
	help
	  This enables support clock driver for i.MX8 platforms.

config UBOOT_CONFIG_SPL_CLK_IMX8MM
	bool "SPL clock support for i.MX8MM"
	depends on UBOOT_CONFIG_ARCH_IMX8M && UBOOT_CONFIG_SPL
	select UBOOT_CONFIG_SPL_CLK
	select UBOOT_CONFIG_SPL_CLK_CCF
	help
	  This enables SPL DM/DTS support for clock driver in i.MX8MM

config UBOOT_CONFIG_CLK_IMX8MM
	bool "Clock support for i.MX8MM"
	depends on UBOOT_CONFIG_ARCH_IMX8M
	select UBOOT_CONFIG_CLK
	select UBOOT_CONFIG_CLK_CCF
	help
	  This enables support clock driver for i.MX8MM platforms.

config UBOOT_CONFIG_SPL_CLK_IMX8MN
	bool "SPL clock support for i.MX8MN"
	depends on UBOOT_CONFIG_ARCH_IMX8M && UBOOT_CONFIG_SPL
	select UBOOT_CONFIG_SPL_CLK
	select UBOOT_CONFIG_SPL_CLK_CCF
	help
	  This enables SPL DM/DTS support for clock driver in i.MX8MN

config UBOOT_CONFIG_CLK_IMX8MN
	bool "Clock support for i.MX8MN"
	depends on UBOOT_CONFIG_ARCH_IMX8M
	select UBOOT_CONFIG_CLK
	select UBOOT_CONFIG_CLK_CCF
	help
	  This enables support clock driver for i.MX8MN platforms.

config UBOOT_CONFIG_SPL_CLK_IMX8MP
	bool "SPL clock support for i.MX8MP"
	depends on UBOOT_CONFIG_ARCH_IMX8M && UBOOT_CONFIG_SPL
	select UBOOT_CONFIG_SPL_CLK
	select UBOOT_CONFIG_SPL_CLK_CCF
	help
	  This enables SPL DM/DTS support for clock driver in i.MX8MP

config UBOOT_CONFIG_CLK_IMX8MP
	bool "Clock support for i.MX8MP"
	depends on UBOOT_CONFIG_ARCH_IMX8M
	select UBOOT_CONFIG_CLK
	select UBOOT_CONFIG_CLK_CCF
	help
	  This enables support clock driver for i.MX8MP platforms.

config UBOOT_CONFIG_SPL_CLK_IMXRT1020
	bool "SPL clock support for i.MXRT1020"
	depends on UBOOT_CONFIG_ARCH_IMXRT && UBOOT_CONFIG_SPL
	select UBOOT_CONFIG_SPL_CLK
	select UBOOT_CONFIG_SPL_CLK_CCF
	help
	  This enables SPL DM/DTS support for clock driver in i.MXRT1020

config UBOOT_CONFIG_CLK_IMXRT1020
	bool "Clock support for i.MXRT1020"
	depends on UBOOT_CONFIG_ARCH_IMXRT
	select UBOOT_CONFIG_CLK
	select UBOOT_CONFIG_CLK_CCF
	help
	  This enables support clock driver for i.MXRT1020 platforms.

config UBOOT_CONFIG_SPL_CLK_IMXRT1050
	bool "SPL clock support for i.MXRT1050"
	depends on UBOOT_CONFIG_ARCH_IMXRT && UBOOT_CONFIG_SPL
	select UBOOT_CONFIG_SPL_CLK
	select UBOOT_CONFIG_SPL_CLK_CCF
	help
	  This enables SPL DM/DTS support for clock driver in i.MXRT1050

config UBOOT_CONFIG_CLK_IMXRT1050
	bool "Clock support for i.MXRT1050"
	depends on UBOOT_CONFIG_ARCH_IMXRT
	select UBOOT_CONFIG_CLK
	select UBOOT_CONFIG_CLK_CCF
	help
	  This enables support clock driver for i.MXRT1050 platforms.
```
