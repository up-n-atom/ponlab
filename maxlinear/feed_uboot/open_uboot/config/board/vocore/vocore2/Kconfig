## maxlinear/feed_uboot/open_uboot/config/drivers/clk/microchip/Kconfig
```kconfig
config UBOOT_CONFIG_CLK_MPFS
	bool "Clock support for Microchip PolarFire SoC"
	depends on UBOOT_CONFIG_CLK && UBOOT_CONFIG_CLK_CCF
	help
	  This enables support clock driver for Microchip PolarFire SoC platform.
```

## maxlinear/feed_uboot/open_uboot/config/drivers/clk/owl/Kconfig
```kconfig
config UBOOT_CONFIG_CLK_OWL
        bool "Actions Semi OWL clock drivers"
        depends on UBOOT_CONFIG_CLK && UBOOT_CONFIG_ARCH_OWL
        help
          Enable support for clock managemet unit present in Actions Semi
	  Owl series S900/S700 SoCs.
```

## maxlinear/feed_uboot/open_uboot/config/drivers/clk/sifive/Kconfig
```kconfig
# SPDX-License-Identifier: GPL-2.0

config UBOOT_CONFIG_CLK_SIFIVE
	bool "SiFive SoC driver support"
	depends on UBOOT_CONFIG_CLK
	help
	  SoC drivers for SiFive Linux-capable SoCs.

config UBOOT_CONFIG_CLK_SIFIVE_PRCI
	bool "PRCI driver for SiFive SoCs"
	depends on UBOOT_CONFIG_CLK_SIFIVE
	select UBOOT_CONFIG_CLK_ANALOGBITS_WRPLL_CLN28HPC
	help
	  Supports the Power Reset Clock interface (PRCI) IP block found in
	  FU540/FU740 SoCs. If this kernel is meant to run on a SiFive FU540/
	  FU740 SoCs, enable this driver.
```

## maxlinear/feed_uboot/open_uboot/config/drivers/clk/sunxi/Kconfig
```kconfig
config UBOOT_CONFIG_CLK_SUNXI
	bool "Clock support for Allwinner SoCs"
	depends on UBOOT_CONFIG_CLK && UBOOT_CONFIG_ARCH_SUNXI
	select UBOOT_CONFIG_DM_RESET
	select UBOOT_CONFIG_SPL_DM_RESET if SPL_CLK
	default y
	help
	  This enables support for common clock driver API on Allwinner
	  SoCs.

if UBOOT_CONFIG_CLK_SUNXI

config UBOOT_CONFIG_CLK_SUN4I_A10
	bool "Clock driver for Allwinner A10/A20"
	default UBOOT_CONFIG_MACH_SUN4I || UBOOT_CONFIG_MACH_SUN7I
	help
	  This enables common clock driver support for platforms based
	  on Allwinner A10/A20 SoC.

config UBOOT_CONFIG_CLK_SUN5I_A10S
	bool "Clock driver for Allwinner A10s/A13"
	default UBOOT_CONFIG_MACH_SUN5I
	help
	  This enables common clock driver support for platforms based
	  on Allwinner A10s/A13 SoC.

config UBOOT_CONFIG_CLK_SUN6I_A31
	bool "Clock driver for Allwinner A31/A31s"
	default UBOOT_CONFIG_MACH_SUN6I
	help
	  This enables common clock driver support for platforms based
	  on Allwinner A31/A31s SoC.

config UBOOT_CONFIG_CLK_SUN6I_A31_R
	bool "Clock driver for Allwinner A31 generation PRCM"
	default UBOOT_CONFIG_SUNXI_GEN_SUN6I
	help
	  This enables common clock driver support for the PRCM
	  in Allwinner A31/A31s/A23/A33/A83T/H3/A64/H5 SoCs.

config UBOOT_CONFIG_CLK_SUN8I_A23
	bool "Clock driver for Allwinner A23/A33"
	default UBOOT_CONFIG_MACH_SUN8I_A23 || UBOOT_CONFIG_MACH_SUN8I_A33
	help
	  This enables common clock driver support for platforms based
	  on Allwinner A23/A33 SoC.

config UBOOT_CONFIG_CLK_SUN8I_A83T
	bool "Clock driver for Allwinner A83T"
	default UBOOT_CONFIG_MACH_SUN8I_A83T
	help
	  This enables common clock driver support for platforms based
	  on Allwinner A83T SoC.

config UBOOT_CONFIG_CLK_SUN8I_R40
	bool "Clock driver for Allwinner R40"
	default UBOOT_CONFIG_MACH_SUN8I_R40
	help
	  This enables common clock driver support for platforms based
	  on Allwinner R40 SoC.

config UBOOT_CONFIG_CLK_SUN8I_V3S
	bool "Clock driver for Allwinner V3S"
	default UBOOT_CONFIG_MACH_SUN8I_V3S
	help
	  This enables common clock driver support for platforms based
	  on Allwinner V3S SoC.

config UBOOT_CONFIG_CLK_SUN9I_A80
	bool "Clock driver for Allwinner A80"
	default UBOOT_CONFIG_MACH_SUN9I
	help
	  This enables common clock driver support for platforms based
	  on Allwinner A80 SoC.

config UBOOT_CONFIG_CLK_SUN8I_H3
	bool "Clock driver for Allwinner H3/H5"
	default UBOOT_CONFIG_MACH_SUNXI_H3_H5
	help
	  This enables common clock driver support for platforms based
	  on Allwinner H3/H5 SoC.

config UBOOT_CONFIG_CLK_SUN50I_H6
	bool "Clock driver for Allwinner H6"
	default UBOOT_CONFIG_MACH_SUN50I_H6
	help
	  This enables common clock driver support for platforms based
	  on Allwinner H6 SoC.

config UBOOT_CONFIG_CLK_SUN50I_H6_R
	bool "Clock driver for Allwinner H6 generation PRCM"
	default UBOOT_CONFIG_SUN50I_GEN_H6
	help
	  This enables common clock driver support for the PRCM
	  in Allwinner H6/H616 SoCs.

config UBOOT_CONFIG_CLK_SUN50I_H616
	bool "Clock driver for Allwinner H616"
	default UBOOT_CONFIG_MACH_SUN50I_H616
	help
	  This enables common clock driver support for platforms based
	  on Allwinner H616 SoC.

config UBOOT_CONFIG_CLK_SUN50I_A64
	bool "Clock driver for Allwinner A64"
	default UBOOT_CONFIG_MACH_SUN50I
	help
	  This enables common clock driver support for platforms based
	  on Allwinner A64 SoC.

endif # CLK_SUNXI
```

## maxlinear/feed_uboot/open_uboot/config/drivers/cpu/Kconfig
```kconfig
config UBOOT_CONFIG_CPU
	bool "Enable CPU drivers using Driver Model"
	help
	  This allows drivers to be provided for CPUs and their type to be
	  specified in the board's device tree. For boards which support
	  multiple CPUs, then normally have to be set up in U-Boot so that
	  they can work correctly in the OS. This provides a framework for
	  finding out information about available CPUs and making changes.

config UBOOT_CONFIG_CPU_MPC83XX
	bool "Enable MPC83xx CPU driver"
	depends on UBOOT_CONFIG_CPU
	select UBOOT_CONFIG_CLK_MPC83XX
	help
	  Support CPU cores for SoCs of the MPC83xx series.

config UBOOT_CONFIG_CPU_RISCV
	bool "Enable RISC-V CPU driver"
	depends on UBOOT_CONFIG_CPU && UBOOT_CONFIG_RISCV
	help
	  Support CPU cores for RISC-V architecture.
```

## maxlinear/feed_uboot/open_uboot/config/drivers/crypto/Kconfig
```kconfig
menu "Hardware crypto devices"

source "hash/Kconfig"

source "fsl/Kconfig"

endmenu
```

## maxlinear/feed_uboot/open_uboot/config/drivers/crypto/fsl/Kconfig
```kconfig
config UBOOT_CONFIG_FSL_CAAM
	bool "Freescale Crypto Driver Support"
	select UBOOT_CONFIG_SHA_HW_ACCEL
	# hw_sha1() under drivers/crypto, and needed with SHA_HW_ACCEL
	imply SPL_CRYPTO if (ARM && UBOOT_CONFIG_SPL)
	imply CMD_HASH
	help
	  Enables the Freescale's Cryptographic Accelerator and Assurance
	  Module (CAAM), also known as the SEC version 4 (SEC4). The driver uses
	  Job Ring as interface to communicate with CAAM.

config UBOOT_CONFIG_CAAM_64BIT
	bool
	default y if UBOOT_CONFIG_PHYS_64BIT && !UBOOT_CONFIG_ARCH_IMX8M
	help
	  Select Crypto driver for 64 bits CAAM version

config UBOOT_CONFIG_SYS_FSL_HAS_SEC
	bool
	help
		Enable Freescale Secure Boot and Trusted Architecture

config UBOOT_CONFIG_SYS_FSL_SEC_COMPAT_2
	bool
	help
		Secure boot and trust architecture compatible version 2

config UBOOT_CONFIG_SYS_FSL_SEC_COMPAT_4
	bool
	help
		Secure boot and trust architecture compatible version 4

config UBOOT_CONFIG_SYS_FSL_SEC_COMPAT_5
	bool
	help
		Secure boot and trust architecture compatible version 5

config UBOOT_CONFIG_SYS_FSL_SEC_COMPAT_6
	bool
	help
		Secure boot and trust architecture compatible version 6

config UBOOT_CONFIG_SYS_FSL_SEC_BE
	bool "Big-endian access to Freescale Secure Boot"

config UBOOT_CONFIG_SYS_FSL_SEC_COMPAT
	int "Freescale Secure Boot compatibility"
	depends on UBOOT_CONFIG_SYS_FSL_HAS_SEC
	default 2 if UBOOT_CONFIG_SYS_FSL_SEC_COMPAT_2
	default 4 if UBOOT_CONFIG_SYS_FSL_SEC_COMPAT_4
	default 5 if UBOOT_CONFIG_SYS_FSL_SEC_COMPAT_5
	default 6 if UBOOT_CONFIG_SYS_FSL_SEC_COMPAT_6

config UBOOT_CONFIG_SYS_FSL_SEC_LE
	bool "Little-endian access to Freescale Secure Boot"

if UBOOT_CONFIG_FSL_CAAM

config UBOOT_CONFIG_FSL_CAAM_RNG
	bool "Enable Random Number Generator support"
	depends on UBOOT_CONFIG_DM_RNG
	default y
	help
	  Enable support for the hardware based random number generator
	  module of the CAAM. The random data is fetched from the DRGB
	  using the prediction resistance flag which means the DRGB is
	  reseeded from the TRNG every time random data is generated.

endif
```

## maxlinear/feed_uboot/open_uboot/config/drivers/crypto/rsa_mod_exp/Kconfig
```kconfig
config UBOOT_CONFIG_DM_MOD_EXP
	bool "Enable Driver Model for RSA Modular Exponentiation"
	depends on UBOOT_CONFIG_DM
	help
	  If you want to use driver model for RSA Modular Exponentiation, say Y.
```

## maxlinear/feed_uboot/open_uboot/config/drivers/ddr/Kconfig
```kconfig
choice
	prompt "Method to determine DDR clock frequency"
	default UBOOT_CONFIG_STATIC_DDR_CLK_FREQ
	depends on UBOOT_CONFIG_ARCH_P1010 || UBOOT_CONFIG_ARCH_P1020 || UBOOT_CONFIG_ARCH_P2020 || UBOOT_CONFIG_ARCH_T1024 \
		|| ARCH_T1042 || UBOOT_CONFIG_ARCH_T2080 || UBOOT_CONFIG_ARCH_T4240 || UBOOT_CONFIG_ARCH_LS1021A \
		|| FSL_LSCH2 || UBOOT_CONFIG_FSL_LSCH3 || UBOOT_CONFIG_TARGET_KMCENT2
	help
	  The DDR clock frequency can either be defined statically now at
	  build time, or can be determined at run-time via the
	  get_board_ddr_clk function.

config UBOOT_CONFIG_DYNAMIC_DDR_CLK_FREQ
	bool "Run-time DDR clock frequency"

config UBOOT_CONFIG_STATIC_DDR_CLK_FREQ
	bool "Build-time static DDR clock frequency"

endchoice

config UBOOT_CONFIG_DDR_CLK_FREQ
	int "DDR clock frequency in Hz"
	depends on UBOOT_CONFIG_STATIC_DDR_CLK_FREQ
	default 100000000
	help
	  The DDR clock frequency, specified in Hz.

config UBOOT_CONFIG_DDR_SPD
	bool "JEDEC Serial Presence Detect (SPD) support"
	help
	  For memory controllers that can utilize it, add enable support for
	  using the JEDEC SDP standard.

source "altera/Kconfig"
source "imx/Kconfig"
```

## maxlinear/feed_uboot/open_uboot/config/drivers/ddr/fsl/Kconfig
```kconfig
config UBOOT_CONFIG_SYS_FSL_DDR
	bool
	help
	  Select Freescale General DDR driver, shared between most Freescale
	  PowerPC- based SoCs (such as mpc83xx, mpc85xx and ARM- based
	  Layerscape SoCs (such as ls2080a).

config UBOOT_CONFIG_SYS_FSL_MMDC
	bool
	help
	  Select Freescale Multi Mode DDR controller (MMDC).

if UBOOT_CONFIG_SYS_FSL_DDR || UBOOT_CONFIG_SYS_FSL_MMDC

config UBOOT_CONFIG_SYS_FSL_DDR_BE
	bool
	help
		Access DDR registers in big-endian

config UBOOT_CONFIG_SYS_FSL_DDR_LE
	bool
	help
		Access DDR registers in little-endian

config UBOOT_CONFIG_FSL_DDR_BIST
	bool

config UBOOT_CONFIG_FSL_DDR_INTERACTIVE
	bool

config UBOOT_CONFIG_FSL_DDR_SYNC_REFRESH
	bool

config UBOOT_CONFIG_FSL_DDR_FIRST_SLOT_QUAD_CAPABLE
	bool

menu "Freescale DDR controllers"
	depends on UBOOT_CONFIG_SYS_FSL_DDR

config UBOOT_CONFIG_SYS_NUM_DDR_CTLRS
	int "Maximum DDR controllers"
	default 3 if UBOOT_CONFIG_ARCH_LS2080A	|| \
			ARCH_T4240
	default 2 if UBOOT_CONFIG_ARCH_B4860	|| \
			ARCH_BSC9132	|| \
			ARCH_P4080	|| \
			ARCH_P5040	|| \
			ARCH_LX2160A	|| \
			ARCH_LX2162A
	default 1

config UBOOT_CONFIG_SYS_FSL_DDR_VER
	int
	default 50 if UBOOT_CONFIG_SYS_FSL_DDR_VER_50
	default 47 if UBOOT_CONFIG_SYS_FSL_DDR_VER_47
	default 46 if UBOOT_CONFIG_SYS_FSL_DDR_VER_46
	default 44 if UBOOT_CONFIG_SYS_FSL_DDR_VER_44

config UBOOT_CONFIG_SYS_FSL_DDR_VER_50
	bool

config UBOOT_CONFIG_SYS_FSL_DDR_VER_47
	bool

config UBOOT_CONFIG_SYS_FSL_DDR_VER_46
	bool

config UBOOT_CONFIG_SYS_FSL_DDR_VER_44
	bool

config UBOOT_CONFIG_SYS_FSL_DDRC_GEN1
	bool
	help
	  Enable Freescale DDR controller.

config UBOOT_CONFIG_SYS_FSL_DDRC_GEN2
	bool
	depends on !UBOOT_CONFIG_MPC86xx
	help
	  Enable Freescale DDR2 controller.

config UBOOT_CONFIG_SYS_FSL_DDRC_GEN3
	bool
	depends on UBOOT_CONFIG_PPC
	help
	  Enable Freescale DDR3 controller for PowerPC SoCs.

config UBOOT_CONFIG_SYS_FSL_DDRC_ARM_GEN3
	bool
	depends on UBOOT_CONFIG_ARM
	help
	  Enable Freescale DDR3 controller for ARM SoCs.

config UBOOT_CONFIG_SYS_FSL_DDRC_GEN4
	bool
	help
	  Enable Freescale DDR4 controller.

config UBOOT_CONFIG_SYS_FSL_HAS_DDR4
	bool

config UBOOT_CONFIG_SYS_FSL_HAS_DDR3
	bool

config UBOOT_CONFIG_SYS_FSL_HAS_DDR2
	bool

config UBOOT_CONFIG_SYS_FSL_HAS_DDR1
	bool

choice
	prompt "DDR technology"
	default UBOOT_CONFIG_SYS_FSL_DDR4 if UBOOT_CONFIG_SYS_FSL_HAS_DDR4
	default UBOOT_CONFIG_SYS_FSL_DDR3 if UBOOT_CONFIG_SYS_FSL_HAS_DDR3
	default UBOOT_CONFIG_SYS_FSL_DDR2 if UBOOT_CONFIG_SYS_FSL_HAS_DDR2
	default UBOOT_CONFIG_SYS_FSL_DDR1 if UBOOT_CONFIG_SYS_FSL_HAS_DDR1

config UBOOT_CONFIG_SYS_FSL_DDR4
	bool "Freescale DDR4 controller"
	depends on UBOOT_CONFIG_SYS_FSL_HAS_DDR4
	imply DDR_SPD
	select UBOOT_CONFIG_SYS_FSL_DDRC_GEN4

config UBOOT_CONFIG_SYS_FSL_DDR3
	bool "Freescale DDR3 controller"
	depends on UBOOT_CONFIG_SYS_FSL_HAS_DDR3
	imply DDR_SPD
	select UBOOT_CONFIG_SYS_FSL_DDRC_GEN3 if PPC
	select UBOOT_CONFIG_SYS_FSL_DDRC_ARM_GEN3 if ARM

config UBOOT_CONFIG_SYS_FSL_DDR2
	bool "Freescale DDR2 controller"
	depends on UBOOT_CONFIG_SYS_FSL_HAS_DDR2
	imply DDR_SPD
	select UBOOT_CONFIG_SYS_FSL_DDRC_GEN2 if (!MPC86xx && !UBOOT_CONFIG_SYS_FSL_DDRC_GEN3)

config UBOOT_CONFIG_SYS_FSL_DDR1
	bool "Freescale DDR1 controller"
	depends on UBOOT_CONFIG_SYS_FSL_HAS_DDR1
	imply DDR_SPD
	select UBOOT_CONFIG_SYS_FSL_DDRC_GEN1

endchoice

endmenu

config UBOOT_CONFIG_FSL_DMA
	def_bool y if DDR_ECC && UBOOT_CONFIG_MPC85xx && !UBOOT_CONFIG_ECC_INIT_VIA_DDRCONTROLLER

config UBOOT_CONFIG_DDR_ECC
	bool "ECC DDR memory support"

config UBOOT_CONFIG_DDR_ECC_CMD
	bool "Access the ECC features of the memory controller"
	depends on UBOOT_CONFIG_DDR_ECC && UBOOT_CONFIG_MPC83xx
	default y

config UBOOT_CONFIG_ECC_INIT_VIA_DDRCONTROLLER
	bool "DDR Memory controller initializes memory."
	help
	  Use the DDR controller to auto initialize memory.  If not enabled,
	  the DMA controller is responsible for doing this.

endif

config UBOOT_CONFIG_SYS_FSL_ERRATUM_A008378
	bool

config UBOOT_CONFIG_SYS_FSL_ERRATUM_A008109
	bool

config UBOOT_CONFIG_SYS_FSL_ERRATUM_A008511
	bool

config UBOOT_CONFIG_SYS_FSL_ERRATUM_A009663
	bool

config UBOOT_CONFIG_SYS_FSL_ERRATUM_A009801
	bool

config UBOOT_CONFIG_SYS_FSL_ERRATUM_A009803
	bool

config UBOOT_CONFIG_SYS_FSL_ERRATUM_A009942
	bool

config UBOOT_CONFIG_SYS_FSL_ERRATUM_A010165
	bool

config UBOOT_CONFIG_SYS_FSL_ERRATUM_NMG_DDR120
	bool

config UBOOT_CONFIG_SYS_FSL_ERRATUM_DDR_115
	bool

config UBOOT_CONFIG_SYS_FSL_ERRATUM_DDR111_DDR134
	bool

config UBOOT_CONFIG_SYS_FSL_ERRATUM_DDR_A003
	bool

config UBOOT_CONFIG_SYS_FSL_ERRATUM_DDR_A003474
	bool
```

## maxlinear/feed_uboot/open_uboot/config/drivers/ddr/imx/imx8ulp/Kconfig
```kconfig
menu "i.MX8ULP DDR controllers"
	depends on UBOOT_CONFIG_ARCH_IMX8ULP

config UBOOT_CONFIG_IMX8ULP_DRAM
	bool "imx8m dram"

config UBOOT_CONFIG_IMX8ULP_DRAM_PHY_PLL_BYPASS
	bool "Enable the DDR PHY PLL bypass mode, so PHY clock is from DDR_CLK "
	depends on UBOOT_CONFIG_IMX8ULP_DRAM

endmenu
```
