## maxlinear/feed_uboot/open_uboot/config/board/freescale/ls1028a/Kconfig
```kconfig
if UBOOT_CONFIG_TARGET_LS1028AQDS

config UBOOT_CONFIG_SYS_BOARD
	default "ls1028a"

config UBOOT_CONFIG_SYS_VENDOR
	default "freescale"

config UBOOT_CONFIG_SYS_SOC
	default "fsl-layerscape"

config UBOOT_CONFIG_SYS_CONFIG_NAME
	default "ls1028aqds"

config UBOOT_CONFIG_EMMC_BOOT
	bool "Support for booting from EMMC"

config UBOOT_CONFIG_SYS_TEXT_BASE
	default 0x96000000 if UBOOT_CONFIG_SD_BOOT || UBOOT_CONFIG_EMMC_BOOT
	default 0x82000000 if UBOOT_CONFIG_TFABOOT
	default 0x20100000

if UBOOT_CONFIG_FSL_LS_PPA
config UBOOT_CONFIG_SYS_LS_PPA_FW_ADDR
	hex "PPA Firmware Addr"
	default 0x20400000 if UBOOT_CONFIG_SYS_LS_PPA_FW_IN_XIP && UBOOT_CONFIG_ARCH_LS1028A
	default 0x400000 if UBOOT_CONFIG_SYS_LS_PPA_FW_IN_MMC && UBOOT_CONFIG_ARCH_LS1028A
if UBOOT_CONFIG_CHAIN_OF_TRUST
config UBOOT_CONFIG_SYS_LS_PPA_ESBC_ADDR
	hex "PPA header Addr"
	default 0x20600000 if UBOOT_CONFIG_SYS_LS_PPA_FW_IN_XIP && UBOOT_CONFIG_ARCH_LS1028A
endif
endif

source "../../../board/freescale/common/Kconfig"

endif

if UBOOT_CONFIG_TARGET_LS1028ARDB

config UBOOT_CONFIG_SYS_BOARD
	default "ls1028a"

config UBOOT_CONFIG_SYS_VENDOR
	default "freescale"

config UBOOT_CONFIG_SYS_SOC
	default "fsl-layerscape"

config UBOOT_CONFIG_SYS_CONFIG_NAME
	default "ls1028ardb"

config UBOOT_CONFIG_EMMC_BOOT
	bool "Support for booting from EMMC"

config UBOOT_CONFIG_SYS_TEXT_BASE
	default 0x96000000 if UBOOT_CONFIG_SD_BOOT || UBOOT_CONFIG_EMMC_BOOT
	default 0x82000000 if UBOOT_CONFIG_TFABOOT
	default 0x20100000

source "../../../board/freescale/common/Kconfig"

endif
```

## maxlinear/feed_uboot/open_uboot/config/board/freescale/ls1043aqds/Kconfig
```kconfig
if UBOOT_CONFIG_TARGET_LS1043AQDS

config UBOOT_CONFIG_SYS_BOARD
	default "ls1043aqds"

config UBOOT_CONFIG_SYS_VENDOR
	default "freescale"

config UBOOT_CONFIG_SYS_SOC
	default "fsl-layerscape"

config UBOOT_CONFIG_SYS_CONFIG_NAME
	default "ls1043aqds"

if UBOOT_CONFIG_FSL_LS_PPA
config UBOOT_CONFIG_SYS_LS_PPA_FW_ADDR
	hex "PPA Firmware Addr"
	default 0x40400000 if UBOOT_CONFIG_SYS_LS_PPA_FW_IN_XIP && UBOOT_CONFIG_QSPI_BOOT
	default 0x60400000 if UBOOT_CONFIG_SYS_LS_PPA_FW_IN_XIP
	default 0x400000 if UBOOT_CONFIG_SYS_LS_PPA_FW_IN_MMC || UBOOT_CONFIG_SYS_LS_PPA_FW_IN_NAND

if UBOOT_CONFIG_CHAIN_OF_TRUST
config UBOOT_CONFIG_SYS_LS_PPA_ESBC_ADDR
	hex "PPA Firmware HDR Addr"
	default 0x40680000 if UBOOT_CONFIG_SYS_LS_PPA_FW_IN_XIP && UBOOT_CONFIG_QSPI_BOOT
	default 0x60680000 if UBOOT_CONFIG_SYS_LS_PPA_FW_IN_XIP
	default 0x680000 if UBOOT_CONFIG_SYS_LS_PPA_FW_IN_MMC || UBOOT_CONFIG_SYS_LS_PPA_FW_IN_NAND
endif
endif

source "../../../board/freescale/common/Kconfig"

endif
```

## maxlinear/feed_uboot/open_uboot/config/board/freescale/ls1043ardb/Kconfig
```kconfig
if UBOOT_CONFIG_TARGET_LS1043ARDB

config UBOOT_CONFIG_SYS_BOARD
	default "ls1043ardb"

config UBOOT_CONFIG_SYS_VENDOR
	default "freescale"

config UBOOT_CONFIG_SYS_SOC
	default "fsl-layerscape"

config UBOOT_CONFIG_SYS_CONFIG_NAME
	default "ls1043ardb"

config UBOOT_CONFIG_SYS_HAS_ARMV8_SECURE_BASE
	bool "Enable secure address for PSCI image"
	depends on UBOOT_CONFIG_ARMV8_PSCI
	help
	  PSCI image can be re-located to secure RAM.
	  If enabled, please also define the value for ARMV8_SECURE_BASE,
	  for LS1043ARDB, it could be some address in OCRAM.

if UBOOT_CONFIG_FSL_LS_PPA
config UBOOT_CONFIG_SYS_LS_PPA_FW_ADDR
	hex "PPA Firmware Addr"
	default 0x60400000 if UBOOT_CONFIG_SYS_LS_PPA_FW_IN_XIP
	default 0x400000 if UBOOT_CONFIG_SYS_LS_PPA_FW_IN_MMC || UBOOT_CONFIG_SYS_LS_PPA_FW_IN_NAND

if UBOOT_CONFIG_CHAIN_OF_TRUST
config UBOOT_CONFIG_SYS_LS_PPA_ESBC_ADDR
	hex "PPA Firmware HDR Addr"
	default 0x60680000 if UBOOT_CONFIG_SYS_LS_PPA_FW_IN_XIP
	default 0x680000 if UBOOT_CONFIG_SYS_LS_PPA_FW_IN_MMC || UBOOT_CONFIG_SYS_LS_PPA_FW_IN_NAND
endif
endif

source "../../../board/freescale/common/Kconfig"

endif
```

## maxlinear/feed_uboot/open_uboot/config/board/freescale/ls1046afrwy/Kconfig
```kconfig
if UBOOT_CONFIG_TARGET_LS1046AFRWY

config UBOOT_CONFIG_SYS_BOARD
	default "ls1046afrwy"

config UBOOT_CONFIG_SYS_VENDOR
	default "freescale"

config UBOOT_CONFIG_SYS_SOC
	default "fsl-layerscape"

config UBOOT_CONFIG_SYS_CONFIG_NAME
	default "ls1046afrwy"

source "../../../board/freescale/common/Kconfig"
endif
```
