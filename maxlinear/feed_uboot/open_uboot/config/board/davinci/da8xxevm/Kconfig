## maxlinear/feed_uboot/open_uboot/config/board/davinci/da8xxevm/Kconfig
```kconfig
if UBOOT_CONFIG_TARGET_DA850EVM

config UBOOT_CONFIG_SYS_BOARD
	default "da8xxevm"

config UBOOT_CONFIG_SYS_VENDOR
	default "davinci"

config UBOOT_CONFIG_SYS_CONFIG_NAME
	default "da850evm"

menuconfig UBOOT_CONFIG_DA850_MAC
	bool "Use MAC Address"
	default y

if UBOOT_CONFIG_DA850_MAC
config UBOOT_CONFIG_MAC_ADDR_IN_SPIFLASH
	bool "MAC address in SPI Flash"
	default y
	help
	  The OMAP-L138 and AM1808 SoM are programmed with
	  their MAC address in SPI Flash from the factory
	  Enable this option to read the MAC from SPI Flash

endif

endif

if UBOOT_CONFIG_TARGET_OMAPL138_LCDK

config UBOOT_CONFIG_SYS_BOARD
	default "da8xxevm"

config UBOOT_CONFIG_SYS_VENDOR
	default "davinci"

config UBOOT_CONFIG_SYS_CONFIG_NAME
	default "omapl138_lcdk"

endif

source "../../../board/ti/common/Kconfig"
```

## maxlinear/feed_uboot/open_uboot/config/board/dfi/dfi-bt700/Kconfig
```kconfig
config UBOOT_CONFIG_SYS_BOARD
	default "dfi-bt700"

config UBOOT_CONFIG_SYS_VENDOR
	default "dfi"

config UBOOT_CONFIG_SYS_SOC
	default "baytrail"

config UBOOT_CONFIG_SYS_CONFIG_NAME
	default "dfi-bt700" if UBOOT_CONFIG_TARGET_Q7X_151_DFI_BT700
	default "theadorable-x86-dfi-bt700" if UBOOT_CONFIG_TARGET_THEADORABLE_X86_DFI_BT700

config UBOOT_CONFIG_SYS_TEXT_BASE
	default 0xfff00000

config UBOOT_CONFIG_BOARD_SPECIFIC_OPTIONS # dummy
	def_bool y
	select UBOOT_CONFIG_X86_RESET_VECTOR
	select UBOOT_CONFIG_INTEL_BAYTRAIL
	select UBOOT_CONFIG_BOARD_ROMSIZE_KB_8192
	select UBOOT_CONFIG_BOARD_EARLY_INIT_F
	select UBOOT_CONFIG_BOARD_LATE_INIT
	select UBOOT_CONFIG_SPI_FLASH_STMICRO
	imply SPI_FLASH_SPANSION
	imply SPI_FLASH_WINBOND
	select UBOOT_CONFIG_SERIAL_RX_BUFFER

config UBOOT_CONFIG_PCIE_ECAM_BASE
	default 0xe0000000
```

## maxlinear/feed_uboot/open_uboot/config/board/dhelectronics/dh_imx6/Kconfig
```kconfig
if UBOOT_CONFIG_TARGET_DHCOMIMX6

config UBOOT_CONFIG_SYS_BOARD
	default "dh_imx6"

config UBOOT_CONFIG_SYS_VENDOR
	default "dhelectronics"

config UBOOT_CONFIG_SYS_CONFIG_NAME
	default "dh_imx6"

endif
```

## maxlinear/feed_uboot/open_uboot/config/board/dhelectronics/dh_stm32mp1/Kconfig
```kconfig
if UBOOT_CONFIG_TARGET_DH_STM32MP1_PDK2

config UBOOT_CONFIG_SYS_BOARD
	default "dh_stm32mp1"

config UBOOT_CONFIG_SYS_VENDOR
	default "dhelectronics"

config UBOOT_CONFIG_SYS_CONFIG_NAME
	default "stm32mp15_dh_dhsom"

config UBOOT_CONFIG_ENV_SECT_SIZE
	default 0x10000 if UBOOT_CONFIG_ENV_IS_IN_SPI_FLASH

config UBOOT_CONFIG_ENV_OFFSET
	default 0x1E0000 if UBOOT_CONFIG_ENV_IS_IN_SPI_FLASH

config UBOOT_CONFIG_ENV_OFFSET_REDUND
	default 0x1F0000 if UBOOT_CONFIG_ENV_IS_IN_SPI_FLASH

source "../../../board/st/common/Kconfig"
endif
```

## maxlinear/feed_uboot/open_uboot/config/board/efi/Kconfig
```kconfig
if UBOOT_CONFIG_VENDOR_EFI

choice
	prompt "Mainboard model"
	optional

config UBOOT_CONFIG_TARGET_EFI_APP32
	bool "32-bit efi application"
	select UBOOT_CONFIG_EFI_APP
	help
	  This target is used for running U-Boot on top of EFI. In
	  this case EFI does the early initialisation, and U-Boot
	  takes over once the RAM, video and CPU are fully running.
	  U-Boot is loaded as an application from EFI.

config UBOOT_CONFIG_TARGET_EFI_APP64
	bool "64-bit efi application"
	select UBOOT_CONFIG_EFI_APP
	select UBOOT_CONFIG_X86_64
	help
	  This target is used for running U-Boot on top of EFI in 64-bit mode.
	  In this case EFI does the early initialisation, and U-Boot
	  takes over once the RAM, video and CPU are fully running.
	  U-Boot is loaded as an application from EFI.

config UBOOT_CONFIG_TARGET_EFI_PAYLOAD
	bool "efi payload"
	help
	  This target is used for running U-Boot on top of EFI. In
	  this case EFI does the early initialisation, and U-Boot
	  takes over once the RAM, video and CPU are fully running.
	  U-Boot is loaded as a payload from EFI.

endchoice

source "efi-x86_app/Kconfig"
source "efi-x86_payload/Kconfig"

endif
```

## maxlinear/feed_uboot/open_uboot/config/board/efi/efi-x86_app/Kconfig
```kconfig
if UBOOT_CONFIG_EFI_APP

config UBOOT_CONFIG_SYS_BOARD
	default "efi-x86_app"

config UBOOT_CONFIG_SYS_VENDOR
	default "efi"

config UBOOT_CONFIG_SYS_SOC
	default "efi"

config UBOOT_CONFIG_SYS_CONFIG_NAME
	default "efi-x86_app"

config UBOOT_CONFIG_BOARD_SPECIFIC_OPTIONS # dummy
	def_bool y
	imply VIDEO_EFI

endif
```

## maxlinear/feed_uboot/open_uboot/config/board/elgin/elgin_rv1108/Kconfig
```kconfig
if UBOOT_CONFIG_TARGET_ELGIN_RV1108

config UBOOT_CONFIG_SYS_BOARD
	default "elgin_rv1108"

config UBOOT_CONFIG_SYS_VENDOR
	default "elgin"

config UBOOT_CONFIG_SYS_CONFIG_NAME
	default "elgin_rv1108"

config UBOOT_CONFIG_BOARD_SPECIFIC_OPTIONS # dummy
	def_bool y

endif
```

## maxlinear/feed_uboot/open_uboot/config/board/embest/mx6boards/Kconfig
```kconfig
if UBOOT_CONFIG_TARGET_EMBESTMX6BOARDS

config UBOOT_CONFIG_SYS_BOARD
	default "mx6boards"

config UBOOT_CONFIG_SYS_VENDOR
	default "embest"

config UBOOT_CONFIG_SYS_CONFIG_NAME
	default "embestmx6boards"

endif
```

## maxlinear/feed_uboot/open_uboot/config/board/emulation/common/Kconfig
```kconfig
config UBOOT_CONFIG_MTDPARTS_NOR0
	string "mtd boot partition for nor0"
	default "64m(u-boot)" if UBOOT_CONFIG_TARGET_QEMU_ARM_64BIT && !UBOOT_CONFIG_TFABOOT
	depends on UBOOT_CONFIG_SYS_MTDPARTS_RUNTIME
	help
	  This define the partition of nor0 used to build mtparts dynamically
	  for boot from nor0.

config UBOOT_CONFIG_MTDPARTS_NOR1
	string "mtd u-boot env partition for nor1"
	default "64m(u-boot-env)" if UBOOT_CONFIG_TARGET_QEMU_ARM_64BIT && !UBOOT_CONFIG_TFABOOT
	depends on UBOOT_CONFIG_SYS_MTDPARTS_RUNTIME
	help
	  This define the partition of nor1 used to build mtparts dynamically
	  for the u-boot env stored on nor1.
```

## maxlinear/feed_uboot/open_uboot/config/board/emulation/qemu-riscv/Kconfig
```kconfig
if UBOOT_CONFIG_TARGET_QEMU_VIRT

config UBOOT_CONFIG_SYS_BOARD
	default "qemu-riscv"

config UBOOT_CONFIG_SYS_VENDOR
	default "emulation"

config UBOOT_CONFIG_SYS_CPU
	default "generic"

config UBOOT_CONFIG_SYS_CONFIG_NAME
	default "qemu-riscv"

config UBOOT_CONFIG_SYS_TEXT_BASE
	default 0x81200000 if UBOOT_CONFIG_SPL
	default 0x80000000 if ! UBOOT_CONFIG_RISCV_SMODE
	default 0x80200000 if UBOOT_CONFIG_RISCV_SMODE && UBOOT_CONFIG_ARCH_RV64I
	default 0x80400000 if UBOOT_CONFIG_RISCV_SMODE && UBOOT_CONFIG_ARCH_RV32I

config UBOOT_CONFIG_SPL_TEXT_BASE
	default 0x80000000

config UBOOT_CONFIG_SPL_OPENSBI_LOAD_ADDR
	hex
	default 0x81000000

config UBOOT_CONFIG_BOARD_SPECIFIC_OPTIONS # dummy
	def_bool y
	select UBOOT_CONFIG_GENERIC_RISCV
	select UBOOT_CONFIG_SUPPORT_SPL
	imply AHCI
	imply SMP
	imply BOARD_LATE_INIT
	imply PCI_INIT_R
	imply SPL_RAM_SUPPORT
	imply SPL_RAM_DEVICE
	imply CMD_PCI
	imply CMD_POWEROFF
	imply CMD_SCSI
	imply CMD_PING
	imply CMD_EXT2
	imply CMD_EXT4
	imply CMD_FAT
	imply CMD_FS_GENERIC
	imply DOS_PARTITION
	imply ISO_PARTITION
	imply EFI_PARTITION
	imply SCSI_AHCI
	imply AHCI_PCI
	imply E1000
	imply NVME
	imply PCI
	imply PCIE_ECAM_GENERIC
	imply SCSI
	imply DM_SCSI
	imply SYS_NS16550
	imply SIFIVE_SERIAL
	imply SYSRESET
	imply SYSRESET_CMD_POWEROFF
	imply SYSRESET_SYSCON
	imply VIRTIO_MMIO
	imply VIRTIO_PCI
	imply VIRTIO_NET
	imply VIRTIO_BLK
	imply MTD_NOR_FLASH
	imply CFI_FLASH

endif
```

## maxlinear/feed_uboot/open_uboot/config/board/engicam/imx8mm/Kconfig
```kconfig
if UBOOT_CONFIG_TARGET_IMX8MM_ICORE_MX8MM

config UBOOT_CONFIG_SYS_BOARD
	default "imx8mm"

config UBOOT_CONFIG_SYS_VENDOR
	default "engicam"

config UBOOT_CONFIG_SYS_CONFIG_NAME
	default "imx8mm_icore_mx8mm"

config UBOOT_CONFIG_IMX_CONFIG
	default "arch/arm/mach-imx/imx8m/imximage-8mm-lpddr4.cfg"

source "../../../board/freescale/common/Kconfig"

endif
```

## maxlinear/feed_uboot/open_uboot/config/board/firefly/firefly-rk3308/Kconfig
```kconfig
if UBOOT_CONFIG_TARGET_ROC_RK3308_CC

config UBOOT_CONFIG_SYS_BOARD
	default "firefly-rk3308"

config UBOOT_CONFIG_SYS_VENDOR
	default "firefly"

config UBOOT_CONFIG_SYS_CONFIG_NAME
	default "firefly_rk3308"

config UBOOT_CONFIG_BOARD_SPECIFIC_OPTIONS # dummy
	def_bool y

endif
```

## maxlinear/feed_uboot/open_uboot/config/board/freescale/common/Kconfig
```kconfig
config UBOOT_CONFIG_CHAIN_OF_TRUST
	depends on !UBOOT_CONFIG_FIT_SIGNATURE && UBOOT_CONFIG_NXP_ESBC
	imply CMD_BLOB
	imply CMD_HASH if ARM
	select UBOOT_CONFIG_FSL_CAAM
	select UBOOT_CONFIG_SPL_BOARD_INIT if (ARM && UBOOT_CONFIG_SPL)
	select UBOOT_CONFIG_SPL_HASH if (ARM && UBOOT_CONFIG_SPL)
	select UBOOT_CONFIG_SHA_HW_ACCEL
	select UBOOT_CONFIG_SHA_PROG_HW_ACCEL
	select UBOOT_CONFIG_ENV_IS_NOWHERE
	select UBOOT_CONFIG_CMD_EXT4 if ARM
	select UBOOT_CONFIG_CMD_EXT4_WRITE if ARM
	bool
	default y

config UBOOT_CONFIG_CMD_ESBC_VALIDATE
	bool "Enable the 'esbc_validate' and 'esbc_halt' commands"
	default y if UBOOT_CONFIG_CHAIN_OF_TRUST
	help
	  This option enables two commands used for secure booting:

	    esbc_validate - validate signature using RSA verification
	    esbc_halt - put the core in spin loop (Secure Boot Only)

config UBOOT_CONFIG_FSL_USE_PCA9547_MUX
	bool "Enable PCA9547 I2C Mux on Freescale boards"
	help
	 This option enables the PCA9547 I2C mux on Freescale boards.

config UBOOT_CONFIG_VID
	depends on UBOOT_CONFIG_DM_I2C
	bool "Enable Freescale VID"
	help
	 This option enables setting core voltage based on individual
	 values saved in SoC fuses.

config UBOOT_CONFIG_VOL_MONITOR_LTC3882_READ
	depends on UBOOT_CONFIG_VID
	bool "Enable the LTC3882 voltage monitor read"
	help
	 This option enables LTC3882 voltage monitor read
	 functionality. It is used by the common VID driver.

config UBOOT_CONFIG_VOL_MONITOR_LTC3882_SET
	depends on UBOOT_CONFIG_VID
	bool "Enable the LTC3882 voltage monitor set"
	help
	 This option enables LTC3882 voltage monitor set
	 functionality. It is used by the common VID driver.

config UBOOT_CONFIG_VOL_MONITOR_ISL68233_READ
	depends on UBOOT_CONFIG_VID
	bool "Enable the ISL68233 voltage monitor read"
	help
	 This option enables ISL68233 voltage monitor read
	 functionality. It is used by the common VID driver.

config UBOOT_CONFIG_VOL_MONITOR_ISL68233_SET
	depends on UBOOT_CONFIG_VID
	bool "Enable the ISL68233 voltage monitor set"
	help
	 This option enables ISL68233 voltage monitor set
	 functionality. It is used by the common VID driver.
```

## maxlinear/feed_uboot/open_uboot/config/board/freescale/imx8mp_evk/Kconfig
```kconfig
if UBOOT_CONFIG_TARGET_IMX8MP_EVK

config UBOOT_CONFIG_SYS_BOARD
	default "imx8mp_evk"

config UBOOT_CONFIG_SYS_VENDOR
	default "freescale"

config UBOOT_CONFIG_SYS_CONFIG_NAME
	default "imx8mp_evk"

config UBOOT_CONFIG_IMX_CONFIG
	default "board/freescale/imx8mp_evk/imximage-8mp-lpddr4.cfg"

source "../../../board/freescale/common/Kconfig"

endif
```

## maxlinear/feed_uboot/open_uboot/config/board/freescale/imx8mq_evk/Kconfig
```kconfig
if UBOOT_CONFIG_TARGET_IMX8MQ_EVK

config UBOOT_CONFIG_SYS_BOARD
	default "imx8mq_evk"

config UBOOT_CONFIG_SYS_VENDOR
	default "freescale"

config UBOOT_CONFIG_SYS_CONFIG_NAME
	default "imx8mq_evk"

config UBOOT_CONFIG_IMX_CONFIG
	default "arch/arm/mach-imx/imx8m/imximage.cfg"

endif
```

## maxlinear/feed_uboot/open_uboot/config/board/freescale/imx8qxp_mek/Kconfig
```kconfig
if UBOOT_CONFIG_TARGET_IMX8QXP_MEK

config UBOOT_CONFIG_SYS_BOARD
	default "imx8qxp_mek"

config UBOOT_CONFIG_SYS_VENDOR
	default "freescale"

config UBOOT_CONFIG_SYS_CONFIG_NAME
	default "imx8qxp_mek"

config UBOOT_CONFIG_IMX_CONFIG
	default "board/freescale/imx8qxp_mek/imximage.cfg"

source "../../../board/freescale/common/Kconfig"

endif
```

## maxlinear/feed_uboot/open_uboot/config/board/freescale/imx8ulp_evk/Kconfig
```kconfig
if UBOOT_CONFIG_TARGET_IMX8ULP_EVK

config UBOOT_CONFIG_SYS_BOARD
	default "imx8ulp_evk"

config UBOOT_CONFIG_SYS_VENDOR
	default "freescale"

config UBOOT_CONFIG_SYS_CONFIG_NAME
	default "imx8ulp_evk"

source "../../../board/freescale/common/Kconfig"

endif
```

## maxlinear/feed_uboot/open_uboot/config/board/freescale/imxrt1050-evk/Kconfig
```kconfig
if UBOOT_CONFIG_TARGET_IMXRT1050_EVK

config UBOOT_CONFIG_SYS_BOARD
	string
	default "imxrt1050-evk"

config UBOOT_CONFIG_SYS_VENDOR
	string
	default "freescale"

config UBOOT_CONFIG_SYS_SOC
	string
	default "imxrt1050"

config UBOOT_CONFIG_SYS_CONFIG_NAME
	string
	default "imxrt1050-evk"

config UBOOT_CONFIG_IMX_CONFIG
	default "board/freescale/imxrt1050-evk/imximage.cfg"

endif
```

## maxlinear/feed_uboot/open_uboot/config/board/freescale/ls1012afrdm/Kconfig
```kconfig
if UBOOT_CONFIG_TARGET_LS1012AFRDM

config UBOOT_CONFIG_SYS_BOARD
	default "ls1012afrdm"

config UBOOT_CONFIG_SYS_VENDOR
	default "freescale"

config UBOOT_CONFIG_SYS_SOC
	default "fsl-layerscape"

config UBOOT_CONFIG_SYS_CONFIG_NAME
	default "ls1012afrdm"

config UBOOT_CONFIG_SYS_LS_PFE_FW_ADDR
	hex "Flash address of PFE firmware"
	default 0x40a00000

config UBOOT_CONFIG_SYS_LS_PFE_FW_LENGTH
	hex "length of PFE firmware"
	default 0x40000

config UBOOT_CONFIG_SYS_LS_PPA_FW_ADDR
	hex "PPA Firmware Addr"
	default 0x40400000
endif

if UBOOT_CONFIG_FSL_PFE

config UBOOT_CONFIG_BOARD_SPECIFIC_OPTIONS # dummy
	def_bool y
	select UBOOT_CONFIG_PHYLIB
	imply PHY_REALTEK
	imply PHY_ATHEROS

config UBOOT_CONFIG_DDR_PFE_PHYS_BASEADDR
	hex "PFE DDR physical base address"
	default 0x03800000

config UBOOT_CONFIG_DDR_PFE_BASEADDR
	hex "PFE DDR base address"
	default 0x83800000

config UBOOT_CONFIG_PFE_EMAC1_PHY_ADDR
	hex "PFE DDR base address"
	default 0x2

config UBOOT_CONFIG_PFE_EMAC2_PHY_ADDR
	hex "PFE DDR base address"
	default 0x1

endif

if UBOOT_CONFIG_TARGET_LS1012AFRWY

config UBOOT_CONFIG_SYS_BOARD
	default "ls1012afrdm"

config UBOOT_CONFIG_SYS_VENDOR
	default "freescale"

config UBOOT_CONFIG_SYS_SOC
	default "fsl-layerscape"

config UBOOT_CONFIG_SYS_CONFIG_NAME
	default "ls1012afrwy"

config UBOOT_CONFIG_SYS_LS_PFE_FW_ADDR
	hex "Flash address of PFE firmware"
	default 0x40020000

config UBOOT_CONFIG_SYS_LS_PFE_FW_LENGTH
	hex "length of PFE firmware"
	default 0x40000

config UBOOT_CONFIG_SYS_LS_PPA_FW_ADDR
	hex "PPA Firmware Addr"
	default 0x40060000

config UBOOT_CONFIG_SYS_LS_PPA_ESBC_ADDR
	hex "PPA Firmware HDR Addr"
	default 0x401f4000

config UBOOT_CONFIG_SYS_LS_PFE_ESBC_ADDR
	hex "PFE Firmware HDR Addr"
	default 0x401f8000

config UBOOT_CONFIG_SYS_LS_PFE_ESBC_LENGTH
	hex "length of PFE Firmware HDR"
	default 0xc00
endif

if UBOOT_CONFIG_TARGET_LS1012AFRDM || UBOOT_CONFIG_TARGET_LS1012AFRWY
source "../../../board/freescale/common/Kconfig"
endif
```

## maxlinear/feed_uboot/open_uboot/config/board/freescale/ls1021aiot/Kconfig
```kconfig
if UBOOT_CONFIG_TARGET_LS1021AIOT

config UBOOT_CONFIG_SYS_BOARD
	default "ls1021aiot"

config UBOOT_CONFIG_SYS_VENDOR
	default "freescale"

config UBOOT_CONFIG_SYS_SOC
	default "ls102xa"

config UBOOT_CONFIG_SYS_CONFIG_NAME
	default "ls1021aiot"

source "../../../board/freescale/common/Kconfig"

endif
```

## maxlinear/feed_uboot/open_uboot/config/board/freescale/ls1021atwr/Kconfig
```kconfig
if UBOOT_CONFIG_TARGET_LS1021ATWR

config UBOOT_CONFIG_SYS_BOARD
	default "ls1021atwr"

config UBOOT_CONFIG_SYS_VENDOR
	default "freescale"

config UBOOT_CONFIG_SYS_SOC
	default "ls102xa"

config UBOOT_CONFIG_SYS_CONFIG_NAME
	default "ls1021atwr"

source "../../../board/freescale/common/Kconfig"

endif
```
