## maxlinear/feed_uboot/open_uboot/config/board/grinn/chiliboard/Kconfig
```kconfig
if UBOOT_CONFIG_TARGET_CHILIBOARD

config UBOOT_CONFIG_SYS_BOARD
	default "chiliboard"

config UBOOT_CONFIG_SYS_VENDOR
	default "grinn"

config UBOOT_CONFIG_SYS_CONFIG_NAME
	default "chiliboard"

config UBOOT_CONFIG_SYS_SOC
	default "am33xx"

endif
```

## maxlinear/feed_uboot/open_uboot/config/board/grinn/liteboard/Kconfig
```kconfig
if UBOOT_CONFIG_TARGET_LITEBOARD

config UBOOT_CONFIG_SYS_BOARD
	default "liteboard"

config UBOOT_CONFIG_SYS_VENDOR
	default "grinn"

config UBOOT_CONFIG_SYS_CONFIG_NAME
	default "liteboard"

endif
```

## maxlinear/feed_uboot/open_uboot/config/board/hisilicon/hikey960/Kconfig
```kconfig
if UBOOT_CONFIG_TARGET_HIKEY960

config UBOOT_CONFIG_SYS_BOARD
	default "hikey960"

config UBOOT_CONFIG_SYS_VENDOR
	default "hisilicon"

config UBOOT_CONFIG_SYS_SOC
	default "hi3660"

config UBOOT_CONFIG_SYS_CONFIG_NAME
	default "hikey960"

endif
```

## maxlinear/feed_uboot/open_uboot/config/board/hoperun/hihope-rzg2/Kconfig
```kconfig
if UBOOT_CONFIG_TARGET_HIHOPE_RZG2

config UBOOT_CONFIG_SYS_SOC
	default "rmobile"

config UBOOT_CONFIG_SYS_BOARD
	default "hihope-rzg2"

config UBOOT_CONFIG_SYS_VENDOR
	default "hoperun"

config UBOOT_CONFIG_SYS_CONFIG_NAME
	default "hihope-rzg2"

endif
```

## maxlinear/feed_uboot/open_uboot/config/board/imgtec/boston/Kconfig
```kconfig
if UBOOT_CONFIG_TARGET_BOSTON

config UBOOT_CONFIG_SYS_BOARD
	default "boston"

config UBOOT_CONFIG_SYS_VENDOR
	default "imgtec"

config UBOOT_CONFIG_SYS_CONFIG_NAME
	default "boston"

config UBOOT_CONFIG_SYS_TEXT_BASE
	default 0x9fc00000 if UBOOT_CONFIG_32BIT
	default 0xffffffff9fc00000 if UBOOT_CONFIG_64BIT

endif
```

## maxlinear/feed_uboot/open_uboot/config/board/imgtec/malta/Kconfig
```kconfig
if UBOOT_CONFIG_TARGET_MALTA

config UBOOT_CONFIG_SYS_BOARD
	default "malta"

config UBOOT_CONFIG_SYS_VENDOR
	default "imgtec"

config UBOOT_CONFIG_SYS_CONFIG_NAME
	default "malta"

config UBOOT_CONFIG_SYS_TEXT_BASE
	default 0xbe000000 if UBOOT_CONFIG_32BIT
	default 0xffffffffbe000000 if UBOOT_CONFIG_64BIT

endif
```

## maxlinear/feed_uboot/open_uboot/config/board/imgtec/xilfpga/Kconfig
```kconfig
if UBOOT_CONFIG_TARGET_XILFPGA

config UBOOT_CONFIG_SYS_BOARD
	default "xilfpga"

config UBOOT_CONFIG_SYS_VENDOR
	default "imgtec"

config UBOOT_CONFIG_SYS_CONFIG_NAME
	default "imgtec_xilfpga"

config UBOOT_CONFIG_SYS_TEXT_BASE
	default 0x80C00000

endif
```

## maxlinear/feed_uboot/open_uboot/config/board/intel/bayleybay/Kconfig
```kconfig
if UBOOT_CONFIG_TARGET_BAYLEYBAY

config UBOOT_CONFIG_SYS_BOARD
	default "bayleybay"

config UBOOT_CONFIG_SYS_VENDOR
	default "intel"

config UBOOT_CONFIG_SYS_SOC
	default "baytrail"

config UBOOT_CONFIG_SYS_CONFIG_NAME
	default "bayleybay"

config UBOOT_CONFIG_SYS_TEXT_BASE
	default 0xfff00000

config UBOOT_CONFIG_BOARD_SPECIFIC_OPTIONS # dummy
	def_bool y
	select UBOOT_CONFIG_X86_RESET_VECTOR
	select UBOOT_CONFIG_INTEL_BAYTRAIL
	select UBOOT_CONFIG_BOARD_ROMSIZE_KB_8192
	select UBOOT_CONFIG_SPI_FLASH_WINBOND

config UBOOT_CONFIG_PCIE_ECAM_BASE
	default 0xe0000000

endif
```

## maxlinear/feed_uboot/open_uboot/config/board/intel/cherryhill/Kconfig
```kconfig
if UBOOT_CONFIG_TARGET_CHERRYHILL

config UBOOT_CONFIG_SYS_BOARD
	default "cherryhill"

config UBOOT_CONFIG_SYS_VENDOR
	default "intel"

config UBOOT_CONFIG_SYS_SOC
	default "braswell"

config UBOOT_CONFIG_SYS_CONFIG_NAME
	default "cherryhill"

config UBOOT_CONFIG_SYS_TEXT_BASE
	default 0xffe00000

config UBOOT_CONFIG_BOARD_SPECIFIC_OPTIONS # dummy
	def_bool y
	select UBOOT_CONFIG_X86_RESET_VECTOR
	select UBOOT_CONFIG_INTEL_BRASWELL
	select UBOOT_CONFIG_BOARD_ROMSIZE_KB_8192
	select UBOOT_CONFIG_SPI_FLASH_MACRONIX

endif
```

## maxlinear/feed_uboot/open_uboot/config/board/intel/edison/Kconfig
```kconfig
if UBOOT_CONFIG_TARGET_EDISON

config UBOOT_CONFIG_SYS_BOARD
	default "edison"

config UBOOT_CONFIG_SYS_VENDOR
	default "intel"

config UBOOT_CONFIG_SYS_SOC
	default "tangier"

config UBOOT_CONFIG_SYS_CONFIG_NAME
	default "edison"

config UBOOT_CONFIG_SYS_MALLOC_LEN
	default 0x08000000

config UBOOT_CONFIG_SYS_TEXT_BASE
	default 0x01101000

config UBOOT_CONFIG_ROM_TABLE_ADDR
	default 0x0e4500

config UBOOT_CONFIG_ROM_TABLE_SIZE
	default 0x007b00

config UBOOT_CONFIG_BOARD_SPECIFIC_OPTIONS # dummy
	def_bool y
	select UBOOT_CONFIG_X86_LOAD_FROM_32_BIT
	select UBOOT_CONFIG_INTEL_MID
	select UBOOT_CONFIG_INTEL_TANGIER
	select UBOOT_CONFIG_BOARD_LATE_INIT
	select UBOOT_CONFIG_MD5
	imply BINMAN

endif
```

## maxlinear/feed_uboot/open_uboot/config/board/intel/galileo/Kconfig
```kconfig
if UBOOT_CONFIG_TARGET_GALILEO

config UBOOT_CONFIG_SYS_BOARD
	default "galileo"

config UBOOT_CONFIG_SYS_VENDOR
	default "intel"

config UBOOT_CONFIG_SYS_SOC
	default "quark"

config UBOOT_CONFIG_SYS_CONFIG_NAME
	default "galileo"

config UBOOT_CONFIG_SYS_TEXT_BASE
	default 0xfff10000

config UBOOT_CONFIG_BOARD_SPECIFIC_OPTIONS # dummy
	def_bool y
	select UBOOT_CONFIG_X86_RESET_VECTOR
	select UBOOT_CONFIG_INTEL_QUARK
	select UBOOT_CONFIG_BOARD_ROMSIZE_KB_1024
	select UBOOT_CONFIG_SPI_FLASH_WINBOND

endif
```

## maxlinear/feed_uboot/open_uboot/config/board/intel/lightning/Kconfig
```kconfig
menu "Lightning Mountain board config"
	depends on UBOOT_CONFIG_TARGET_LIGHTNING_MOUNTAIN

config UBOOT_CONFIG_LGM_U_BOOT_SIZE
	hex "U-BOOT pad size before lzma"
	default "0x80000"

config UBOOT_CONFIG_SYS_BOARD
	default "lightning"

config UBOOT_CONFIG_DRIVER_LIGHTNING
	bool "Lightning Mountain Board Configuration"
	default y

config UBOOT_CONFIG_SYS_BOARD
	default "lightning"

config UBOOT_CONFIG_SYS_CONFIG_NAME
	default "lightning_mountain"

config UBOOT_CONFIG_BOARD_SPECIFIC_OPTIONS # dummy
	def_bool y
	select UBOOT_CONFIG_X86_RESET_VECTOR 
	select UBOOT_CONFIG_USE_EARLY_BOARD_INIT

config UBOOT_CONFIG_PMIC_CONFIGURATIONS
	bool "Enable PMIC support in LGM"
	help
	  Enable PMIC configuration in LGM boards.

if ( UBOOT_CONFIG_PMIC_CONFIGURATIONS )

choice
	prompt "PMIC Vendor"
	help
	  Which PMIC vendor is used on the board.

config UBOOT_CONFIG_ROHM_PMIC
	bool "Rohm PMIC"
	help
	  Rohm PMIC is used on the board.

config UBOOT_CONFIG_RICHTEK_PMIC
	bool "Richtek PMIC"
	help
	  Richtek PMIC is used on the board.

config UBOOT_CONFIG_MPS_PMIC
	bool "MPS PMIC"
	help
	  MPS PMIC is used on the board.
endchoice

config UBOOT_CONFIG_ROC_VOLTAGE
	hex "ROC boot voltage value"
	default 0x4a
	help
	  The core voltage applied to ROC. Default to to 0.865V,
	  safe voltage to allow boot from all boards.
endif

choice
	prompt "Chipset Version"
	default UBOOT_CONFIG_LIGHTNING_B0

config UBOOT_CONFIG_LIGHTNING_A0
	bool "Lightning-Mountain A0"

config UBOOT_CONFIG_LIGHTNING_B0
	bool "Lightning-Mountain B0"
endchoice

choice
	prompt "Board Specific"
	default UBOOT_CONFIG_BOARD_ANYWAN_LIGHTNING

config UBOOT_CONFIG_BOARD_ANYWAN_LIGHTNING
	bool "Lightning Park/Brooks board configurations"

config UBOOT_CONFIG_BOARD_OCTOPUS
	bool "Octopus board configurations"

endchoice

menu "Lightning Mountain DDR Configurations"

config UBOOT_CONFIG_LGM_MEM_SIZE
	int "Memory size in MB"
	help
	  DDR size available on the board

config UBOOT_CONFIG_IS_HAPS
	bool "DDR configuration for HAPS"

config UBOOT_CONFIG_IS_SIMICS
	bool "Configure LGM build for Simics"
	default n
	help
	  Choose this option for Simics build

config UBOOT_CONFIG_DDR_TUNING_DEBUG_VAL
	hex "DDR tuning verbose value"
	default "0xC8"
	help
	  DDR tuning verbose value, between 1 - 0xc8.
	  Where 1 is very verbose and 0xc8 is the least.
	  Enable DEBUG_SIMPLIFY to see the prints in RBE.

config UBOOT_CONFIG_CUSTOMIZED_DDR_HEADER
	bool "Customised DDR tuning parameters"
	help
	  Enable Customised DDR in LGM boards.

choice
	prompt "DDR Type"
	help
	  Choose the DDR type attached to the
	  board.

config UBOOT_CONFIG_LGM_DDR3
	bool "DDR3"
config UBOOT_CONFIG_LGM_LPDDR3
	bool "LPDDR3"
config UBOOT_CONFIG_LGM_DDR4
	bool "DDR4"
config UBOOT_CONFIG_LGM_LPDDR4
	bool "LPDDR4"
endchoice

if ( UBOOT_CONFIG_LGM_LPDDR4 )
config UBOOT_CONFIG_LGM_LPDDR4X_PHY
	bool "Configure LPDDR4 PHY to LPDDR4x"
endif

choice
	prompt "DDR Speed"
	help
	  Run the DDR at the specific DDR speed

config UBOOT_CONFIG_LGM_FREQ_3733M
	bool "DDR @ 3733Mhz"

config UBOOT_CONFIG_LGM_FREQ_3200M
	bool "DDR @ 3200Mhz"

config UBOOT_CONFIG_LGM_FREQ_2666M
	bool "DDR @ 2666Mhz"

config UBOOT_CONFIG_LGM_FREQ_2400M
	bool "DDR @ 2400Mhz"

config UBOOT_CONFIG_LGM_FREQ_2133M
	bool "DDR @ 2133Mhz"

config UBOOT_CONFIG_LGM_FREQ_1866M
	bool "DDR @ 1866Mhz"

config UBOOT_CONFIG_LGM_FREQ_1600M
	bool "DDR @ 1600Mhz"
endchoice

if ( UBOOT_CONFIG_CUSTOMIZED_DDR_HEADER )

choice
	prompt "DDR Vendor"
	help
	  Which DDR vendor is used on the board.

config UBOOT_CONFIG_MICRON_DDR
	bool "Micron"
	help
	  Micon DRAM is used on the board.

config UBOOT_CONFIG_SAMSUNG_DDR
	bool "Samsung"
	help
	  Samsung DRAM is used on the board.

config UBOOT_CONFIG_HYNIX_DDR
	bool "SK Hynix"
	help
	  SK Hynix DRAM is used on the board.

config UBOOT_CONFIG_OTHER_DDR
	bool "Other DDR Vendor not in list"

endchoice

config UBOOT_CONFIG_DDR_VENDOR
	string
	default "micron" if UBOOT_CONFIG_MICRON_DDR
	default "samsung" if UBOOT_CONFIG_SAMSUNG_DDR
	default "hynix" if UBOOT_CONFIG_HYNIX_DDR
	default "custom" if UBOOT_CONFIG_OTHER_DDR

config UBOOT_CONFIG_DDR_RANK
	int "Number of Ranks"
	default 2
	help
	  DDR rank supported by the configurations

config UBOOT_CONFIG_DDR_RANK_DEPTH
	int "Rank Depth in Megabits"
	default 256
	help
	  DDR rank depth per module

config UBOOT_CONFIG_DDR_RANK_WIDTH
	int "Rank/Bus width in bits"
	default 16
	help
	  DDR rank width per module in bits
endif
endmenu

config UBOOT_CONFIG_UBOOT_IN_USER_PART
	bool "Support U-boot binary in User partition"
	depends on UBOOT_CONFIG_BOOT_FROM_EMMC
	default n
	help
	  Select this option if U-boot is not in the boot
	  partition

config UBOOT_CONFIG_MAX_RBE_PER_PART
	int "No. of RBE per RBE partition"
	default 4 if UBOOT_CONFIG_BOOT_FROM_EMMC
	default 1 if UBOOT_CONFIG_BOOT_FROM_NAND || UBOOT_CONFIG_BOOT_FROM_QSPI_NOR || UBOOT_CONFIG_BOOT_FROM_QSPI_NAND

config UBOOT_CONFIG_LGM_THERMAL_PROTECTION
	bool "Support boot-up thermal protection"
	default n
	help
	  Select this option to allow U-boot to wait till
	  SOC temperatures are below a temperature threshold.

config UBOOT_CONFIG_LGM_THERMAL_HIGH_THRESH
	int "Thermal upper threshold value"
	depends on UBOOT_CONFIG_LGM_THERMAL_PROTECTION
	help
	  Thermal boot uppper threshold value

config UBOOT_CONFIG_LGM_THERMAL_LOW_THRESH
	int "Thermal lower threshold value"
	depends on UBOOT_CONFIG_LGM_THERMAL_PROTECTION
	help
	  Thermal boot lower threshold value

config UBOOT_CONFIG_LGM_SUPPORT_DTB_OVERLAY
	depends on UBOOT_CONFIG_BOARD_OCTOPUS
	bool "DTBO overlay feature in Octopus"
	help
	  For Octopus reference design which allows system detection
	  of WAN and PCI-e devices

config UBOOT_CONFIG_GPIO_WAN_MOD_ABS
	int "GPIO pin number for SFP detection"
	depends on UBOOT_CONFIG_LGM_SUPPORT_DTB_OVERLAY
	default 0
	help
	  This is the GPIO used for SFP detection. When an SFP
	  is added to the cage, the GPIO will be pulled low.

config UBOOT_CONFIG_GPIO_WAN_MUX
	int "GPIO pin connected to WAN switch mux"
	depends on UBOOT_CONFIG_LGM_SUPPORT_DTB_OVERLAY
	default 0
	help
	  This is the GPIO used to select between SFP or ETH WAN.

endmenu
```

## maxlinear/feed_uboot/open_uboot/config/board/intel/slimbootloader/Kconfig
```kconfig
# SPDX-License-Identifier: GPL-2.0+
#
# Copyright (C) 2019 Intel Corporation <www.intel.com>

if UBOOT_CONFIG_TARGET_SLIMBOOTLOADER

config UBOOT_CONFIG_SYS_BOARD
	default "slimbootloader"

config UBOOT_CONFIG_SYS_VENDOR
	default "intel"

config UBOOT_CONFIG_SYS_SOC
	default "slimbootloader"

config UBOOT_CONFIG_SYS_CONFIG_NAME
	default "slimbootloader"

config UBOOT_CONFIG_SYS_TEXT_BASE
	default 0x00100000

config UBOOT_CONFIG_BOARD_SPECIFIC_OPTIONS
	def_bool y
	select UBOOT_CONFIG_SYS_SLIMBOOTLOADER
	select UBOOT_CONFIG_USB_STORAGE
	select UBOOT_CONFIG_USB_KEYBOARD

endif
```

## maxlinear/feed_uboot/open_uboot/config/board/inversepath/usbarmory/Kconfig
```kconfig
if UBOOT_CONFIG_TARGET_USBARMORY

config UBOOT_CONFIG_IMX_CONFIG
	default "board/inversepath/usbarmory/imximage.cfg"

config UBOOT_CONFIG_SYS_BOARD
	default "usbarmory"

config UBOOT_CONFIG_SYS_VENDOR
	default "inversepath"

config UBOOT_CONFIG_SYS_CONFIG_NAME
	default "usbarmory"

endif
```

## maxlinear/feed_uboot/open_uboot/config/board/iomega/iconnect/Kconfig
```kconfig
if UBOOT_CONFIG_TARGET_ICONNECT

config UBOOT_CONFIG_SYS_BOARD
	default "iconnect"

config UBOOT_CONFIG_SYS_VENDOR
	default "iomega"

config UBOOT_CONFIG_SYS_CONFIG_NAME
	default "iconnect"

endif
```

## maxlinear/feed_uboot/open_uboot/config/board/isee/igep00x0/Kconfig
```kconfig
if UBOOT_CONFIG_TARGET_OMAP3_IGEP00X0

config UBOOT_CONFIG_SYS_BOARD
	default "igep00x0"

config UBOOT_CONFIG_SYS_VENDOR
	default "isee"

config UBOOT_CONFIG_SYS_CONFIG_NAME
	default "omap3_igep00x0"

source "../../../board/ti/common/Kconfig"

endif
```

## maxlinear/feed_uboot/open_uboot/config/board/k+p/kp_imx53/Kconfig
```kconfig
if UBOOT_CONFIG_TARGET_KP_IMX53

config UBOOT_CONFIG_SYS_BOARD
	default "kp_imx53"

config UBOOT_CONFIG_SYS_VENDOR
	default "k+p"

config UBOOT_CONFIG_SYS_SOC
	default "mx5"

config UBOOT_CONFIG_SYS_CONFIG_NAME
	default "kp_imx53"

config UBOOT_CONFIG_IMX_CONFIG
	default "board/freescale/mx53loco/imximage.cfg"

endif
```

## maxlinear/feed_uboot/open_uboot/config/board/k+p/kp_imx6q_tpc/Kconfig
```kconfig
if UBOOT_CONFIG_TARGET_KP_IMX6Q_TPC

config UBOOT_CONFIG_SYS_BOARD
	default "kp_imx6q_tpc"

config UBOOT_CONFIG_SYS_VENDOR
	default "k+p"

config UBOOT_CONFIG_SYS_CONFIG_NAME
	default "kp_imx6q_tpc"

endif
```

## maxlinear/feed_uboot/open_uboot/config/board/kobol/helios4/Kconfig
```kconfig
menu "Helios4 configuration"
	depends on UBOOT_CONFIG_TARGET_HELIOS4

config UBOOT_CONFIG_ENV_SIZE
	hex "Environment Size"
	default 0x10000

config UBOOT_CONFIG_ENV_OFFSET
	hex "Environment offset"
	default 0xF0000

config UBOOT_CONFIG_ENV_SECT_SIZE
	hex "Environment Sector-Size"
	# Use SPI or SATA flash erase block size of 4 KiB
	default 0x1000 if UBOOT_CONFIG_MVEBU_SPL_BOOT_DEVICE_SPI || UBOOT_CONFIG_MVEBU_SPL_BOOT_DEVICE_SATA
	# Use optimistic 64 KiB erase block, will vary between actual media
	default 0x10000 if UBOOT_CONFIG_MVEBU_SPL_BOOT_DEVICE_MMC || UBOOT_CONFIG_MVEBU_SPL_BOOT_DEVICE_UART

endmenu
```

## maxlinear/feed_uboot/open_uboot/config/board/kontron/sl-mx6ul/Kconfig
```kconfig
if UBOOT_CONFIG_TARGET_KONTRON_MX6UL

config UBOOT_CONFIG_SYS_BOARD
	string
	default "sl-mx6ul"

config UBOOT_CONFIG_SYS_VENDOR
	string
	default "kontron"

config UBOOT_CONFIG_SYS_CONFIG_NAME
	string
	default "kontron-sl-mx6ul"

endif
```
