## maxlinear/feed_uboot/open_uboot/config/board/kontron/sl28/Kconfig
```kconfig
if UBOOT_CONFIG_TARGET_SL28

config UBOOT_CONFIG_SYS_BOARD
	default "sl28"

config UBOOT_CONFIG_SYS_VENDOR
	default "kontron"

config UBOOT_CONFIG_SYS_SOC
	default "fsl-layerscape"

config UBOOT_CONFIG_SYS_CONFIG_NAME
	default "kontron_sl28"

config UBOOT_CONFIG_SYS_TEXT_BASE
	default 0x96000000

config UBOOT_CONFIG_SL28_SPL_LOADS_ATF_BL31
	bool "SPL loads BL31 of the ARM Trusted Firmware"
	select UBOOT_CONFIG_SPL_ATF
	select UBOOT_CONFIG_SPL_ATF_LOAD_IMAGE_V2
	select UBOOT_CONFIG_ARMV8_SEC_FIRMWARE_SUPPORT
	select UBOOT_CONFIG_SEC_FIRMWARE_ARMV8_PSCI
	help
	  Enable this to load a BL31 image by the SPL. You have to
	  provde a bl31.bin in u-boot's root directory.

if UBOOT_CONFIG_SL28_SPL_LOADS_ATF_BL31

config UBOOT_CONFIG_SL28_BL31_ENTRY_ADDR
	hex "Entry point of the BL31 image"
	default 0xfbe00000

endif

config UBOOT_CONFIG_SL28_SPL_LOADS_OPTEE_BL32
	bool "SPL loads OP-TEE Trusted OS as BL32"
	depends on UBOOT_CONFIG_SL28_SPL_LOADS_ATF_BL31
	help
	  Enable this to load a BL32 image by the SPL. You have to
	  provde a tee.bin in u-boot's root directory.

if UBOOT_CONFIG_SL28_SPL_LOADS_OPTEE_BL32

config UBOOT_CONFIG_SL28_BL32_ENTRY_ADDR
	hex "Entry point of the BL32 image"
	default 0xfc000000

endif

config UBOOT_CONFIG_SL28_ENABLE_SER0_CONSOLE
	bool "Enable console output on SER0"
	select UBOOT_CONFIG_DM_SERIAL
	select UBOOT_CONFIG_SPL_DM_SERIAL
	select UBOOT_CONFIG_FSL_LPUART
	help
	  By default the console output of this board is on the second serial
	  line (SER1). Sometimes it is desirable to enable output on the first
	  serial line (SER0). For example, if you have a carrier which only
	  supports the first serial port.
endif
```

## maxlinear/feed_uboot/open_uboot/config/board/lg/sniper/Kconfig
```kconfig
if UBOOT_CONFIG_TARGET_SNIPER

config UBOOT_CONFIG_SYS_BOARD
	default "sniper"

config UBOOT_CONFIG_SYS_VENDOR
	default "lg"

config UBOOT_CONFIG_SYS_CONFIG_NAME
	default "sniper"

endif
```

## maxlinear/feed_uboot/open_uboot/config/board/liebherr/mccmon6/Kconfig
```kconfig
if UBOOT_CONFIG_TARGET_MCCMON6

config UBOOT_CONFIG_SYS_BOARD
	default "mccmon6"

config UBOOT_CONFIG_SYS_VENDOR
	default "liebherr"

config UBOOT_CONFIG_SYS_CONFIG_NAME
	default "mccmon6"

endif
```

## maxlinear/feed_uboot/open_uboot/config/board/logicpd/am3517evm/Kconfig
```kconfig
if UBOOT_CONFIG_TARGET_AM3517_EVM

config UBOOT_CONFIG_SYS_BOARD
	default "am3517evm"

config UBOOT_CONFIG_SYS_VENDOR
	default "logicpd"

config UBOOT_CONFIG_SYS_CONFIG_NAME
	default "am3517_evm"

source "../../../board/ti/common/Kconfig"

endif
```

## maxlinear/feed_uboot/open_uboot/config/board/logicpd/imx6/Kconfig
```kconfig
if UBOOT_CONFIG_TARGET_MX6LOGICPD

config UBOOT_CONFIG_SYS_BOARD
       default "imx6"

config UBOOT_CONFIG_SYS_VENDOR
       default "logicpd"

config UBOOT_CONFIG_SYS_CONFIG_NAME
       default "imx6_logic"

endif
```
