## maxlinear/feed_uboot/open_uboot/config/board/Marvell/guruplug/Kconfig
```kconfig
if UBOOT_CONFIG_TARGET_GURUPLUG

config UBOOT_CONFIG_SYS_BOARD
	default "guruplug"

config UBOOT_CONFIG_SYS_VENDOR
	default "Marvell"

config UBOOT_CONFIG_SYS_CONFIG_NAME
	default "guruplug"

endif
```

## maxlinear/feed_uboot/open_uboot/config/board/Marvell/octeon_nic23/Kconfig
```kconfig
if UBOOT_CONFIG_TARGET_OCTEON_NIC23

config UBOOT_CONFIG_SYS_BOARD
	string
	default "octeon_nic23"

config UBOOT_CONFIG_SYS_VENDOR
	string
	default "Marvell"

config UBOOT_CONFIG_SYS_CONFIG_NAME
	string
	default "octeon_nic23"

config UBOOT_CONFIG_DEFAULT_DEVICE_TREE
	string
	default "mrvl,octeon-nic23"

endif
```

## maxlinear/feed_uboot/open_uboot/config/board/Seagate/goflexhome/Kconfig
```kconfig
if UBOOT_CONFIG_TARGET_GOFLEXHOME

config UBOOT_CONFIG_SYS_BOARD
	default "goflexhome"

config UBOOT_CONFIG_SYS_VENDOR
	default "Seagate"

config UBOOT_CONFIG_SYS_CONFIG_NAME
	default "goflexhome"

endif
```

## maxlinear/feed_uboot/open_uboot/config/board/Seagate/nas220/Kconfig
```kconfig
if UBOOT_CONFIG_TARGET_NAS220

config UBOOT_CONFIG_SYS_BOARD
	default "nas220"

config UBOOT_CONFIG_SYS_VENDOR
	default "Seagate"

config UBOOT_CONFIG_SYS_CONFIG_NAME
	default "nas220"

endif
```

## maxlinear/feed_uboot/open_uboot/config/board/Synology/ds414/Kconfig
```kconfig
if UBOOT_CONFIG_TARGET_DS414

config UBOOT_CONFIG_SYS_BOARD
	default "ds414"

config UBOOT_CONFIG_SYS_VENDOR
	default "Synology"

config UBOOT_CONFIG_SYS_CONFIG_NAME
	default "ds414"

endif
```

## maxlinear/feed_uboot/open_uboot/config/board/alliedtelesis/SBx81LIFKW/Kconfig
```kconfig
if UBOOT_CONFIG_TARGET_SBx81LIFKW

config UBOOT_CONFIG_SYS_BOARD
       default "SBx81LIFKW"

config UBOOT_CONFIG_SYS_VENDOR
       default "alliedtelesis"

config UBOOT_CONFIG_SYS_CONFIG_NAME
       default "SBx81LIFKW"

endif
```

## maxlinear/feed_uboot/open_uboot/config/board/alliedtelesis/SBx81LIFXCAT/Kconfig
```kconfig
if UBOOT_CONFIG_TARGET_SBx81LIFXCAT

config UBOOT_CONFIG_SYS_BOARD
       default "SBx81LIFXCAT"

config UBOOT_CONFIG_SYS_VENDOR
       default "alliedtelesis"

config UBOOT_CONFIG_SYS_CONFIG_NAME
       default "SBx81LIFXCAT"

endif
```

## maxlinear/feed_uboot/open_uboot/config/board/aristainetos/Kconfig
```kconfig
if UBOOT_CONFIG_TARGET_ARISTAINETOS2C

source "common/Kconfig"

config UBOOT_CONFIG_SYS_BOARD
	default "aristainetos"

config UBOOT_CONFIG_SYS_BOARD_VERSION
	default 5

config UBOOT_CONFIG_IMX_CONFIG
	default "board/aristainetos/aristainetos2.cfg"

endif

if UBOOT_CONFIG_TARGET_ARISTAINETOS2CCSLB

source "common/Kconfig"

config UBOOT_CONFIG_SYS_BOARD
	default "aristainetos"

config UBOOT_CONFIG_SYS_BOARD_VERSION
	default 6

config UBOOT_CONFIG_IMX_CONFIG
	default "board/aristainetos/aristainetos2.cfg"

endif
```

## maxlinear/feed_uboot/open_uboot/config/board/aristainetos/common/Kconfig
```kconfig
config UBOOT_CONFIG_SYS_BOARD_VERSION
	int "select version of aristainetos board"
	help
	  version of aristainetos board version
	  5 version 2c and 2d
	  6 version 2c-cslb

config UBOOT_CONFIG_SYS_I2C_MXC_I2C1
	default y

config UBOOT_CONFIG_SYS_I2C_MXC_I2C2
	default y

config UBOOT_CONFIG_SYS_I2C_MXC_I2C3
	default y

config UBOOT_CONFIG_SYS_I2C_MXC_I2C4
	default y

config UBOOT_CONFIG_SYS_MALLOC_LEN
	default 0x4000000

config UBOOT_CONFIG_ENV_SIZE
	default 0x3000

config UBOOT_CONFIG_ENV_SECT_SIZE
	default 0x10000

config UBOOT_CONFIG_ENV_OFFSET
	default 0xd0000

config UBOOT_CONFIG_SYS_CONFIG_NAME
	default "aristainetos2"
```

## maxlinear/feed_uboot/open_uboot/config/board/armltd/vexpress/Kconfig
```kconfig
if UBOOT_CONFIG_TARGET_VEXPRESS_CA9X4

config UBOOT_CONFIG_SYS_BOARD
	default "vexpress"

config UBOOT_CONFIG_SYS_VENDOR
	default "armltd"

config UBOOT_CONFIG_SYS_CONFIG_NAME
	default "vexpress_ca9x4"

endif
```

## maxlinear/feed_uboot/open_uboot/config/board/armltd/vexpress64/Kconfig
```kconfig
if UBOOT_CONFIG_TARGET_VEXPRESS64_BASE_FVP || UBOOT_CONFIG_TARGET_VEXPRESS64_JUNO

config UBOOT_CONFIG_SYS_BOARD
	default "vexpress64"

config UBOOT_CONFIG_SYS_VENDOR
	default "armltd"

config UBOOT_CONFIG_SYS_CONFIG_NAME
	default "vexpress_aemv8a"

config UBOOT_CONFIG_JUNO_DTB_PART
	string "NOR flash partition holding DTB"
	default "board.dtb"
	help
	  The ARM partition name in the NOR flash memory holding the
	  device tree blob to configure U-Boot.

endif
```

## maxlinear/feed_uboot/open_uboot/config/board/aspeed/evb_ast2500/Kconfig
```kconfig
if UBOOT_CONFIG_TARGET_EVB_AST2500

config UBOOT_CONFIG_SYS_BOARD
	default "evb_ast2500"

config UBOOT_CONFIG_SYS_VENDOR
	default "aspeed"

config UBOOT_CONFIG_SYS_CONFIG_NAME
	default "evb_ast2500"

endif
```

## maxlinear/feed_uboot/open_uboot/config/board/astro/mcf5373l/Kconfig
```kconfig
if UBOOT_CONFIG_TARGET_ASTRO_MCF5373L

config UBOOT_CONFIG_SYS_CPU
	default "mcf532x"

config UBOOT_CONFIG_SYS_BOARD
	default "mcf5373l"

config UBOOT_CONFIG_SYS_VENDOR
	default "astro"

config UBOOT_CONFIG_SYS_CONFIG_NAME
	default "astro_mcf5373l"

endif
```

## maxlinear/feed_uboot/open_uboot/config/board/atmark-techno/armadillo-800eva/Kconfig
```kconfig
if UBOOT_CONFIG_TARGET_ARMADILLO_800EVA

config UBOOT_CONFIG_SYS_BOARD
	default "armadillo-800eva"

config UBOOT_CONFIG_SYS_VENDOR
	default "atmark-techno"

config UBOOT_CONFIG_SYS_CONFIG_NAME
	default "armadillo-800eva"

endif
```

## maxlinear/feed_uboot/open_uboot/config/board/atmel/at91sam9263ek/Kconfig
```kconfig
if UBOOT_CONFIG_TARGET_AT91SAM9263EK

config UBOOT_CONFIG_SYS_BOARD
	default "at91sam9263ek"

config UBOOT_CONFIG_SYS_VENDOR
	default "atmel"

config UBOOT_CONFIG_SYS_CONFIG_NAME
	default "at91sam9263ek"

endif
```

## maxlinear/feed_uboot/open_uboot/config/board/atmel/at91sam9m10g45ek/Kconfig
```kconfig
if UBOOT_CONFIG_TARGET_AT91SAM9M10G45EK

config UBOOT_CONFIG_SYS_BOARD
	default "at91sam9m10g45ek"

config UBOOT_CONFIG_SYS_VENDOR
	default "atmel"

config UBOOT_CONFIG_SYS_CONFIG_NAME
	default "at91sam9m10g45ek"

endif
```

## maxlinear/feed_uboot/open_uboot/config/board/atmel/at91sam9n12ek/Kconfig
```kconfig
if UBOOT_CONFIG_TARGET_AT91SAM9N12EK

config UBOOT_CONFIG_SYS_BOARD
	default "at91sam9n12ek"

config UBOOT_CONFIG_SYS_VENDOR
	default "atmel"

config UBOOT_CONFIG_SYS_CONFIG_NAME
	default "at91sam9n12ek"

endif
```

## maxlinear/feed_uboot/open_uboot/config/board/atmel/sama5d2_icp/Kconfig
```kconfig
if UBOOT_CONFIG_TARGET_SAMA5D2_ICP

config UBOOT_CONFIG_SYS_BOARD
	default "sama5d2_icp"

config UBOOT_CONFIG_SYS_VENDOR
	default "atmel"

config UBOOT_CONFIG_SYS_SOC
	default "at91"

config UBOOT_CONFIG_SYS_CONFIG_NAME
	default "sama5d2_icp"

endif
```

## maxlinear/feed_uboot/open_uboot/config/board/atmel/sama5d2_ptc_ek/Kconfig
```kconfig
if UBOOT_CONFIG_TARGET_SAMA5D2_PTC_EK

config UBOOT_CONFIG_SYS_BOARD
	default "sama5d2_ptc_ek"

config UBOOT_CONFIG_SYS_VENDOR
	default "atmel"

config UBOOT_CONFIG_SYS_SOC
	default "at91"

config UBOOT_CONFIG_SYS_CONFIG_NAME
	default "sama5d2_ptc_ek"

endif
```

## maxlinear/feed_uboot/open_uboot/config/board/atmel/sama5d2_xplained/Kconfig
```kconfig
if UBOOT_CONFIG_TARGET_SAMA5D2_XPLAINED

config UBOOT_CONFIG_SYS_BOARD
	default "sama5d2_xplained"

config UBOOT_CONFIG_SYS_VENDOR
	default "atmel"

config UBOOT_CONFIG_SYS_SOC
	default "at91"

config UBOOT_CONFIG_SYS_CONFIG_NAME
	default "sama5d2_xplained"

endif
```

## maxlinear/feed_uboot/open_uboot/config/board/atmel/sama5d3_xplained/Kconfig
```kconfig
if UBOOT_CONFIG_TARGET_SAMA5D3_XPLAINED

config UBOOT_CONFIG_SYS_BOARD
	default "sama5d3_xplained"

config UBOOT_CONFIG_SYS_VENDOR
	default "atmel"

config UBOOT_CONFIG_SYS_CONFIG_NAME
	default "sama5d3_xplained"

endif
```

## maxlinear/feed_uboot/open_uboot/config/board/atmel/sama5d4_xplained/Kconfig
```kconfig
if UBOOT_CONFIG_TARGET_SAMA5D4_XPLAINED

config UBOOT_CONFIG_SYS_BOARD
	default "sama5d4_xplained"

config UBOOT_CONFIG_SYS_VENDOR
	default "atmel"

config UBOOT_CONFIG_SYS_CONFIG_NAME
	default "sama5d4_xplained"

endif
```

## maxlinear/feed_uboot/open_uboot/config/board/avionic-design/tec-ng/Kconfig
```kconfig
if UBOOT_CONFIG_TARGET_TEC_NG

config UBOOT_CONFIG_SYS_BOARD
	default "tec-ng"

config UBOOT_CONFIG_SYS_VENDOR
	default "avionic-design"

config UBOOT_CONFIG_SYS_CONFIG_NAME
	default "tec-ng"

endif
```

## maxlinear/feed_uboot/open_uboot/config/board/beacon/imx8mm/Kconfig
```kconfig
if UBOOT_CONFIG_TARGET_IMX8MM_BEACON

config UBOOT_CONFIG_SYS_BOARD
	default "imx8mm"

config UBOOT_CONFIG_SYS_VENDOR
	default "beacon"

config UBOOT_CONFIG_SYS_CONFIG_NAME
	default "imx8mm_beacon"

config UBOOT_CONFIG_IMX_CONFIG
	default "board/beacon/imx8mm/imximage-8mm-lpddr4.cfg"

source "../../../board/freescale/common/Kconfig"

endif
```

## maxlinear/feed_uboot/open_uboot/config/board/beacon/imx8mn/Kconfig
```kconfig
if UBOOT_CONFIG_TARGET_IMX8MN_BEACON

config UBOOT_CONFIG_SYS_BOARD
	default "imx8mn"

config UBOOT_CONFIG_SYS_VENDOR
	default "beacon"

config UBOOT_CONFIG_SYS_CONFIG_NAME
	default "imx8mn_beacon"

config UBOOT_CONFIG_IMX8MN_FORCE_NOM_SOC
	bool "Force to use nominal mode for SOC and ARM"

config UBOOT_CONFIG_IMX8MN_BEACON_2GB_LPDDR
	bool "Enable 2GB LPDDR"

config UBOOT_CONFIG_IMX_CONFIG
	default "board/beacon/imx8mn/imximage-8mn-lpddr4.cfg"

source "../../../board/freescale/common/Kconfig"

endif
```
