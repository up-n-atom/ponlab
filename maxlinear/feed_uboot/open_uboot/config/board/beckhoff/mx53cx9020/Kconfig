## maxlinear/feed_uboot/open_uboot/config/board/beckhoff/mx53cx9020/Kconfig
```kconfig
if UBOOT_CONFIG_TARGET_MX53CX9020

config UBOOT_CONFIG_SYS_BOARD
	default "mx53cx9020"

config UBOOT_CONFIG_SYS_VENDOR
	default "beckhoff"

config UBOOT_CONFIG_SYS_CONFIG_NAME
	default "mx53cx9020"

config UBOOT_CONFIG_IMX_CONFIG
	default "board/beckhoff/mx53cx9020/imximage.cfg"

endif
```

## maxlinear/feed_uboot/open_uboot/config/board/bluewater/gurnard/Kconfig
```kconfig
if UBOOT_CONFIG_TARGET_GURNARD

config UBOOT_CONFIG_SYS_BOARD
	default "gurnard"

config UBOOT_CONFIG_SYS_VENDOR
	default "bluewater"

config UBOOT_CONFIG_SYS_CONFIG_NAME
	default "snapper9g45"

endif
```

## maxlinear/feed_uboot/open_uboot/config/board/bluewater/snapper9260/Kconfig
```kconfig
if UBOOT_CONFIG_TARGET_SNAPPER9260

config UBOOT_CONFIG_SYS_BOARD
	default "snapper9260"

config UBOOT_CONFIG_SYS_VENDOR
	default "bluewater"

config UBOOT_CONFIG_SYS_CONFIG_NAME
	default "snapper9260"

endif
```

## maxlinear/feed_uboot/open_uboot/config/board/bosch/guardian/Kconfig
```kconfig
if UBOOT_CONFIG_TARGET_AM335X_GUARDIAN

config UBOOT_CONFIG_SYS_BOARD
	default "guardian"

config UBOOT_CONFIG_SYS_VENDOR
	default "bosch"

config UBOOT_CONFIG_SYS_SOC
	default "am33xx"

config UBOOT_CONFIG_SYS_CONFIG_NAME
	default "am335x_guardian"

endif
```

## maxlinear/feed_uboot/open_uboot/config/board/bosch/shc/Kconfig
```kconfig
if UBOOT_CONFIG_TARGET_AM335X_SHC

config UBOOT_CONFIG_SYS_BOARD
	default "shc"

config UBOOT_CONFIG_SYS_VENDOR
	default "bosch"

config UBOOT_CONFIG_SYS_SOC
	default "am33xx"

config UBOOT_CONFIG_SYS_CONFIG_NAME
	default "am335x_shc"

choice
	prompt "enable different boot versions for the shc board"
	default UBOOT_CONFIG_SHC_EMMC
	help
	  Select the boot version of the shc board.

config UBOOT_CONFIG_SHC_EMMC
	bool "enable eMMC"
	help
	  enable here the eMMC functionality on the bosch shc board.

config UBOOT_CONFIG_SHC_ICT
	bool "enable ICT"
	help
	  enable here the ICT functionality on the bosch shc board

config UBOOT_CONFIG_SHC_NETBOOT
	bool "enable NETBOOT"
	help
	  enable here the NETBOOT functionality on the bosch shc board

config UBOOT_CONFIG_SHC_SDBOOT
	bool "enable SDBOOT"
	help
	  enable here the SDBOOT functionality on the bosch shc board

endchoice

choice
	prompt "enable different board versions for the shc board"
	default UBOOT_CONFIG_C3_SAMPLE
	help
	  Select the board version of the shc board.

config UBOOT_CONFIG_B_SAMPLE
	bool "B Sample board version"
	help
	  activate, if you want to build for the B sample version
	  of the bosch shc board

config UBOOT_CONFIG_B2_SAMPLE
	bool "B2 Sample board version"
	help
	  activate, if you want to build for the B2 sample version
	  of the bosch shc board

config UBOOT_CONFIG_C_SAMPLE
	bool "C Sample board version"
	help
	  activate, if you want to build for the C sample version
	  of the bosch shc board

config UBOOT_CONFIG_C2_SAMPLE
	bool "C2 Sample board version"
	help
	  activate, if you want to build for the C2 sample version
	  of the bosch shc board

config UBOOT_CONFIG_C3_SAMPLE
	bool "C3 Sample board version"
	help
	  activate, if you want to build for the C3 sample version
	  of the bosch shc board

config UBOOT_CONFIG_SERIES
	bool "Series board version"
	help
	  activate, if you want to build for the Series version
	  of the bosch shc board

endchoice

endif
```

## maxlinear/feed_uboot/open_uboot/config/board/boundary/nitrogen6x/Kconfig
```kconfig
if UBOOT_CONFIG_TARGET_NITROGEN6X

config UBOOT_CONFIG_SYS_BOARD
	default "nitrogen6x"

config UBOOT_CONFIG_SYS_VENDOR
	default "boundary"

config UBOOT_CONFIG_SYS_CONFIG_NAME
	default "nitrogen6x"

config UBOOT_CONFIG_DDR_MB
	int "Memory size in MB"

endif
```

## maxlinear/feed_uboot/open_uboot/config/board/broadcom/bcm968380gerg/Kconfig
```kconfig
if UBOOT_CONFIG_BOARD_BROADCOM_BCM968380GERG

config UBOOT_CONFIG_SYS_BOARD
	default "bcm968380gerg"

config UBOOT_CONFIG_SYS_VENDOR
	default "broadcom"

config UBOOT_CONFIG_SYS_CONFIG_NAME
	default "broadcom_bcm968380gerg"

endif
```

## maxlinear/feed_uboot/open_uboot/config/board/broadcom/bcm968580xref/Kconfig
```kconfig
if UBOOT_CONFIG_ARCH_BCM6858

config UBOOT_CONFIG_SYS_VENDOR
	default "broadcom"

config UBOOT_CONFIG_SYS_BOARD
	default "bcm968580xref"

config UBOOT_CONFIG_SYS_CONFIG_NAME
	default "broadcom_bcm968580xref"

endif

config UBOOT_CONFIG_TARGET_BCM968580XREF
	bool "Support Broadcom bcm968580xref"
	depends on UBOOT_CONFIG_ARCH_BCM6858
	select UBOOT_CONFIG_ARM64
```

## maxlinear/feed_uboot/open_uboot/config/board/broadcom/bcmns3/Kconfig
```kconfig
if UBOOT_CONFIG_TARGET_BCMNS3

config UBOOT_CONFIG_SYS_BOARD
	default "bcmns3"

config UBOOT_CONFIG_SYS_VENDOR
	default "broadcom"

config UBOOT_CONFIG_SYS_SOC
	default "bcmns3"

config UBOOT_CONFIG_SYS_CONFIG_NAME
	default "bcm_ns3"

config UBOOT_CONFIG_CMD_BCM_EXT_UTILS
	bool "Enable Broadcom-specific U-Boot commands"
	default y
	help
	  Enable Broadcom specific U-Boot commands such as error log setup
	  command or any other commands specific to NS3 platform.

endif
```

## maxlinear/feed_uboot/open_uboot/config/board/bticino/mamoj/Kconfig
```kconfig
if UBOOT_CONFIG_TARGET_MX6DL_MAMOJ

config UBOOT_CONFIG_SYS_BOARD
	default "mamoj"

config UBOOT_CONFIG_SYS_VENDOR
	default "bticino"

config UBOOT_CONFIG_SYS_CONFIG_NAME
	default "imx6dl-mamoj"

endif
```

## maxlinear/feed_uboot/open_uboot/config/board/cadence/xtfpga/Kconfig
```kconfig
if UBOOT_CONFIG_TARGET_XTFPGA

choice
	prompt "XTFPGA board type select"

config UBOOT_CONFIG_XTFPGA_LX60
	bool "Support Avnet LX60"
config UBOOT_CONFIG_XTFPGA_LX110
	bool "Support Avnet LX110"
config UBOOT_CONFIG_XTFPGA_LX200
	bool "Support Avnet LX200"
config UBOOT_CONFIG_XTFPGA_ML605
	bool "Support Xilinx ML605"
config UBOOT_CONFIG_XTFPGA_KC705
	bool "Support Xilinx KC705"

endchoice

config UBOOT_CONFIG_SYS_BOARD
	string
	default "xtfpga"

config UBOOT_CONFIG_SYS_VENDOR
	string
	default "cadence"

config UBOOT_CONFIG_SYS_CONFIG_NAME
	string
	default "xtfpga"

config UBOOT_CONFIG_BOARD_SDRAM_SIZE
	hex
	default 0x04000000 if UBOOT_CONFIG_XTFPGA_LX60
	default 0x03000000 if UBOOT_CONFIG_XTFPGA_LX110
	default 0x06000000 if UBOOT_CONFIG_XTFPGA_LX200
	default 0x18000000 if UBOOT_CONFIG_XTFPGA_ML605
	default 0x38000000 if UBOOT_CONFIG_XTFPGA_KC705

endif
```

## maxlinear/feed_uboot/open_uboot/config/board/calao/usb_a9263/Kconfig
```kconfig
if UBOOT_CONFIG_TARGET_USB_A9263

config UBOOT_CONFIG_SYS_BOARD
	default "usb_a9263"

config UBOOT_CONFIG_SYS_VENDOR
	default "calao"

config UBOOT_CONFIG_SYS_CONFIG_NAME
	default "usb_a9263"

endif
```

## maxlinear/feed_uboot/open_uboot/config/board/cei/cei-tk1-som/Kconfig
```kconfig
if UBOOT_CONFIG_TARGET_CEI_TK1_SOM

config UBOOT_CONFIG_SYS_BOARD
	default "cei-tk1-som"

config UBOOT_CONFIG_SYS_VENDOR
	default "cei"

config UBOOT_CONFIG_SYS_CONFIG_NAME
	default "cei-tk1-som"

endif
```

## maxlinear/feed_uboot/open_uboot/config/board/cobra5272/Kconfig
```kconfig
if UBOOT_CONFIG_TARGET_COBRA5272

config UBOOT_CONFIG_SYS_CPU
	default "mcf52x2"

config UBOOT_CONFIG_SYS_BOARD
	default "cobra5272"

config UBOOT_CONFIG_SYS_CONFIG_NAME
	default "cobra5272"

endif
```

## maxlinear/feed_uboot/open_uboot/config/board/compulab/cl-som-imx7/Kconfig
```kconfig
if UBOOT_CONFIG_TARGET_CL_SOM_IMX7

config UBOOT_CONFIG_SYS_BOARD
	default "cl-som-imx7"

config UBOOT_CONFIG_SYS_VENDOR
	default "compulab"

config UBOOT_CONFIG_SYS_CONFIG_NAME
	default "cl-som-imx7"

config UBOOT_CONFIG_SYS_MMC_DEV
	int
	default 0

config UBOOT_CONFIG_SYS_USB_DEV
	int
	default 0

config UBOOT_CONFIG_SYS_MMC_IMG_LOAD_PART
	int
	default 1

config UBOOT_CONFIG_SYS_USB_IMG_LOAD_PART
	int
	default 1

endif
```

## maxlinear/feed_uboot/open_uboot/config/board/compulab/cm_fx6/Kconfig
```kconfig
if UBOOT_CONFIG_TARGET_CM_FX6

config UBOOT_CONFIG_SYS_BOARD
	default "cm_fx6"

config UBOOT_CONFIG_SYS_VENDOR
	default "compulab"

config UBOOT_CONFIG_SYS_CONFIG_NAME
	default "cm_fx6"

endif
```

## maxlinear/feed_uboot/open_uboot/config/board/comtrend/ar5315u/Kconfig
```kconfig
if UBOOT_CONFIG_BOARD_COMTREND_AR5315U

config UBOOT_CONFIG_SYS_BOARD
	default "ar5315u"

config UBOOT_CONFIG_SYS_VENDOR
	default "comtrend"

config UBOOT_CONFIG_SYS_CONFIG_NAME
	default "comtrend_ar5315u"

endif
```

## maxlinear/feed_uboot/open_uboot/config/board/comtrend/ct5361/Kconfig
```kconfig
if UBOOT_CONFIG_BOARD_COMTREND_CT5361

config UBOOT_CONFIG_SYS_BOARD
	default "ct5361"

config UBOOT_CONFIG_SYS_VENDOR
	default "comtrend"

config UBOOT_CONFIG_SYS_CONFIG_NAME
	default "comtrend_ct5361"

endif
```

## maxlinear/feed_uboot/open_uboot/config/board/comtrend/vr3032u/Kconfig
```kconfig
if UBOOT_CONFIG_BOARD_COMTREND_VR3032U

config UBOOT_CONFIG_SYS_BOARD
	default "vr3032u"

config UBOOT_CONFIG_SYS_VENDOR
	default "comtrend"

config UBOOT_CONFIG_SYS_CONFIG_NAME
	default "comtrend_vr3032u"

endif
```

## maxlinear/feed_uboot/open_uboot/config/board/comtrend/wap5813n/Kconfig
```kconfig
if UBOOT_CONFIG_BOARD_COMTREND_WAP5813N

config UBOOT_CONFIG_SYS_BOARD
	default "wap5813n"

config UBOOT_CONFIG_SYS_VENDOR
	default "comtrend"

config UBOOT_CONFIG_SYS_CONFIG_NAME
	default "comtrend_wap5813n"

endif
```

## maxlinear/feed_uboot/open_uboot/config/board/congatec/cgtqmx8/Kconfig
```kconfig
if UBOOT_CONFIG_TARGET_CONGA_QMX8

config UBOOT_CONFIG_SYS_BOARD
	default "cgtqmx8"

config UBOOT_CONFIG_SYS_VENDOR
	default "congatec"

config UBOOT_CONFIG_SYS_CONFIG_NAME
	default "cgtqmx8"

config UBOOT_CONFIG_IMX_CONFIG
	default "board/congatec/cgtqmx8/imximage.cfg"

source "../../../board/congatec/common/Kconfig"

endif
```

## maxlinear/feed_uboot/open_uboot/config/board/congatec/common/Kconfig
```kconfig
if !ARCH_IMX8M && !UBOOT_CONFIG_ARCH_IMX8

config UBOOT_CONFIG_CHAIN_OF_TRUST
	depends on !UBOOT_CONFIG_FIT_SIGNATURE && UBOOT_CONFIG_SECURE_BOOT
	imply CMD_BLOB
	imply CMD_HASH if ARM
	select UBOOT_CONFIG_FSL_CAAM
	select UBOOT_CONFIG_SPL_BOARD_INIT if (ARM && UBOOT_CONFIG_SPL)
	select UBOOT_CONFIG_SHA_HW_ACCEL
	select UBOOT_CONFIG_SHA_PROG_HW_ACCEL
	select UBOOT_CONFIG_ENV_IS_NOWHERE
	select UBOOT_CONFIG_CMD_EXT4 if ARM
	select UBOOT_CONFIG_CMD_EXT4_WRITE if ARM
	bool
	default y

config UBOOT_CONFIG_CMD_ESBC_VALIDATE
	bool "Enable the 'esbc_validate' and 'esbc_halt' commands"
	default y if UBOOT_CONFIG_CHAIN_OF_TRUST
	help
	  This option enables two commands used for secure booting:

	    esbc_validate - validate signature using RSA verification
	    esbc_halt - put the core in spin loop (Secure Boot Only)

endif

config UBOOT_CONFIG_VOL_MONITOR_LTC3882_READ
	depends on UBOOT_CONFIG_VID
	bool "Enable the LTC3882 voltage monitor read"
	help
	 This option enables LTC3882 voltage monitor read
	 functionality. It is used by common VID driver.

config UBOOT_CONFIG_VOL_MONITOR_LTC3882_SET
	depends on UBOOT_CONFIG_VID
	bool "Enable the LTC3882 voltage monitor set"
	help
	 This option enables LTC3882 voltage monitor set
	 functionality. It is used by common VID driver.

config UBOOT_CONFIG_USB_TCPC
	bool "USB Typec port controller simple driver"
	help
	  Enable USB type-c port controller (TCPC) driver
```

## maxlinear/feed_uboot/open_uboot/config/board/congatec/conga-qeval20-qa3-e3845/Kconfig
```kconfig
config UBOOT_CONFIG_SYS_BOARD
	default "conga-qeval20-qa3-e3845"

config UBOOT_CONFIG_SYS_VENDOR
	default "congatec"

config UBOOT_CONFIG_SYS_SOC
	default "baytrail"

config UBOOT_CONFIG_SYS_CONFIG_NAME
	default "conga-qeval20-qa3-e3845" if UBOOT_CONFIG_TARGET_CONGA_QEVAL20_QA3_E3845
	default "theadorable-x86-conga-qa3-e3845" if UBOOT_CONFIG_TARGET_THEADORABLE_X86_CONGA_QA3_E3845

config UBOOT_CONFIG_SYS_TEXT_BASE
	default 0xfff00000

config UBOOT_CONFIG_BOARD_SPECIFIC_OPTIONS # dummy
	def_bool y
	select UBOOT_CONFIG_X86_RESET_VECTOR
	select UBOOT_CONFIG_INTEL_BAYTRAIL
	select UBOOT_CONFIG_BOARD_ROMSIZE_KB_8192
	select UBOOT_CONFIG_BOARD_EARLY_INIT_F
	select UBOOT_CONFIG_BOARD_LATE_INIT
	select UBOOT_CONFIG_SPI_FLASH_STMICRO
	imply SPI_FLASH_SPANSION
	imply SPI_FLASH_WINBOND
	select UBOOT_CONFIG_SERIAL_RX_BUFFER

config UBOOT_CONFIG_PCIE_ECAM_BASE
	default 0xe0000000
```

## maxlinear/feed_uboot/open_uboot/config/board/cortina/presidio-asic/Kconfig
```kconfig
if UBOOT_CONFIG_TARGET_PRESIDIO_ASIC
config UBOOT_CONFIG_BIT64
       bool
       default y

select UBOOT_CONFIG_SOC_CA7774

config UBOOT_CONFIG_SYS_BOARD
	default "presidio-asic"

config UBOOT_CONFIG_SYS_VENDOR
	default "cortina"

config UBOOT_CONFIG_SYS_CONFIG_NAME
	default "presidio_asic"

source "../../../board/cortina/common/Kconfig"
endif
```

## maxlinear/feed_uboot/open_uboot/config/board/cssi/MCR3000/Kconfig
```kconfig
if UBOOT_CONFIG_TARGET_MCR3000

config UBOOT_CONFIG_SYS_BOARD
	default "MCR3000"

config UBOOT_CONFIG_SYS_VENDOR
	default "cssi"

config UBOOT_CONFIG_SYS_CONFIG_NAME
	default "MCR3000"

config UBOOT_CONFIG_SYS_TEXT_BASE
	default 0x04000000

endif
```
