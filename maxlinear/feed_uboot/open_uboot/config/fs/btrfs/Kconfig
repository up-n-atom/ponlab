## maxlinear/linux/Documentation/devicetree/bindings/net/datapath/mxl,lgm-cqm.yaml
```yaml
# SPDX-License-Identifier: GPL-2.0
%YAML 1.2
---
$schema: http://devicetree.org/meta-schemas/core.yaml#

title: MaxLinear CQM driver

properties:
  compatible:
    items:
      - description: should be "mxl,lgm-cqm"

  reg:
    items:
      - description: address and length of the register set for the device.

  interrupts:
    items:
      - description: IRQ line info for CQM. The interrupt specifier
                     depends on the interrupt-parent interrupt controller

  interrupt-names:
    items:
      - description: Name associated with interrupt line

  clocks:
    items:
      - description: clocks source for CQM

  clocks-names:
    items:
      - description: name of the clock source

  resets:
    items:
      - description: reference to a reset controller asserting CQM

  reset-names:
    items:
      - description: list of reset signal names.
                     See Documentation/devicetree/bindings/reset/reset.txt

  power-domains:
    items:
      - description: reference to power domain for cqm

  mxl,syscon:
    items:
      - description: reference to syscon

  mxl,bm-buff-size:
    items:
      - description: reference to buffer pool size

  mxl,c55_ddr_mem:
    items:
      - description: reference to c55 ddr

  mxl,lpid_config:
    items:
      - description: 
          reference to lpid configuration
          mxl,port-mode - bitmap representing port P0-P15. Bit value 1 indicates
                          the port corresponding to the bit is dynamic port.
          mxl,wan-mode - bitmap representing the WAN mode.
                         LPID_WAN_ETH - 0x01
                         LPID_WAN_PON - 0x02
                         LPID_WAN_DOCSIS - 0x04
                         LPID_WAN_DSL - 0x08
          mxl,lpid-epg-map - array of four tuples. Each four tuple indicates the
                             map of LPID, EGRESS Port GROUP, txdma controller and
                             txdma channel in the form of
                             <LPID, EPG, TXDMA_CTRL, TXDMA_CHAN>.
                             For example, <3 35 2 8> means LPID 3 has EPG 35,
                             which is mapped to TXDMA controller 2 channel 8.

  mxl,txin-fallback:
    items:
      - description: TXIN fallback to LGM B-step behavior, i.e. 32, for LGM C-step,

  mxl,deq_dma_delay:
    items:
      - description:
          specify DEQ DMA port delay for LGM C-step.
          Array of three tuples in form of <DCP, DEQ_PORT, DELAY_IN_CYCLES>.
          For example, <0 59 200> means DEQ_DLY_CNT_DCP_0 is mapped to CQM DEQ
          port 59 with a delay of 200 CQM clock cycles.

  mxl,cpu-pool-enq-chk:
    items:
      - description: 0xfe policy enqueue check via status bit check, for LGM C-step,

  mxl,sram-pool:
    items:
      - description: reference to sram pool

  mxl,sram-size:
    items:
      - description: size of sram pool

  cpupool:
    items:
      - description: reference to cpu gen pool

  syspool:
    items:
      - description: reference to sys gen pool

  rwpool:
    items:
      - description: reference to rw gen pool

  dmas:
    items:
      - description: reference to dma controller

  dma-names:
    items:
      - description: dma names

  mxl,wav700:
    items:
      - description: set to 1 to enable wav700 support

  mxl,wav-port-resv:
    items:
      - description: reserve dp port setting for wav700
                     mxl,wav-port-resv = <num_ports, mul_factor>
                     num_ports - num of dpid to be reserved
                     mul_factor - start dpid should be the first num in the dynamic range
                                  that is divisible by this factor

  cqm,bm_pools:
    items:
      - description: 
          bm buffer pools
          reg - index for BM buffer pool
          pool,buff_sz - size of each buffer in the pool
          pool,pool-num_buffs - number of buffers in the pool for ETH and PON systems
          pool,type - type of the BM buffer pool
                   SSB_NIOC_SHARED - SSB NIOC pool
                   CQM_NIOC_SHARED - NIOC shared pool
                   CQM_NIOC_ISOLATED - NIOC isolated pool
                   CQM_CPU_ISOLATED - CPU isolated pool

  cqm,bm_policies:
    items:
      - description:
          bm policies
          reg - index for BM policy
          policy,pool - BM pools in the policy
          policy,alloc - minimum guaranteed and max allowed buffers for ETH and PON systems
          policy,direction - transfer direction, e.g. CQM_TX_RX, CQM_TX, CQM_RX

  mxl,cqm_clkrate:
    items:
      - description: override the default cqm clock frequency

examples:
  - |
    cqm_lgm: cqm_lgm@e6000000 {
        compatible = "mxl,lgm-cqm";
        reg = < 0xe6000000 0x100000 /*CQM_DC_DESC_PORT*/
                0xe6400000 0x1000   /*CQM_WIB*/
                0xe6440000 0x800 /*CQM_QID2EP_MAP*/
                0xe6610000 0x10000 /*CQM_CONTROL*/
                0xe6620000 0x2000 /*CBM_QIDT0*/
                0xe6622000 0x2000 /*CBM_QIDT1*/
                0xe6660000 0x10000 /*CBM_LS*/
                0xe6680000 0x20000 /*CQM ENQ*/
                0xe66C0000 0x40000 /*CQM DEQ*/
                0xe6700000 0x100000 /*FSQM*/
                0xe6800000 0x100000 /*FSQM DESC*/
                0xe6b00000 0x1000 /*TX PUSH*/
                0xe6c00000 0x100000 /*CQM_DMA_DESC_PORT*/
        >;
        interrupt-parent = <&soc_msi>;
        interrupts = <54>, <55>, <56>, <57>,
                     <58>, <59>, <60>, <61>;
        interrupt-names = "cqm0", "cqm1","cqm2", "cqm3",
                          "cqm4", "cqm5", "cqm6", "cqm7";

        /* clocks */
        clocks = <&cgu0 LGM_CLK_CQEM>, <&cgu0 LGM_GCLK_CQEM>;
        clock-names = "freq", "cbm";
        resets = <&rcu0 0x70 11>;
        reset-names = "cqm";
        power-domains = <&pd_cqm>;
        mxl,syscon = <&sysconf>;
        mxl,bm-buff-size = <&buffer_pool_size>;
        /* mxl,c55_ddr_mem = <&voice_c55_ddr>; */
        mxl,lpid_config = <&lpid_config>;
        mxl,sram-pool = <&shared_sram>;
        mxl,sram-size = <0xe900>;
        cpupool = <&cpu_pool>;
        syspool = <&sys_pool>;
        rwpool = <&rw_pool>;
        firewall-domains = <&fw_dom_cqmdeq
                            &fw_dom_cqmenq>;
        dmas =
            <&dma1tx 0>, <&dma1tx 1>, <&dma1tx 2>, <&dma1tx 3>, <&dma1tx 4>,
            <&dma1tx 5>, <&dma1tx 6>, <&dma1tx 7>, <&dma1tx 8>, <&dma1tx 9>,
            <&dma1tx 10>, <&dma1tx 11>, <&dma1tx 12>, <&dma1tx 13>, <&dma1tx 14>,
            <&dma1tx 15>, <&dma1rx 0>, <&dma1rx 1>, <&dma1rx 2>, <&dma1rx 3>,
            <&dma1rx 4>, <&dma1rx 5>, <&dma1rx 6>, <&dma1rx 7>, <&dma1rx 8>,
            <&dma1rx 9>, <&dma2tx 0>, <&dma2tx 1>, <&dma2tx 2>, <&dma2tx 3>,
            <&dma2tx 4>, <&dma2tx 5>, <&dma2tx 6>, <&dma2tx 7>, <&dma2tx 8>,
            <&dma2tx 9>, <&dma2tx 10>, <&dma2tx 11>, <&dma2tx 12>, <&dma2tx 13>,
            <&dma2tx 14>, <&dma2tx 15>, <&dma0tx 0>, <&dma0tx 1>, <&dma0tx 2>,
            <&dma0tx 3>, <&dma0tx 4>, <&dma0tx 5>, <&dma0tx 6>, <&dma0tx 7>,
            <&dma0tx 8>, <&dma0tx 9>, <&dma0tx 10>, <&dma0tx 11>, <&dma0tx 12>,
            <&dma0tx 13>, <&dma0tx 14>, <&dma0tx 15>;
            dma-names =
                "DMA1TXC0", "DMA1TXC1", "DMA1TXC2", "DMA1TXC3", "DMA1TXC4",
                "DMA1TXC5", "DMA1TXC6", "DMA1TXC7", "DMA1TXC8", "DMA1TXC9",
                "DMA1TXC10", "DMA1TXC11", "DMA1TXC12", "DMA1TXC13", "DMA1TXC14",
                "DMA1TXC15", "DMA1RXC0", "DMA1RXC1", "DMA1RXC2", "DMA1RXC3",
                "DMA1RXC4", "DMA1RXC5", "DMA1RXC6", "DMA1RXC7", "DMA1RXC8",
                "DMA1RXC9", "DMA2TXC0", "DMA2TXC1", "DMA2TXC2", "DMA2TXC3",
                "DMA2TXC4", "DMA2TXC5", "DMA2TXC6", "DMA2TXC7", "DMA2TXC8",
                "DMA2TXC9", "DMA2TXC10", "DMA2TXC11", "DMA2TXC12", "DMA2TXC13",
                "DMA2TXC14", "DMA2TXC15", "DMA0TXC0", "DMA0TXC1", "DMA0TXC2",
                "DMA0TXC3", "DMA0TXC4", "DMA0TXC5", "DMA0TXC6", "DMA0TXC7",
                "DMA0TXC8", "DMA0TXC9", "DMA0TXC10", "DMA0TXC11", "DMA0TXC12",
                "DMA0TXC13","DMA0TXC14","DMA0TXC15";
        mxl,wav-port-resv = <&wav_port_resv>;
        cqm,bm_pools {
            #size-cells = <0>;
            #address-cells = <1>;
            pool@0 {
                reg = <0>;
                pool,buff_sz = <256>;
                /* Default, PON Systems */
                pool,pool-num_buffs = <128 128>;
                pool,type = <SSB_NIOC_SHARED>;
            };
            pool@1 {
                reg = <1>;
                pool,buff_sz = <512>;
                /* Default, PON Systems */
                pool,pool-num_buffs = <9984 130752>;
                pool,type = <CQM_NIOC_SHARED>;
            };
            pool@2 {
                reg = <2>;
                pool,buff_sz = <1024>;
                pool,pool-num_buffs = <3008 34880>;
                pool,type = <CQM_NIOC_SHARED>;
            };
            pool@3 {
            reg = <3>;
                pool,buff_sz = <2048>;
                pool,pool-num_buffs = <136768 211200>;
                pool,type = <CQM_NIOC_SHARED>;
            };
            pool@4 {
                reg = <4>;
                pool,buff_sz = <10240>;
                pool,pool-num_buffs = <2432 6144>;
                pool,type = <CQM_NIOC_SHARED>;
            };
            /* Voice Pool: type = CQM_NIOC_ISOLATED */
            pool@5 {
                reg = <5>;
                pool,buff_sz = <2048>;
                pool,pool-num_buffs = <1024>;
                pool,type = <CQM_NIOC_ISOLATED>;
            };
            /* CPU Pools: type = CQM_CPU_ISOLATED */
            pool@6 {
                reg = <6>;
                pool,buff_sz = <512>;
                pool,pool-num_buffs = <128>;
                pool,type = <CQM_CPU_ISOLATED>;
            };
            pool@7 {
                reg = <7>;
                pool,buff_sz = <1024>;
                pool,pool-num_buffs = <18496>;
                pool,type = <CQM_CPU_ISOLATED>;
            };
            pool@8 {
                reg = <8>;
                pool,buff_sz = <2048>;
                pool,pool-num_buffs = <11328>;
                pool,type = <CQM_CPU_ISOLATED>;
            };
            pool@9 {
                reg = <9>;
                pool,buff_sz = <10240>;
                pool,pool-num_buffs = <512>;
                pool,type = <CQM_CPU_ISOLATED>;
            };
        };
        cqm,bm_policies{
            #size-cells = <0>;
            #address-cells = <1>;
            bm_policy@0 {
                reg=<0>;/* Policy Id */
                policy,pool = <0 DP_RES_ID_SYS>,
                          <1 DP_RES_ID_SYS>; /* Pool Id, Type */
                /* <Min Guaranteed, Max Allowed> */
                policy,alloc = <128 9586 128 130358>; /* If PON is enabled */
                policy,direction = <CQM_TX_RX>;
            };
            bm_policy@1 {
                reg=<1>;
                policy,pool = <1 DP_RES_ID_SYS>;
                policy,alloc = <9340 9458 128680 130230>;
                policy,direction = <CQM_TX_RX>;
            };
            bm_policy@2 {
                reg=<2>;
                policy,pool = <2 DP_RES_ID_SYS>;
                policy,alloc = <2840 2848 34664 34751>;
                policy,direction = <CQM_TX_RX>;
            };
            bm_policy@3 {
                reg=<3>;
                policy,pool = <3 DP_RES_ID_SYS>;
                policy,alloc = <6296 7870 76839 87851>;
                policy,direction = <CQM_TX_RX>;
            };
            bm_policy@4 {
                reg=<4>;
                policy,pool = <4 DP_RES_ID_SYS>;
                policy,alloc = <2331 2343 6044 6075>;
                policy,direction = <CQM_TX_RX>;
            };
            /* TOE TX policy */
            bm_policy@5 {
                reg=<5>;
                policy,pool = <3 DP_RES_ID_SYS>;
                policy,alloc = <2048 2560>;
                policy,direction = <CQM_TX>;
            };
            /* Radio 1: WAV 2.4G Policies */
            bm_policy@6 {
                reg=<6>;
                policy,pool = <3 DP_RES_ID_WAV614>;
                policy,alloc = <5000 6250>;
                policy,direction = <CQM_RX>;
            };
            bm_policy@7 {
                reg=<7>;
                policy,pool = <3 DP_RES_ID_WAV614>;
                policy,alloc = <10000 12500>;
                policy,direction = <CQM_TX>;
            };
            /* Radio 2: WAV 5/6G Policies */
            bm_policy@8 {
                reg=<8>;
                policy,pool = <3 DP_RES_ID_WAV624>;
                policy,alloc = <10000 12500>;
                policy,direction = <CQM_RX>;
            };
            bm_policy@9 {
                reg=<9>;
                policy,pool = <3 DP_RES_ID_WAV624>;
                policy,alloc = <20000 24682 20000 25000>;
                policy,direction = <CQM_TX>;
            };
            /* Radio 3: WAV 5/6G Policies */
            bm_policy@10 {
                reg=<10>;
                policy,pool = <3 DP_RES_ID_WAV624>;
                policy,alloc = <10000 12500>;
                policy,direction = <CQM_RX>;
            };
            bm_policy@11 {
                reg=<11>;
                policy,pool = <3 DP_RES_ID_WAV624>;
                policy,alloc = <20000 24682 20000 25000>;
                policy,direction = <CQM_TX>;
            };
            /* DSL Policies */
            bm_policy@12 {
                reg=<12>;
                policy,pool = <3 DP_RES_ID_VRX>;
                policy,alloc = <1000 1250 1000 1250>;
                policy,direction = <CQM_RX>;
            };
            bm_policy@13 {
                reg=<13>;
                policy,pool = <1 DP_RES_ID_VRX>;
                policy,alloc = <500 618 500 618>;
                policy,direction = <CQM_TX>;
            };
            bm_policy@14 {
                reg=<14>;
                policy,pool = <2 DP_RES_ID_VRX>;
                policy,alloc = <150 158 150 158>;
                policy,direction = <CQM_TX>;
            };
            bm_policy@15 {
                reg=<15>;
                policy,pool = <3 DP_RES_ID_VRX>;
                policy,alloc = <320 400 320 400>;
                policy,direction = <CQM_TX>;
            };
            bm_policy@16 {
                reg=<16>;
                policy,pool = <4 DP_RES_ID_VRX>;
                policy,alloc = <64 76 64 76>;
                policy,direction = <CQM_TX>;
            };
            /* Voice Policy */
            bm_policy@17 {
                reg=<17>;
                policy,pool = <5 DP_RES_ID_VOICE0>;
                policy,alloc = <1024 1024>;
                policy,direction = <CQM_RX>;
            };
            /* CPU Policies */
            bm_policy@18 {
                reg=<18>;
                policy,pool = <6 DP_RES_ID_CPU> ;
                policy,alloc = <128 128>;
                policy,direction = <CQM_TX_RX>;
            };
            bm_policy@19 {
                reg=<19>;
                policy,pool = <7 DP_RES_ID_CPU>;
                policy,alloc = <18496 18496>;
                policy,direction = <CQM_TX_RX>;
            };
            bm_policy@20 {
                reg=<20>;
                policy,pool = <8 DP_RES_ID_CPU>;
                policy,alloc = <11328 11328>;
                policy,direction = <CQM_TX_RX>;
            };
            bm_policy@21 {
                reg=<21>;
                policy,pool = <9 DP_RES_ID_CPU>;
                policy,alloc = <512 512>;
                policy,direction = <CQM_TX_RX>;
            };
            bm_policy@22 {
                reg=<22>;
                policy,pool = <3 DP_RES_ID_WAV700>;
                policy,alloc = <40000 47132>;
                policy,direction = <CQM_RX>;
            };
            bm_policy@23 {
                reg=<23>;
                policy,pool = <3 DP_RES_ID_WAV700>;
                policy,alloc = <80000 87132>;
                policy,direction = <CQM_TX>;
            };
        };
    };

    &wav_port_resv {
        mxl,wav-port-resv = <3 4>;
    };

    &lpid_config {
        mxl,port-mode = <LPID_PORT_MODE1>;
        mxl,wan-mode = <LPID_WAN_ETH>;
        mxl,lpid-epg-map = <2 75>,
                           <3 35>,
                           <4 51>,
                           <5 36>,
                           <6 37>,
                           <7 52>,
                           <8 53>,
                           <9 38>,
                           <10 54>;
    };
```
