## maxlinear/linux/Documentation/devicetree/bindings/net/datapath/mxl,lgm-xpcs.yaml
```yaml
# SPDX-License-Identifier: GPL-2.0
%YAML 1.2
---
$schema: http://devicetree.org/meta-schemas/core.yaml#

title: MaxLinear XPCS driver for LGM or PRX

properties:
  compatible:
    items:
      - const: mxl,lgm-xpcs
      - const: mxl,prx-xpcs
      - const: mxl,lgm-xpcs-c10

  reg:
    items:
      - description: address and length of the register set for the device.

  interrupts:
    items:
      - description: IRQ line info for CQM. The interrupt specifier
                     depends on the interrupt-parent interrupt controller

  clocks:
    items:
      - description: clocks source for CQM

  power-domains:
    items:
      - description: reference to power domain for cqm

  lineclk,syscon:
    items:
      - description: reference to hsio syscon

  lineclk,offset:
    items:
      - description: hsio syscon offset

  lineclk,bit:
    items:
      - description: bit in hsio syscon offset

  mpllb:
    items:
      - description: whether MPLLB is used

  phys:
    items:
      - description: reference to phy for XPCS

  phy-names:
    items:
      - description: name of the phy

  slave:
    items:
      - description: whether the XPCS is a slave deivce in an XPCS pair

  pair:
    items:
      - description: reference to slave deivce in an XPCS pair

  mxl,cbphy_app:
    item:
      - description: reference to combophy application syscon

examples:
  - |
    hsiol_xpcs1: xpcs@1 {
        compatible = "mxl,lgm-xpcs";
        status = "disabled";
        reg = <0xD0B42000 0x400>;
        clocks = <&cgu0 LGM_GCLK_XPCS1>;
        interrupt-parent = <&ioapic1>;
        interrupts = <56 1>;
        lineclk,syscon = <&hsiol>;
        lineclk,offset = <0x134>;
        lineclk,bit = <0>;
        xpcs-name = "hsiol_xpcs1";
        xpcs-mode = <6>; /* <0> - SGMII, <1> - 1000BaseX, <2> - 2500BaseX, <3> - 5GBaseR, <4> - 10GBaseR, <5> - USXGMII, <6> - 10GKR, <7> - QUSXGMII */
        xpcs-cl37 = <3 3 3 0 0 1 0 1>; /* <0> - disable, <1> - SGMII MAC side, <2> - SGMII PHY side, <3> - BaseX */
        xpcs-cl73 = <0 0 0 0 0 0 0 0>; /* <0> - disable, <1> - enable */
        mpllb = <1>;
        phys = <&cb0phy1 PHY_TYPE_XPCS_SL>;
        phy-names = "phy";
        power-domains = <&pd_hsio1>;
        slave = <1>;
    };
    hsiol_xpcs0: xpcs@0 {
        compatible = "mxl,lgm-xpcs";
        status = "disabled";
        reg = <0xD0A42000 0x400>;
        clocks = <&cgu0 LGM_GCLK_XPCS0>;
        interrupt-parent = <&ioapic1>;
        interrupts = <55 1>;
        lineclk,syscon = <&hsiol>;
        lineclk,offset = <0x130>;
        lineclk,bit = <0>;
        xpcs-name = "hsiol_xpcs0";
        xpcs-mode = <6>; /* <0> - SGMII, <1> - 1000BaseX, <2> - 2500BaseX, <3> - 5GBaseR, <4> - 10GBaseR, <5> - USXGMII, <6> - 10GKR, <7> - QUSXGMII */
        xpcs-cl37 = <3 3 3 0 0 1 0 1>; /* <0> - disable, <1> - SGMII MAC side, <2> - SGMII PHY side, <3> - BaseX */
        xpcs-cl73 = <0 0 0 0 0 0 0 0>; /* <0> - disable, <1> - enable */
        mpllb = <1>;
        phys = <&cb0phy0 PHY_TYPE_XPCS_SL>;
        phy-names = "phy";
        pair = <&hsiol_xpcs1>;
        power-domains = <&pd_hsio1>;
    };
```

## maxlinear/linux/Documentation/devicetree/bindings/pinctrl/intel,lgm-io.yaml
```yaml
# SPDX-License-Identifier: (GPL-2.0-only OR BSD-2-Clause)
%YAML 1.2
---
$id: http://devicetree.org/schemas/pinctrl/intel,lgm-io.yaml#
$schema: http://devicetree.org/meta-schemas/core.yaml#

title: Intel Lightning Mountain SoC pinmux & GPIO controller binding

maintainers:
  - Rahul Tanwar <rahul.tanwar@linux.intel.com>

description: |
  Pinmux & GPIO controller controls pin multiplexing & configuration including
  GPIO function selection & GPIO attributes configuration.

Required properties:
  compatible:
    const: intel,lgm-io

  reg:
    maxItems: 1

Optional properties:
  #pinctrl-cells: number of cells of topmux. set it to 2.

  pinctrl,syscon: reference node to topmux register

# Client device subnode's properties
patternProperties:
  '-pins$':
    type: object
    description:
      Pinctrl node's client devices use subnodes for desired pin configuration.
      Client device subnodes use below standard properties.
    $ref: pinmux-node.yaml#

    properties:
      function: true
      groups: true
      intel,pins: true
      pinmux: true
      bias-pull-up: true
      bias-pull-down: true
      drive-strength: true
      slew-rate: true
      drive-open-drain: true
      output-enable: true

    required:
      - function
      - groups
      - intel,pins

    additionalProperties:
      topmux: extra register configuration in order to make the pinmux work.
              The format of the topmux: <register_offset mask value>

required:
  - compatible
  - reg

additionalProperties: true

examples:
  # Pinmux controller node
  - |
    pinctrl: pinctrl@e2880000 {
        compatible = "intel,lgm-io";
        reg = <0xe2880000 0x100000>;
        #pinctrl-cells = <2>;
        pinctrl-syscon = <&sysconf>;

        uart0-pins {
             intel,pins = <64>, /* UART_RX0 */
                          <65>; /* UART_TX0 */
             function = "CONSOLE_UART0";
             pinmux = <1>,
                      <1>;
             groups = "CONSOLE_UART0";
             topmux = <0xE8 0x3 0>;
        };
    };

...
```

## maxlinear/linux/drivers/dma/lgm/Kconfig
```kconfig
# SPDX-License-Identifier: GPL-2.0-only
config INTEL_LDMA
	bool "Lightning Mountain centralized DMA controllers"
	depends on X86 || COMPILE_TEST
	select DMA_ENGINE
	select DMA_VIRTUAL_CHANNELS
	help
	  Enable support for Intel Lightning Mountain SOC DMA controllers.
	  These controllers provide DMA capabilities for a variety of on-chip
	  devices such as HSNAND and GSWIP (Gigabit Switch IP).

config INTEL_MCPY
	bool "Intel memory copy DMA support"
	depends on INTEL_LDMA
	help
	  Enable support for the Intel memory copy HW controller.
	  It supports cache coherent DDR to DDR memory copy with
	  scatter-gathering feature.

config INTEL_MCPY_TEST
	tristate "Intel memory copy DMA test"
	depends on INTEL_MCPY
	help
	  Test module for MCPY
```

## maxlinear/linux/drivers/net/datapath/Kconfig
```kconfig
# SPDX-License-Identifier: GPL-2.0

menuconfig MXL_NP_NET_CORE
	depends on NETDEVICES
	bool "Maxlinear NP Network device support"
	help
	  It contains basic network driver sets
	  required to drive Maxlinear NP(LGM/PRX300)
	  to support basic network packet handling.

if MXL_NP_NET_CORE
source "drivers/net/datapath/cqm/Kconfig"
source "drivers/net/datapath/dpm/Kconfig"
source "drivers/net/datapath/xpcs/Kconfig"
source "drivers/net/datapath/gswip/Kconfig"
source "drivers/net/datapath/p34x/Kconfig"
source "drivers/net/datapath/umt/Kconfig"
source "drivers/net/datapath/toe/Kconfig"
source "drivers/net/datapath/vpn/Kconfig"
source "drivers/net/datapath/qos_tc/Kconfig"
source "drivers/net/datapath/qos_notify/Kconfig"
source "drivers/net/datapath/dp_oam/Kconfig"
source "drivers/net/datapath/bridge_filter/Kconfig"
source "drivers/net/datapath/dp_eth_reinsert/Kconfig"
source "drivers/net/datapath/mib_counters/Kconfig"
source "drivers/net/datapath/directpath/Kconfig"
endif # MXL_NP_NET_CORE
```

## maxlinear/linux/drivers/net/datapath/cqm/Kconfig
```kconfig
#
# Central QOS Manager(CQM) configuration
#
config MXL_CBM
	bool "Central Buffer Manager Driver"

	help
	Turn on this option to enable CBM/CQM driver which is a special hardware
	present in the XRX500/FALCONMX/LGM series of SoCs to manage the network buffers
	in HW.
choice
        prompt "SoC platform selection"
        depends on MXL_CBM

config LGM_CQM
        bool "LGM"
        select MXL_SEC_GEN_POOL
        help
          CQM driver for LGM platform.

endchoice

if LGM_CQM
source "drivers/net/datapath/cqm/lgm/Kconfig"
endif

config MXL_CBM_SKB
        bool "hack Skbuff"

config MXL_CBM_TEST
        tristate "CQM unit test module"
```

## maxlinear/linux/drivers/net/datapath/cqm/lgm/Kconfig
```kconfig
#
# Central Buffer Manager(CBM) configuration
#
menu "CQM_LGM"
config IOC_POOL
	bool "IOC CPU POOL"
	depends on MXL_CBM
	help
	Turn on this option to enable IOC CPU POOL

config LGM_CQM_CPUBUF_RET_DC
	bool "CQM CPU buffer return to DC"
	depends on LGM_CQM && INTEL_MCPY
	help
	  LGM CQM feature that returns CPU buffer through DC ring

endmenu
```

## maxlinear/linux/drivers/net/datapath/directpath/Kconfig
```kconfig
config DP_DIRECTPATH
	tristate "Directpath LIB"
	depends on DPM_DATAPATH
	help
	  Directpath Lib based on Datapath Lib, is to provide common rx/tx wrapper
	  apis for directpath devices.

config DP_DIRECTPATH_TEST
	tristate "Directpath Loopback test"
	depends on DP_DIRECTPATH
	help
	  Directpath loopback test.
```

## maxlinear/linux/drivers/net/datapath/gswip/Kconfig
```kconfig
#
# switch api configuration
#
config MXL_ETHSW_API
	tristate "Maxlinear Ethernet Switch API"
	default y
	select MDIO
	select PHYLIB
	help
	  Support for Maxlinear Ethernet Switch API.

config MXL_ETHSW_NOSPTAG
	bool "Disable special tags on LAN interfaces"
	depends on MXL_ETHSW_API
	help
	  Do not insert special tags on packets received on LAN ports.

	  The adaption layer between the MAC (XGMAC and legacy MAC) and GSWIP
	  could hang when it adds special tags to corrupted or too short packets.
	  Prevent this by deactivating this feature. This mostly happens in
	  half duplex mode. When no special tag is added additional PCE rules
	  are needed for rules which should match on packets from all
	  interfaces (LAN + PON) because packets from the PON interface always
	  have a special tag. This affects PCE rules configured on the pon0
	  device.

config MXL_8021X
	depends on MXL_ETHSW_API
	default y
	bool "Support Maxlinear ETHSW 802.1X Switch API's"
	help
	  Supported Maxlinear Switch API for 802.1X features.

config MXL_MULTICAST
	depends on MXL_ETHSW_API
	default y
	bool "Support Maxlinear ETHSW MULTICAST Switch API's"
	help
	  Supported Maxlinear Switch API for multicast features.

config MXL_QOS
	depends on MXL_ETHSW_API
	default y
	bool "Support Maxlinear ETHSW QOS Switch API's"
	help
	  Supported Maxlinear Switch API for  Quality of Service (QoS) features.

config MXL_STP
	depends on MXL_ETHSW_API
	default y
	bool "Support Maxlinear ETHSW STP Switch API's"
	help
	  Supported Maxlinear Switch API for Spanning  Tree  Protocol(STP) features.

config MXL_VLAN
	depends on MXL_ETHSW_API
	default y
	bool "Support Maxlinear ETHSW VLAN Switch API's"
	help
	  Supported Maxlinear Switch API for VLAN features.

config MXL_WOL
	depends on MXL_ETHSW_API
	default y
	bool "Support Maxlinear ETHSW WOL Switch API's"
	help
	  Supported Maxlinear Switch API for Wake-On-Lan(WOL) features.

config MXL_PMAC
	depends on MXL_ETHSW_API
	default y
	bool "Support Maxlinear ETHSW PMAC Switch API's"
	help
	  Supported Maxlinear Switch API for PMAC Configuration features.

config MXL_RMON
	depends on MXL_ETHSW_API
	default y
	bool "Support Maxlinear ETHSW RMON Switch API's"
	help
	  Supported Maxlinear Switch API for RMON counter features.
```

## maxlinear/linux/drivers/net/datapath/p34x/Kconfig
```kconfig
config MXL_P34X_FWDL
	tristate "Maxlinear P34X Quad-PHY FW download driver"
	select MDIO
	help
	  Support for Maxlinear P34X Quad-PHY
```
