## maxlinear/feed_uboot/open_uboot/config/lib/efi_selftest/Kconfig
```kconfig
config UBOOT_CONFIG_CMD_BOOTEFI_SELFTEST
	bool "UEFI unit tests"
	depends on UBOOT_CONFIG_CMD_BOOTEFI
	imply PARTITIONS
	imply DOS_PARTITION
	imply FAT
	imply FAT_WRITE
	imply CMD_POWEROFF if PSCI_RESET || UBOOT_CONFIG_SYSRESET_PSCI
	help
	  This adds a UEFI test application to U-Boot that can be executed
	  via the 'bootefi selftest' command. It provides extended tests of
	  the UEFI API implementation.
```

## maxlinear/feed_uboot/open_uboot/config/scripts/kconfig/tests/auto_submenu/Kconfig
```kconfig
config UBOOT_CONFIG_A
	bool "A"
	default y

config UBOOT_CONFIG_A0
	bool "A0"
	depends on UBOOT_CONFIG_A
	default y
	help
	  This depends on A, so should be a submenu of A.

config UBOOT_CONFIG_A0_0
	bool "A1_0"
	depends on UBOOT_CONFIG_A0
	help
	  Submenus are created recursively.
	  This should be a submenu of A0.

config UBOOT_CONFIG_A1
	bool "A1"
	depends on UBOOT_CONFIG_A
	default y
	help
	  This should line up with A0.

choice
	prompt "choice"
	depends on UBOOT_CONFIG_A1
	help
	  Choice should become a submenu as well.

config UBOOT_CONFIG_A1_0
	bool "A1_0"

config UBOOT_CONFIG_A1_1
	bool "A1_1"

endchoice

config UBOOT_CONFIG_B
	bool "B"
	help
	  This is independent of A.

config UBOOT_CONFIG_C
	bool "C"
	depends on UBOOT_CONFIG_A
	help
	  This depends on A, but not a consecutive item, so can/should not
	  be a submenu.
```

## maxlinear/feed_uboot/open_uboot/config/scripts/kconfig/tests/choice/Kconfig
```kconfig
config UBOOT_CONFIG_MODULES
	bool "Enable loadable module support"
	option modules
	default y

choice
	prompt "boolean choice"
	default UBOOT_CONFIG_BOOL_CHOICE1

config UBOOT_CONFIG_BOOL_CHOICE0
	bool "choice 0"

config UBOOT_CONFIG_BOOL_CHOICE1
	bool "choice 1"

endchoice

choice
	prompt "optional boolean choice"
	optional
	default UBOOT_CONFIG_OPT_BOOL_CHOICE1

config UBOOT_CONFIG_OPT_BOOL_CHOICE0
	bool "choice 0"

config UBOOT_CONFIG_OPT_BOOL_CHOICE1
	bool "choice 1"

endchoice

choice
	prompt "tristate choice"
	default UBOOT_CONFIG_TRI_CHOICE1

config UBOOT_CONFIG_TRI_CHOICE0
	tristate "choice 0"

config UBOOT_CONFIG_TRI_CHOICE1
	tristate "choice 1"

endchoice

choice
	prompt "optional tristate choice"
	optional
	default UBOOT_CONFIG_OPT_TRI_CHOICE1

config UBOOT_CONFIG_OPT_TRI_CHOICE0
	tristate "choice 0"

config UBOOT_CONFIG_OPT_TRI_CHOICE1
	tristate "choice 1"

endchoice
```

## maxlinear/feed_uboot/open_uboot/config/scripts/kconfig/tests/err_recursive_dep/Kconfig
```kconfig
# SPDX-License-Identifier: GPL-2.0

# depends on itself

config UBOOT_CONFIG_A
	bool "A"
	depends on UBOOT_CONFIG_A

# select itself

config UBOOT_CONFIG_B
	bool
	select UBOOT_CONFIG_B

# depends on each other

config UBOOT_CONFIG_C1
	bool "C1"
	depends on UBOOT_CONFIG_C2

config UBOOT_CONFIG_C2
	bool "C2"
	depends on UBOOT_CONFIG_C1

# depends on and select

config UBOOT_CONFIG_D1
	bool "D1"
	depends on UBOOT_CONFIG_D2
	select UBOOT_CONFIG_D2

config UBOOT_CONFIG_D2
	bool

# depends on and imply

config UBOOT_CONFIG_E1
	bool "E1"
	depends on UBOOT_CONFIG_E2
	imply E2

config UBOOT_CONFIG_E2
	bool "E2"

# property

config UBOOT_CONFIG_F1
	bool "F1"
	default UBOOT_CONFIG_F2

config UBOOT_CONFIG_F2
	bool "F2"
	depends on UBOOT_CONFIG_F1

# menu

menu "menu depending on its content"
	depends on UBOOT_CONFIG_G

config UBOOT_CONFIG_G
	bool "G"

endmenu
```

## maxlinear/feed_uboot/open_uboot/config/scripts/kconfig/tests/new_choice_with_dep/Kconfig
```kconfig
config UBOOT_CONFIG_A
	bool "A"
	help
	  This is a new symbol.

choice
	prompt "Choice ?"
	depends on UBOOT_CONFIG_A
	help
	  "depends on A" has been newly added.

config UBOOT_CONFIG_CHOICE_B
	bool "Choice B"

config UBOOT_CONFIG_CHOICE_C
	bool "Choice C"
	help
	  This is a new symbol, so should be asked.

endchoice

choice
	prompt "Choice2 ?"

config UBOOT_CONFIG_CHOICE_D
	bool "Choice D"

config UBOOT_CONFIG_CHOICE_E
	bool "Choice E"

config UBOOT_CONFIG_CHOICE_F
	bool "Choice F"
	depends on UBOOT_CONFIG_A
	help
	  This is a new symbol, so should be asked.

endchoice
```

## maxlinear/feed_uboot/open_uboot/config/scripts/kconfig/tests/rand_nested_choice/Kconfig
```kconfig
choice
	prompt "choice"

config UBOOT_CONFIG_A
	bool "A"

config UBOOT_CONFIG_B
	bool "B"

if UBOOT_CONFIG_B
choice
	prompt "sub choice"

config UBOOT_CONFIG_C
	bool "C"

config UBOOT_CONFIG_D
	bool "D"

if UBOOT_CONFIG_D
choice
	prompt "subsub choice"

config UBOOT_CONFIG_E
	bool "E"

endchoice
endif # D

endchoice
endif # B

endchoice
```

## maxlinear/feed_uboot/open_uboot/config/test/Kconfig
```kconfig
menuconfig UBOOT_CONFIG_UNIT_TEST
	bool "Unit tests"
	help
	  Select this to compile in unit tests for various parts of
	  U-Boot. Test suites will be subcommands of the "ut" command.
	  This does not require sandbox to be included, but it is most
	  often used there.

config UBOOT_CONFIG_SPL_UNIT_TEST
	bool "Unit tests in SPL"
	# We need to be able to unbind devices for tests to work
	select UBOOT_CONFIG_SPL_DM_DEVICE_REMOVE
	help
	  Select this to enable unit tests in SPL. Most test are designed for
	  running in U-Boot proper, but some are intended for SPL, such as
	  of-platdata and SPL handover. To run these tests with the sandbox_spl
	  board, use the -u (unit test) option.

config UBOOT_CONFIG_UT_LIB
	bool "Unit tests for library functions"
	depends on UBOOT_CONFIG_UNIT_TEST
	default y
	help
	  Enables the 'ut lib' command which tests library functions like
	  memcat(), memcyp(), memmove() and ASN1 compiler/decoder.

if UBOOT_CONFIG_UT_LIB

config UBOOT_CONFIG_UT_LIB_ASN1
	bool "Unit test for asn1 compiler and decoder function"
	default y
	imply ASYMMETRIC_KEY_TYPE
	imply ASYMMETRIC_PUBLIC_KEY_SUBTYPE
	imply X509_CERTIFICATE_PARSER
	imply PKCS7_MESSAGE_PARSER
	imply RSA_PUBLIC_KEY_PARSER
	help
	  Enables a test which exercises asn1 compiler and decoder function
	  via various parsers.

config UBOOT_CONFIG_UT_LIB_CRYPT
	bool "Unit test for crypt-style password hashing"
	depends on !UBOOT_CONFIG_SPL && UBOOT_CONFIG_AUTOBOOT_KEYED && UBOOT_CONFIG_AUTOBOOT_ENCRYPTION
	default y
	select UBOOT_CONFIG_CRYPT_PW
	select UBOOT_CONFIG_CRYPT_PW_SHA256
	select UBOOT_CONFIG_CRYPT_PW_SHA512
	help
	  Enables a test for the crypt-style password hash functions.

config UBOOT_CONFIG_UT_LIB_RSA
	bool "Unit test for rsa_verify() function"
	depends on UBOOT_CONFIG_RSA
	depends on UBOOT_CONFIG_RSA_VERIFY_WITH_PKEY
	select UBOOT_CONFIG_IMAGE_SIGN_INFO
	default y
	help
	  Enables rsa_verify() test, currently rsa_verify_with_pkey only()
	  only, at the 'ut lib' command.

endif

config UBOOT_CONFIG_UT_COMPRESSION
	bool "Unit test for compression"
	depends on UBOOT_CONFIG_UNIT_TEST
	depends on UBOOT_CONFIG_CMDLINE && UBOOT_CONFIG_GZIP_COMPRESSED && UBOOT_CONFIG_BZIP2 && UBOOT_CONFIG_LZMA && UBOOT_CONFIG_LZO && UBOOT_CONFIG_LZ4
	default y
	help
	  Enables tests for compression and decompression routines for simple
	  sanity and for buffer overflow conditions.

config UBOOT_CONFIG_UT_LOG
	bool "Unit tests for logging functions"
	depends on UBOOT_CONFIG_UNIT_TEST
	default y
	help
	  Enables the 'ut log' command which tests logging functions like
	  log_err().
	  See also CONFIG_LOG_TEST which provides the 'log test' command.

config UBOOT_CONFIG_UT_TIME
	bool "Unit tests for time functions"
	depends on UBOOT_CONFIG_UNIT_TEST
	help
	  Enables the 'ut time' command which tests that the time functions
	  work correctly. The test is fairly simple and will not catch all
	  problems. But if you are having problems with udelay() and the like,
	  this is a good place to start.

config UBOOT_CONFIG_UT_UNICODE
	bool "Unit tests for Unicode functions"
	depends on UBOOT_CONFIG_UNIT_TEST
	default y
	help
	  Enables the 'ut unicode' command which tests that the functions for
	  manipulating Unicode strings work correctly.

source "dm/Kconfig"
source "env/Kconfig"
source "optee/Kconfig"
source "overlay/Kconfig"
```

## maxlinear/feed_uboot/open_uboot/config/test/optee/Kconfig
```kconfig
config UBOOT_CONFIG_UT_OPTEE
	bool "Enable OP-TEE Unit Tests"
	depends on UBOOT_CONFIG_UNIT_TEST && UBOOT_CONFIG_OF_CONTROL && UBOOT_CONFIG_OPTEE
	default y
	help
	  This enables the 'ut optee' command which runs a series of unit
	  tests on the optee library code..
```

## maxlinear/feed_wlan/wlan_wave_feed/mod-whm/Config.in
```kconfig
config MOD_WHM_CSI_SOCKET_PATH
    string "Path to unix socket to send CSI stats"
    default "/var/run/whm-csi.sock"

config DEFAULT_WIRELESS_CONFIGURATION_TYPE
    string "Select which default configuration to use. Values: mesh,gw"
    default "gw"
    help
      Specify which default configuration to use. Possible values: mesh,gw.
config MXL_WLAN_OSS_BUILD
    bool 'Build for opensource configuration'
    default "n"
    help
      Specify if it is community build( i.e. not customer build)
```

## maxlinear/linux/Documentation/devicetree/bindings/clock/intel,cgu-lgm.yaml
```yaml
# SPDX-License-Identifier: (GPL-2.0-only OR BSD-2-Clause)
%YAML 1.2
---
$id: http://devicetree.org/schemas/clock/intel,cgu-lgm.yaml#
$schema: http://devicetree.org/meta-schemas/core.yaml#

title: Intel Lightning Mountain SoC's Clock Controller(CGU) Binding

maintainers:
  - Rahul Tanwar <rahul.tanwar@linux.intel.com>

description: |
  Lightning Mountain(LGM) SoC's Clock Generation Unit(CGU) driver provides
  all means to access the CGU hardware module in order to generate a series
  of clocks for the whole system and individual peripherals.

  Please refer to include/dt-bindings/clock/intel,lgm-clk.h header file, it
  defines all available clocks as macros. These macros can be used in device
  tree sources.

properties:
  compatible:
    const: intel,cgu-lgm

  reg:
    maxItems: 1

  '#clock-cells':
    const: 1

  intel,ssc-enable:
    default: 1
    description:
      Enable or Disable SSC(Spread Spectrum Control) feature.

  intel,ssc-spread:
    default: 5
    description:
      Spread Depth Control in 0.1% steps.

  intel,ssc-dir:
    default: 1
    description:
      downspread is 1, center spread is 0

  intel,ssc-divval:
    default: 10
    description:
      SSC divider to set the modulation frequency.

required:
  - compatible
  - reg
  - '#clock-cells'

examples:
  - |
    cgu: clock-controller@e0200000 {
        compatible = "intel,cgu-lgm";
        reg = <0xe0200000 0x33c>;
        #clock-cells = <1>;

        cgussc {
                 cgussc1: cgussc@110 {
                          reg = <0x110>;
                          intel,ssc-enable = <1>;
                          intel,ssc-spread = <5>;
                          intel,ssc-dir = <1>;
                          intel,ssc-divval = <10>;
                 };
        };

    };

...
```
