## maxlinear/feed_uboot/open_uboot/config/fs/btrfs/Kconfig
```kconfig
config UBOOT_CONFIG_FS_BTRFS
	bool "Enable BTRFS filesystem support"
	select UBOOT_CONFIG_CRC32C
	select UBOOT_CONFIG_LIB_UUID
	select UBOOT_CONFIG_LZO
	select UBOOT_CONFIG_ZSTD
	select UBOOT_CONFIG_RBTREE
	select UBOOT_CONFIG_SHA256
	help
	  This provides a single-device read-only BTRFS support. BTRFS is a
	  next-generation Linux file system based on the copy-on-write
	  principle.
```

## maxlinear/feed_uboot/open_uboot/config/fs/yaffs2/Kconfig
```kconfig
config UBOOT_CONFIG_YAFFS_DIRECT
	bool

config UBOOT_CONFIG_YAFFS_PROVIDE_DEFS
	bool

config UBOOT_CONFIG_YAFFSFS_PROVIDE_VALUES
	bool

config UBOOT_CONFIG_YAFFS2
	bool "YAFFS2 filesystem support"
	select UBOOT_CONFIG_YAFFS_DIRECT
	select UBOOT_CONFIG_YAFFS_PROVIDE_DEFS
	select UBOOT_CONFIG_YAFFSFS_PROVIDE_VALUES
	help
	  This provides access to YAFFS2 filesystems. Yet Another Flash
	  Filesystem 2 is a filesystem designed specifically for NAND flash.
	  It incorporates bad-block management and ensures that device
	  writes are sequential regardless of filesystem activity.
```
