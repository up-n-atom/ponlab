## maxlinear/feed_uboot/open_uboot/config/arch/arm/mach-imx/mx6/Kconfig
```kconfig
if UBOOT_CONFIG_ARCH_MX6

config UBOOT_CONFIG_MX6_SMP
	bool
	select UBOOT_CONFIG_ARM_ERRATA_751472
	select UBOOT_CONFIG_ARM_ERRATA_761320
	select UBOOT_CONFIG_ARM_ERRATA_794072
	select UBOOT_CONFIG_ARM_ERRATA_845369
	select UBOOT_CONFIG_MP

config UBOOT_CONFIG_MX6
	bool
	default y
	select UBOOT_CONFIG_ARM_ERRATA_743622 if !MX6UL && !UBOOT_CONFIG_MX6ULL
	select UBOOT_CONFIG_GPT_TIMER if !MX6UL && !UBOOT_CONFIG_MX6ULL
	imply CMD_FUSE

choice
	prompt "i.MX6 SoC select"

config UBOOT_CONFIG_MX6D
	bool "i.MX 6Dual SoC support"
	select UBOOT_CONFIG_HAS_CAAM
	select UBOOT_CONFIG_MX6_SMP

config UBOOT_CONFIG_MX6DL
	bool "i.MX 6DualLite SoC support"
	select UBOOT_CONFIG_HAS_CAAM
	select UBOOT_CONFIG_MX6_SMP

config UBOOT_CONFIG_MX6Q
	bool "i.MX 6Quad SoC support"
	select UBOOT_CONFIG_HAS_CAAM
	select UBOOT_CONFIG_MX6_SMP

config UBOOT_CONFIG_MX6QDL
	bool "i.MX 6Dual and 6Quad SoC support"
	select UBOOT_CONFIG_HAS_CAAM
	select UBOOT_CONFIG_MX6_SMP

config UBOOT_CONFIG_MX6S
	bool "i.MX 6Solo SoC support"
	select UBOOT_CONFIG_HAS_CAAM

config UBOOT_CONFIG_MX6SL
	bool "i.MX 6SoloLite SoC support"

config UBOOT_CONFIG_MX6SX
	bool "i.MX 6SoloX SoC support"
	select UBOOT_CONFIG_HAS_CAAM
	select UBOOT_CONFIG_ROM_UNIFIED_SECTIONS

config UBOOT_CONFIG_MX6SLL
	bool "i.MX 6SLL SoC support"
	select UBOOT_CONFIG_ROM_UNIFIED_SECTIONS

config UBOOT_CONFIG_MX6UL
	bool "i.MX 6UltraLite SoC support"
	select UBOOT_CONFIG_HAS_CAAM
	select UBOOT_CONFIG_ROM_UNIFIED_SECTIONS
	select UBOOT_CONFIG_SYSCOUNTER_TIMER
	select UBOOT_CONFIG_SYS_L2CACHE_OFF

config UBOOT_CONFIG_MX6ULL
	bool "i.MX 6ULL SoC support"
	select UBOOT_CONFIG_ROM_UNIFIED_SECTIONS
	select UBOOT_CONFIG_SYSCOUNTER_TIMER
	select UBOOT_CONFIG_SYS_L2CACHE_OFF

endchoice

config UBOOT_CONFIG_MX6UL_LITESOM
	bool
	select UBOOT_CONFIG_DM
	select UBOOT_CONFIG_DM_THERMAL
	select UBOOT_CONFIG_SUPPORT_SPL
	imply CMD_DM

config UBOOT_CONFIG_MX6UL_OPOS6UL
	bool
	select UBOOT_CONFIG_BOARD_LATE_INIT
	select UBOOT_CONFIG_DM
	select UBOOT_CONFIG_DM_GPIO
	select UBOOT_CONFIG_DM_MMC
	select UBOOT_CONFIG_DM_THERMAL
	select UBOOT_CONFIG_SPL_DM if SPL
	select UBOOT_CONFIG_SPL_OF_CONTROL if SPL
	select UBOOT_CONFIG_SPL_PINCTRL if SPL
	select UBOOT_CONFIG_SPL_SEPARATE_BSS if SPL
	select UBOOT_CONFIG_SUPPORT_SPL
	imply CMD_DM

config UBOOT_CONFIG_MX6_OCRAM_256KB
	bool "Support 256KB OCRAM"
	depends on UBOOT_CONFIG_MX6D || UBOOT_CONFIG_MX6Q
	help
	 Allows using the full 256KB size of the OCRAM on the MX6Q/MX6D series
	 of chips, such as for SPL. The OCRAM of the Lite series of chips is
	 only 128KB, so using this option will prevent the resulting code from
	 working on those chips.

config UBOOT_CONFIG_MX6_DDRCAL
	bool "Include dynamic DDR calibration routines"
	depends on UBOOT_CONFIG_SPL
	help
	  Say "Y" if your board uses dynamic (per-boot) DDR calibration.
	  If unsure, say N.

choice
	prompt "MX6 board select"
	optional

config UBOOT_CONFIG_TARGET_APALIS_IMX6
	bool "Toradex Apalis iMX6 board"
	depends on UBOOT_CONFIG_MX6Q
	select UBOOT_CONFIG_BOARD_LATE_INIT
	select UBOOT_CONFIG_DM
	select UBOOT_CONFIG_DM_SERIAL
	select UBOOT_CONFIG_DM_THERMAL
	select UBOOT_CONFIG_SUPPORT_SPL
	imply CMD_DM
	imply CMD_SATA

config UBOOT_CONFIG_TARGET_ARISTAINETOS2C
	bool "Support aristainetos2-revC"
	depends on UBOOT_CONFIG_MX6DL
	select UBOOT_CONFIG_BOARD_LATE_INIT
	select UBOOT_CONFIG_SYS_I2C_MXC
	select UBOOT_CONFIG_MXC_UART
	select UBOOT_CONFIG_FEC_MXC
	select UBOOT_CONFIG_DM
	imply CMD_SATA
	imply CMD_DM

config UBOOT_CONFIG_TARGET_ARISTAINETOS2CCSLB
	bool "Support aristainetos2-revC CSL"
	depends on UBOOT_CONFIG_MX6DL
	select UBOOT_CONFIG_BOARD_LATE_INIT
	select UBOOT_CONFIG_SYS_I2C_MXC
	select UBOOT_CONFIG_MXC_UART
	select UBOOT_CONFIG_FEC_MXC
	select UBOOT_CONFIG_DM
	imply CMD_SATA
	imply CMD_DM

config UBOOT_CONFIG_TARGET_CM_FX6
	bool "CM-FX6"
	depends on UBOOT_CONFIG_MX6QDL
	select UBOOT_CONFIG_BOARD_LATE_INIT
	select UBOOT_CONFIG_DM
	select UBOOT_CONFIG_DM_GPIO
	select UBOOT_CONFIG_DM_SERIAL
	select UBOOT_CONFIG_SUPPORT_SPL
	imply CMD_DM

config UBOOT_CONFIG_TARGET_COLIBRI_IMX6
	bool "Toradex Colibri iMX6 board"
	select UBOOT_CONFIG_BOARD_LATE_INIT
	select UBOOT_CONFIG_DM
	select UBOOT_CONFIG_DM_SERIAL
	select UBOOT_CONFIG_DM_THERMAL
	select UBOOT_CONFIG_SUPPORT_SPL
	imply CMD_DM

config UBOOT_CONFIG_TARGET_COLIBRI_IMX6ULL
	bool "Toradex Colibri iMX6ULL"
	depends on UBOOT_CONFIG_MX6ULL
	select UBOOT_CONFIG_BOARD_LATE_INIT
	select UBOOT_CONFIG_DM
	select UBOOT_CONFIG_DM_THERMAL

config UBOOT_CONFIG_TARGET_DART_6UL
	bool "Variscite imx6ULL dart(DART-SOM-6ULL)"
	depends on UBOOT_CONFIG_MX6ULL
	select UBOOT_CONFIG_DM
	select UBOOT_CONFIG_DM_ETH
	select UBOOT_CONFIG_DM_GPIO
	select UBOOT_CONFIG_DM_I2C
	select UBOOT_CONFIG_DM_MMC
	select UBOOT_CONFIG_DM_SERIAL
	select UBOOT_CONFIG_DM_THERMAL
	select UBOOT_CONFIG_SUPPORT_SPL

config UBOOT_CONFIG_TARGET_DHCOMIMX6
	bool "dh_imx6"
	depends on UBOOT_CONFIG_MX6QDL
	select UBOOT_CONFIG_BOARD_EARLY_INIT_F
	select UBOOT_CONFIG_BOARD_LATE_INIT
	select UBOOT_CONFIG_DM
	select UBOOT_CONFIG_DM_THERMAL
	select UBOOT_CONFIG_SUPPORT_SPL
	imply CMD_DM
	imply CMD_SPL

config UBOOT_CONFIG_TARGET_DISPLAY5
	bool "LWN DISPLAY5 board"
	depends on UBOOT_CONFIG_MX6Q
	select UBOOT_CONFIG_DM
	select UBOOT_CONFIG_DM_ETH
	select UBOOT_CONFIG_DM_I2C
	select UBOOT_CONFIG_DM_MMC
	select UBOOT_CONFIG_DM_SPI
	select UBOOT_CONFIG_DM_GPIO
	select UBOOT_CONFIG_DM_SERIAL
	select UBOOT_CONFIG_SUPPORT_SPL
	imply CMD_DM

config UBOOT_CONFIG_TARGET_EMBESTMX6BOARDS
	bool "embestmx6boards"
	select UBOOT_CONFIG_BOARD_LATE_INIT
	select UBOOT_CONFIG_SUPPORT_SPL

config UBOOT_CONFIG_TARGET_GE_BX50V3
	bool "General Electric Bx50v3"
	depends on UBOOT_CONFIG_MX6Q
	select UBOOT_CONFIG_BOARD_LATE_INIT

config UBOOT_CONFIG_TARGET_GE_B1X5V2
	bool "General Electric B1x5v2"
	depends on UBOOT_CONFIG_MX6QDL
	select UBOOT_CONFIG_BOARD_LATE_INIT
	select UBOOT_CONFIG_DM
	select UBOOT_CONFIG_DM_THERMAL
	select UBOOT_CONFIG_SUPPORT_SPL

config UBOOT_CONFIG_TARGET_GW_VENTANA
	bool "gw_ventana"
	depends on UBOOT_CONFIG_MX6QDL
	select UBOOT_CONFIG_SUPPORT_SPL
	imply CMD_SATA
	imply CMD_SPL

config UBOOT_CONFIG_TARGET_KONTRON_MX6UL
	bool "Kontron Electronics SL/BL i.MX6UL/ULL (N63xx/N64xx)"
	depends on UBOOT_CONFIG_MX6UL
	select UBOOT_CONFIG_BINMAN
	select UBOOT_CONFIG_DM
	select UBOOT_CONFIG_DM_THERMAL
	select UBOOT_CONFIG_SUPPORT_SPL
	imply CMD_DM

config UBOOT_CONFIG_TARGET_KOSAGI_NOVENA
	bool "Kosagi Novena"
	select UBOOT_CONFIG_BOARD_LATE_INIT
	select UBOOT_CONFIG_DM_ETH
	select UBOOT_CONFIG_DM_GPIO
	select UBOOT_CONFIG_DM_MMC
	select UBOOT_CONFIG_PCI
	select UBOOT_CONFIG_DM_SCSI
	select UBOOT_CONFIG_DM_VIDEO
	select UBOOT_CONFIG_OF_CONTROL
	select UBOOT_CONFIG_SUPPORT_SPL
	imply CMD_DM

config UBOOT_CONFIG_TARGET_MCCMON6
	bool "mccmon6"
	depends on UBOOT_CONFIG_MX6QDL
	select UBOOT_CONFIG_SUPPORT_SPL
	select UBOOT_CONFIG_DM
	select UBOOT_CONFIG_DM_GPIO
	select UBOOT_CONFIG_DM_ETH
	select UBOOT_CONFIG_DM_SERIAL
	select UBOOT_CONFIG_DM_I2C
	select UBOOT_CONFIG_DM_SPI
	imply CMD_DM

config UBOOT_CONFIG_TARGET_MX6CUBOXI
	bool "Solid-run mx6 boards"
	depends on UBOOT_CONFIG_MX6QDL
	select UBOOT_CONFIG_BOARD_LATE_INIT
	select UBOOT_CONFIG_SUPPORT_SPL

config UBOOT_CONFIG_TARGET_MX6LOGICPD
	bool "Logic PD i.MX6 SOM"
	depends on UBOOT_CONFIG_MX6Q
	select UBOOT_CONFIG_SUPPORT_SPL
	select UBOOT_CONFIG_BOARD_EARLY_INIT_F
	select UBOOT_CONFIG_BOARD_LATE_INIT
	select UBOOT_CONFIG_DM
	select UBOOT_CONFIG_DM_ETH
	select UBOOT_CONFIG_DM_GPIO
	select UBOOT_CONFIG_DM_I2C
	select UBOOT_CONFIG_DM_MMC
	select UBOOT_CONFIG_DM_PMIC
	select UBOOT_CONFIG_OF_CONTROL
	imply CMD_DM

config UBOOT_CONFIG_TARGET_MX6MEMCAL
	bool "mx6memcal"
	depends on UBOOT_CONFIG_MX6QDL
	select UBOOT_CONFIG_SUPPORT_SPL
	help
	  The mx6memcal board is a virtual board that can be used to validate
	  and characterize the memory layout of a new design during the initial
	  development and pre-production stages.

config UBOOT_CONFIG_TARGET_MX6DL_MAMOJ
	bool "Support BTicino Mamoj"
	depends on UBOOT_CONFIG_MX6QDL
	select UBOOT_CONFIG_DM
	select UBOOT_CONFIG_DM_ETH
	select UBOOT_CONFIG_DM_GPIO
	select UBOOT_CONFIG_DM_I2C
	select UBOOT_CONFIG_DM_MMC
	select UBOOT_CONFIG_DM_PMIC
	select UBOOT_CONFIG_DM_PMIC_PFUZE100
	select UBOOT_CONFIG_DM_THERMAL
	select UBOOT_CONFIG_OF_CONTROL
	select UBOOT_CONFIG_PINCTRL
	select UBOOT_CONFIG_SPL
	select UBOOT_CONFIG_SPL_DM if SPL
	select UBOOT_CONFIG_SPL_GPIO if SPL
	select UBOOT_CONFIG_SPL_LIBCOMMON_SUPPORT if SPL
	select UBOOT_CONFIG_SPL_LIBDISK_SUPPORT if SPL
	select UBOOT_CONFIG_SPL_LIBGENERIC_SUPPORT if SPL
	select UBOOT_CONFIG_SPL_MMC if SPL
	select UBOOT_CONFIG_SPL_OF_CONTROL if SPL
	select UBOOT_CONFIG_SPL_OF_LIBFDT if SPL
	select UBOOT_CONFIG_SPL_PINCTRL if SPL
	select UBOOT_CONFIG_SPL_SEPARATE_BSS if SPL
	select UBOOT_CONFIG_SPL_SERIAL if SPL
	select UBOOT_CONFIG_SPL_USB_GADGET if SPL
	select UBOOT_CONFIG_SPL_USB_HOST if SPL
	select UBOOT_CONFIG_SPL_USB_SDP_SUPPORT if SPL
	select UBOOT_CONFIG_SPL_WATCHDOG if SPL
	select UBOOT_CONFIG_SUPPORT_SPL
	imply CMD_DM

config UBOOT_CONFIG_TARGET_MX6Q_ENGICAM
	bool "Support Engicam i.Core(RQS)"
	depends on UBOOT_CONFIG_MX6QDL
	select UBOOT_CONFIG_BOARD_LATE_INIT
	select UBOOT_CONFIG_DM
	select UBOOT_CONFIG_DM_ETH
	select UBOOT_CONFIG_DM_GPIO
	select UBOOT_CONFIG_DM_I2C
	select UBOOT_CONFIG_DM_MMC
	select UBOOT_CONFIG_DM_THERMAL
	select UBOOT_CONFIG_OF_CONTROL
	select UBOOT_CONFIG_SPL_DM if SPL
	select UBOOT_CONFIG_SPL_OF_CONTROL if SPL
	select UBOOT_CONFIG_SPL_OF_LIBFDT
	select UBOOT_CONFIG_SPL_PINCTRL if SPL
	select UBOOT_CONFIG_SPL_SEPARATE_BSS if SPL
	select UBOOT_CONFIG_SUPPORT_SPL
	imply CMD_DM

config UBOOT_CONFIG_TARGET_MX6SABREAUTO
	bool "mx6sabreauto"
	depends on UBOOT_CONFIG_MX6QDL
	select UBOOT_CONFIG_BOARD_EARLY_INIT_F
	select UBOOT_CONFIG_BOARD_LATE_INIT
	select UBOOT_CONFIG_DM
	select UBOOT_CONFIG_DM_THERMAL
	select UBOOT_CONFIG_SUPPORT_SPL
	imply CMD_DM

config UBOOT_CONFIG_TARGET_MX6SABRESD
	bool "mx6sabresd"
	depends on UBOOT_CONFIG_MX6QDL
	select UBOOT_CONFIG_BOARD_EARLY_INIT_F
	select UBOOT_CONFIG_BOARD_LATE_INIT
	select UBOOT_CONFIG_DM
	select UBOOT_CONFIG_DM_THERMAL
	select UBOOT_CONFIG_SUPPORT_SPL
	imply CMD_DM

config UBOOT_CONFIG_TARGET_MX6SLEVK
	bool "mx6slevk"
	depends on UBOOT_CONFIG_MX6SL
	select UBOOT_CONFIG_SUPPORT_SPL

config UBOOT_CONFIG_TARGET_MX6SLLEVK
	bool "mx6sll evk"
	depends on UBOOT_CONFIG_MX6SLL
	select UBOOT_CONFIG_BOARD_LATE_INIT
	select UBOOT_CONFIG_DM
	select UBOOT_CONFIG_DM_THERMAL
	imply CMD_DM

config UBOOT_CONFIG_TARGET_MX6SXSABRESD
	bool "mx6sxsabresd"
	depends on UBOOT_CONFIG_MX6SX
	select UBOOT_CONFIG_BOARD_EARLY_INIT_F
	select UBOOT_CONFIG_BOARD_LATE_INIT
	select UBOOT_CONFIG_DM
	select UBOOT_CONFIG_DM_THERMAL
	select UBOOT_CONFIG_SUPPORT_SPL

config UBOOT_CONFIG_TARGET_MX6SXSABREAUTO
	bool "mx6sxsabreauto"
	depends on UBOOT_CONFIG_MX6SX
	select UBOOT_CONFIG_BOARD_EARLY_INIT_F
	select UBOOT_CONFIG_BOARD_LATE_INIT
	select UBOOT_CONFIG_DM
	select UBOOT_CONFIG_DM_THERMAL
	imply CMD_DM

config UBOOT_CONFIG_TARGET_MX6UL_9X9_EVK
	bool "mx6ul_9x9_evk"
	depends on UBOOT_CONFIG_MX6UL
	select UBOOT_CONFIG_BOARD_LATE_INIT
	select UBOOT_CONFIG_DM
	select UBOOT_CONFIG_DM_THERMAL
	select UBOOT_CONFIG_SUPPORT_SPL
	imply CMD_DM

config UBOOT_CONFIG_TARGET_MX6UL_14X14_EVK
	bool "mx6ul_14x14_evk"
	depends on UBOOT_CONFIG_MX6UL
	select UBOOT_CONFIG_BOARD_LATE_INIT
	select UBOOT_CONFIG_DM
	select UBOOT_CONFIG_DM_THERMAL
	select UBOOT_CONFIG_SUPPORT_SPL
	imply CMD_DM

config UBOOT_CONFIG_TARGET_MX6UL_ENGICAM
	bool "Support Engicam GEAM6UL/Is.IoT"
	depends on UBOOT_CONFIG_MX6UL
	select UBOOT_CONFIG_BOARD_LATE_INIT
	select UBOOT_CONFIG_DM
	select UBOOT_CONFIG_DM_ETH
	select UBOOT_CONFIG_DM_GPIO
	select UBOOT_CONFIG_DM_I2C
	select UBOOT_CONFIG_DM_MMC
	select UBOOT_CONFIG_DM_THERMAL
	select UBOOT_CONFIG_OF_CONTROL
	select UBOOT_CONFIG_SPL_DM if SPL
	select UBOOT_CONFIG_SPL_OF_CONTROL if SPL
	select UBOOT_CONFIG_SPL_PINCTRL if SPL
	select UBOOT_CONFIG_SPL_SEPARATE_BSS if SPL
	select UBOOT_CONFIG_SUPPORT_SPL
	imply CMD_DM

config UBOOT_CONFIG_TARGET_MX6ULL_14X14_EVK
	bool "Support mx6ull_14x14_evk"
	depends on UBOOT_CONFIG_MX6ULL
	select UBOOT_CONFIG_BOARD_LATE_INIT
	select UBOOT_CONFIG_DM
	select UBOOT_CONFIG_DM_THERMAL
	imply CMD_DM

config UBOOT_CONFIG_TARGET_MYS_6ULX
	bool "MYiR MYS-6ULX"
	depends on UBOOT_CONFIG_MX6ULL
	select UBOOT_CONFIG_DM
	select UBOOT_CONFIG_DM_ETH
	select UBOOT_CONFIG_DM_GPIO
	select UBOOT_CONFIG_DM_I2C
	select UBOOT_CONFIG_DM_MMC
	select UBOOT_CONFIG_DM_SERIAL
	select UBOOT_CONFIG_DM_THERMAL
	select UBOOT_CONFIG_SUPPORT_SPL

config UBOOT_CONFIG_TARGET_NITROGEN6X
	bool "nitrogen6x"
	depends on UBOOT_CONFIG_MX6DL || UBOOT_CONFIG_MX6Q || UBOOT_CONFIG_MX6QDL || UBOOT_CONFIG_MX6S
	imply USB_ETHER_ASIX
	imply USB_ETHER_MCS7830
	imply USB_ETHER_SMSC95XX
	imply USB_HOST_ETHER

config UBOOT_CONFIG_TARGET_NPI_IMX6ULL
	bool "Seeed NPI-IMX6ULL"
	depends on UBOOT_CONFIG_MX6ULL
	select UBOOT_CONFIG_DM
	select UBOOT_CONFIG_DM_ETH
	select UBOOT_CONFIG_DM_MMC
	select UBOOT_CONFIG_DM_GPIO
	select UBOOT_CONFIG_DM_SERIAL
	select UBOOT_CONFIG_DM_THERMAL
	select UBOOT_CONFIG_SUPPORT_SPL

config UBOOT_CONFIG_TARGET_OPOS6ULDEV
	bool "Armadeus OPOS6ULDev board"
	depends on UBOOT_CONFIG_MX6UL
	select UBOOT_CONFIG_MX6UL_OPOS6UL

config UBOOT_CONFIG_TARGET_PICO_IMX6
	bool "PICO-IMX6"
	depends on UBOOT_CONFIG_MX6QDL
	select UBOOT_CONFIG_BOARD_EARLY_INIT_F
	select UBOOT_CONFIG_BOARD_LATE_INIT
	select UBOOT_CONFIG_DM
	select UBOOT_CONFIG_DM_THERMAL
	select UBOOT_CONFIG_SUPPORT_SPL
	imply CMD_DM

config UBOOT_CONFIG_TARGET_PICO_IMX6UL
	bool "PICO-IMX6UL-EMMC"
	depends on UBOOT_CONFIG_MX6UL
	select UBOOT_CONFIG_DM
	select UBOOT_CONFIG_SUPPORT_SPL
	imply CMD_DM

config UBOOT_CONFIG_TARGET_LITEBOARD
	bool "Grinn liteBoard (i.MX6UL)"
	depends on UBOOT_CONFIG_MX6UL
	select UBOOT_CONFIG_BOARD_LATE_INIT
	select UBOOT_CONFIG_MX6UL_LITESOM

config UBOOT_CONFIG_TARGET_PCM058
	bool "Phytec PCM058 i.MX6 Quad"
	depends on UBOOT_CONFIG_MX6Q
	select UBOOT_CONFIG_BOARD_LATE_INIT
	select UBOOT_CONFIG_SUPPORT_SPL
	select UBOOT_CONFIG_DM
	select UBOOT_CONFIG_OF_CONTROL
	imply CMD_DM

config UBOOT_CONFIG_TARGET_PCL063
	bool "PHYTEC PCL063 (phyCORE-i.MX6UL)"
	depends on UBOOT_CONFIG_MX6UL
	select UBOOT_CONFIG_DM
	select UBOOT_CONFIG_DM_ETH
	select UBOOT_CONFIG_DM_GPIO
	select UBOOT_CONFIG_DM_I2C
	select UBOOT_CONFIG_DM_MMC
	select UBOOT_CONFIG_DM_SERIAL
	select UBOOT_CONFIG_DM_THERMAL
	select UBOOT_CONFIG_SUPPORT_SPL

config UBOOT_CONFIG_TARGET_PCL063_ULL
	bool "PHYTEC PCL063 (phyCORE-i.MX6ULL)"
	depends on UBOOT_CONFIG_MX6ULL
	select UBOOT_CONFIG_DM
	select UBOOT_CONFIG_DM_ETH
	select UBOOT_CONFIG_DM_GPIO
	select UBOOT_CONFIG_DM_I2C
	select UBOOT_CONFIG_DM_MMC
	select UBOOT_CONFIG_DM_SERIAL
	select UBOOT_CONFIG_DM_THERMAL
	select UBOOT_CONFIG_SUPPORT_SPL

config UBOOT_CONFIG_TARGET_SOMLABS_VISIONSOM_6ULL
	bool "visionsom-6ull"
	depends on UBOOT_CONFIG_MX6ULL
	select UBOOT_CONFIG_BOARD_LATE_INIT
	select UBOOT_CONFIG_DM
	select UBOOT_CONFIG_DM_ETH
	select UBOOT_CONFIG_DM_GPIO
	select UBOOT_CONFIG_DM_MMC
	select UBOOT_CONFIG_DM_SERIAL
	select UBOOT_CONFIG_DM_THERMAL
	imply CMD_DM

config UBOOT_CONFIG_TARGET_TBS2910
	bool "TBS2910 Matrix ARM mini PC"
	depends on UBOOT_CONFIG_MX6Q

config UBOOT_CONFIG_TARGET_KP_IMX6Q_TPC
	bool "K+P KP_IMX6Q_TPC i.MX6 Quad"
	depends on UBOOT_CONFIG_MX6QDL
	select UBOOT_CONFIG_BOARD_EARLY_INIT_F
	select UBOOT_CONFIG_BOARD_LATE_INIT
	select UBOOT_CONFIG_DM
	select UBOOT_CONFIG_SPL_DM if SPL
	select UBOOT_CONFIG_DM_THERMAL
	select UBOOT_CONFIG_DM_MMC
	select UBOOT_CONFIG_DM_ETH
	select UBOOT_CONFIG_DM_REGULATOR
	select UBOOT_CONFIG_SPL_DM_REGULATOR if SPL
	select UBOOT_CONFIG_DM_SERIAL
	select UBOOT_CONFIG_DM_I2C
	select UBOOT_CONFIG_DM_GPIO
	select UBOOT_CONFIG_SUPPORT_SPL
	select UBOOT_CONFIG_SPL_SEPARATE_BSS if SPL
	imply CMD_DM
	imply CMD_SPL

config UBOOT_CONFIG_TARGET_TQMA6
	bool "TQ-Systems TQMa6 board"
	select UBOOT_CONFIG_BOARD_EARLY_INIT_F
	select UBOOT_CONFIG_BOARD_LATE_INIT
	select UBOOT_CONFIG_MXC_SPI
	select UBOOT_CONFIG_SPI
	imply DM
	imply DM_GPIO
	imply DM_MMC
	imply DM_SPI
	imply DM_SPI_FLASH
	imply DM_I2C
	imply CMD_SF
	imply CMD_DM

config UBOOT_CONFIG_TARGET_UDOO
	bool "udoo"
	depends on UBOOT_CONFIG_MX6QDL
	select UBOOT_CONFIG_BOARD_LATE_INIT
	select UBOOT_CONFIG_SUPPORT_SPL
	imply CMD_DM

config UBOOT_CONFIG_TARGET_UDOO_NEO
	bool "UDOO Neo"
	depends on UBOOT_CONFIG_MX6SX
	select UBOOT_CONFIG_BOARD_LATE_INIT
	select UBOOT_CONFIG_DM
	select UBOOT_CONFIG_DM_THERMAL
	select UBOOT_CONFIG_SUPPORT_SPL
	imply CMD_DM

config UBOOT_CONFIG_TARGET_SOFTING_VINING_2000
	bool "Softing VIN|ING 2000"
	depends on UBOOT_CONFIG_MX6SX
	select UBOOT_CONFIG_BOARD_LATE_INIT
	select UBOOT_CONFIG_DM
	select UBOOT_CONFIG_DM_THERMAL
	select UBOOT_CONFIG_SUPPORT_SPL
	imply CMD_DM

config UBOOT_CONFIG_TARGET_WANDBOARD
	bool "wandboard"
	depends on UBOOT_CONFIG_MX6QDL
	select UBOOT_CONFIG_BOARD_LATE_INIT
	select UBOOT_CONFIG_SUPPORT_SPL

config UBOOT_CONFIG_TARGET_WARP
	bool "WaRP"
	depends on UBOOT_CONFIG_MX6SL
	select UBOOT_CONFIG_BOARD_LATE_INIT

config UBOOT_CONFIG_TARGET_BRPPT2
	bool "brppt2"
	depends on UBOOT_CONFIG_MX6QDL
	select UBOOT_CONFIG_BOARD_LATE_INIT
	select UBOOT_CONFIG_OF_CONTROL
	select UBOOT_CONFIG_SPL_OF_LIBFDT
	select UBOOT_CONFIG_DM
	select UBOOT_CONFIG_DM_ETH
	select UBOOT_CONFIG_DM_GPIO
	select UBOOT_CONFIG_DM_I2C
	select UBOOT_CONFIG_DM_MMC
	select UBOOT_CONFIG_SUPPORT_SPL
	select UBOOT_CONFIG_SPL_DM if SPL
	select UBOOT_CONFIG_SPL_OF_CONTROL if SPL
        help
          Support
          B&R BRPPT2 platform
          based on Freescale's iMX6 SoC

config UBOOT_CONFIG_TARGET_O4_IMX6ULL_NANO
	bool "O4-iMX6ULL-NANO"
	depends on UBOOT_CONFIG_MX6ULL
	select UBOOT_CONFIG_BOARD_LATE_INIT
	select UBOOT_CONFIG_DM
	select UBOOT_CONFIG_DM_THERMAL
	imply CMD_DM
	help
	  Support for www.out4.ru O4-iMX6UL-NANO platform
	  based on Freescale's i.MX6UL/i.MX6ULL SoC.

endchoice

config UBOOT_CONFIG_SYS_SOC
	default "mx6"

source "../../../../board/ge/bx50v3/Kconfig"
source "../../../../board/ge/b1x5v2/Kconfig"
source "../../../../board/aristainetos/Kconfig"
source "../../../../board/armadeus/opos6uldev/Kconfig"
source "../../../../board/boundary/nitrogen6x/Kconfig"
source "../../../../board/bticino/mamoj/Kconfig"
source "../../../../board/compulab/cm_fx6/Kconfig"
source "../../../../board/dhelectronics/dh_imx6/Kconfig"
source "../../../../board/embest/mx6boards/Kconfig"
source "../../../../board/engicam/imx6q/Kconfig"
source "../../../../board/engicam/imx6ul/Kconfig"
source "../../../../board/freescale/mx6memcal/Kconfig"
source "../../../../board/freescale/mx6sabreauto/Kconfig"
source "../../../../board/freescale/mx6sabresd/Kconfig"
source "../../../../board/freescale/mx6slevk/Kconfig"
source "../../../../board/freescale/mx6sllevk/Kconfig"
source "../../../../board/freescale/mx6sxsabresd/Kconfig"
source "../../../../board/freescale/mx6sxsabreauto/Kconfig"
source "../../../../board/freescale/mx6ul_14x14_evk/Kconfig"
source "../../../../board/freescale/mx6ullevk/Kconfig"
source "../../../../board/grinn/liteboard/Kconfig"
source "../../../../board/phytec/pcm058/Kconfig"
source "../../../../board/phytec/pcl063/Kconfig"
source "../../../../board/gateworks/gw_ventana/Kconfig"
source "../../../../board/kontron/sl-mx6ul/Kconfig"
source "../../../../board/kosagi/novena/Kconfig"
source "../../../../board/softing/vining_2000/Kconfig"
source "../../../../board/liebherr/display5/Kconfig"
source "../../../../board/liebherr/mccmon6/Kconfig"
source "../../../../board/logicpd/imx6/Kconfig"
source "../../../../board/solidrun/mx6cuboxi/Kconfig"
source "../../../../board/somlabs/visionsom-6ull/Kconfig"
source "../../../../board/technexion/pico-imx6/Kconfig"
source "../../../../board/technexion/pico-imx6ul/Kconfig"
source "../../../../board/tbs/tbs2910/Kconfig"
source "../../../../board/tq/tqma6/Kconfig"
source "../../../../board/toradex/apalis_imx6/Kconfig"
source "../../../../board/toradex/colibri_imx6/Kconfig"
source "../../../../board/toradex/colibri-imx6ull/Kconfig"
source "../../../../board/k+p/kp_imx6q_tpc/Kconfig"
source "../../../../board/udoo/Kconfig"
source "../../../../board/udoo/neo/Kconfig"
source "../../../../board/wandboard/Kconfig"
source "../../../../board/warp/Kconfig"
source "../../../../board/BuR/brppt2/Kconfig"
source "../../../../board/out4/o4-imx6ull-nano/Kconfig"

endif
```
