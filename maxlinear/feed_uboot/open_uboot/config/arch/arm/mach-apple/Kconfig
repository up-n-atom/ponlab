## maxlinear/feed_uboot/open_uboot/config/arch/arm/mach-imx/imx8m/Kconfig
```kconfig
if UBOOT_CONFIG_ARCH_IMX8M

config UBOOT_CONFIG_IMX8M
	bool
	select UBOOT_CONFIG_HAS_CAAM
	select UBOOT_CONFIG_ROM_UNIFIED_SECTIONS

config UBOOT_CONFIG_IMX8MQ
	bool
	select UBOOT_CONFIG_IMX8M

config UBOOT_CONFIG_IMX8MM
	bool
	select UBOOT_CONFIG_IMX8M

config UBOOT_CONFIG_IMX8MN
	bool
	select UBOOT_CONFIG_IMX8M

config UBOOT_CONFIG_IMX8MP
	bool
	select UBOOT_CONFIG_IMX8M

config UBOOT_CONFIG_SYS_SOC
	default "imx8m"

choice
	prompt "NXP i.MX8M board select"
	optional

config UBOOT_CONFIG_TARGET_IMX8MQ_CM
	bool "Ronetix iMX8MQ-CM SoM"
		select UBOOT_CONFIG_BINMAN
	select UBOOT_CONFIG_IMX8MQ
	select UBOOT_CONFIG_IMX8M_LPDDR4

config UBOOT_CONFIG_TARGET_IMX8MQ_EVK
	bool "imx8mq_evk"
	select UBOOT_CONFIG_BINMAN
	select UBOOT_CONFIG_IMX8MQ
	select UBOOT_CONFIG_IMX8M_LPDDR4

config UBOOT_CONFIG_TARGET_IMX8MQ_PHANBELL
	bool "imx8mq_phanbell"
	select UBOOT_CONFIG_BINMAN
	select UBOOT_CONFIG_IMX8MQ
	select UBOOT_CONFIG_IMX8M_LPDDR4

config UBOOT_CONFIG_TARGET_IMX8MM_EVK
	bool "imx8mm LPDDR4 EVK board"
	select UBOOT_CONFIG_BINMAN
	select UBOOT_CONFIG_IMX8MM
	select UBOOT_CONFIG_SUPPORT_SPL
	select UBOOT_CONFIG_IMX8M_LPDDR4

config UBOOT_CONFIG_TARGET_IMX8MM_ICORE_MX8MM
	bool "Engicam i.Core MX8M Mini SOM"
	select UBOOT_CONFIG_IMX8MM
	select UBOOT_CONFIG_SUPPORT_SPL
	select UBOOT_CONFIG_IMX8M_LPDDR4
	help
	  i.Core MX8M Mini is an EDIMM SOM based on NXP i.MX8MM.

	  i.Core MX8M Mini EDIMM2.2:
	  * EDIMM2.2 is a Form Factor Capacitive Evaluation Board.
	  * i.Core MX8M Mini needs to mount on top of EDIMM2.2 for
	    creating complete i.Core MX8M Mini EDIMM2.2 Starter Kit.

	  i.Core MX8M Mini C.TOUCH 2.0
	  * C.TOUCH 2.0 is a general purpose Carrier board.
	  * i.Core MX8M Mini needs to mount on top of this Carrier board
	    for creating complete i.Core MX8M Mini C.TOUCH 2.0 board.

config UBOOT_CONFIG_TARGET_IMX8MM_VENICE
	bool "Support Gateworks Venice iMX8M Mini module"
	select UBOOT_CONFIG_BINMAN
	select UBOOT_CONFIG_IMX8MM
	select UBOOT_CONFIG_SUPPORT_SPL
	select UBOOT_CONFIG_IMX8M_LPDDR4

config UBOOT_CONFIG_TARGET_KONTRON_MX8MM
	bool "Kontron Electronics N80xx"
	select UBOOT_CONFIG_BINMAN
	select UBOOT_CONFIG_IMX8MM
	select UBOOT_CONFIG_SUPPORT_SPL
	select UBOOT_CONFIG_IMX8M_LPDDR4

config UBOOT_CONFIG_TARGET_IMX8MN_EVK
	bool "imx8mn LPDDR4 EVK board"
	select UBOOT_CONFIG_BINMAN
	select UBOOT_CONFIG_IMX8MN
	select UBOOT_CONFIG_SUPPORT_SPL
	select UBOOT_CONFIG_IMX8M_LPDDR4

config UBOOT_CONFIG_TARGET_IMX8MN_DDR4_EVK
	bool "imx8mn DDR4 EVK board"
	select UBOOT_CONFIG_BINMAN
	select UBOOT_CONFIG_IMX8MN
	select UBOOT_CONFIG_SUPPORT_SPL
	select UBOOT_CONFIG_IMX8M_DDR4

config UBOOT_CONFIG_TARGET_IMX8MP_EVK
	bool "imx8mp LPDDR4 EVK board"
	select UBOOT_CONFIG_BINMAN
	select UBOOT_CONFIG_IMX8MP
	select UBOOT_CONFIG_SUPPORT_SPL
	select UBOOT_CONFIG_IMX8M_LPDDR4

config UBOOT_CONFIG_TARGET_PICO_IMX8MQ
	bool "Support Technexion Pico iMX8MQ"
	select UBOOT_CONFIG_BINMAN
	select UBOOT_CONFIG_IMX8MQ
	select UBOOT_CONFIG_IMX8M_LPDDR4

config UBOOT_CONFIG_TARGET_VERDIN_IMX8MM
	bool "Support Toradex Verdin iMX8M Mini module"
	select UBOOT_CONFIG_BINMAN
	select UBOOT_CONFIG_IMX8MM
	select UBOOT_CONFIG_SUPPORT_SPL
	select UBOOT_CONFIG_IMX8M_LPDDR4

config UBOOT_CONFIG_TARGET_IMX8MM_BEACON
	bool "imx8mm Beacon Embedded devkit"
	select UBOOT_CONFIG_BINMAN
	select UBOOT_CONFIG_IMX8MM
	select UBOOT_CONFIG_SUPPORT_SPL
	select UBOOT_CONFIG_IMX8M_LPDDR4

config UBOOT_CONFIG_TARGET_IMX8MN_BEACON
	bool "imx8mn Beacon Embedded devkit"
	select UBOOT_CONFIG_BINMAN
	select UBOOT_CONFIG_IMX8MN
	select UBOOT_CONFIG_SUPPORT_SPL
	select UBOOT_CONFIG_IMX8M_LPDDR4

config UBOOT_CONFIG_TARGET_PHYCORE_IMX8MM
	bool "PHYTEC PHYCORE i.MX8MM"
	select UBOOT_CONFIG_BINMAN
	select UBOOT_CONFIG_IMX8MM
	select UBOOT_CONFIG_SUPPORT_SPL
	select UBOOT_CONFIG_IMX8M_LPDDR4

config UBOOT_CONFIG_TARGET_PHYCORE_IMX8MP
	bool "PHYTEC PHYCORE i.MX8MP"
	select UBOOT_CONFIG_BINMAN
	select UBOOT_CONFIG_IMX8MP
	select UBOOT_CONFIG_SUPPORT_SPL
	select UBOOT_CONFIG_IMX8M_LPDDR4

config UBOOT_CONFIG_TARGET_IMX8MM_CL_IOT_GATE
	bool "CompuLab iot-gate-imx8"
	select UBOOT_CONFIG_BINMAN
	select UBOOT_CONFIG_IMX8MM
	select UBOOT_CONFIG_SUPPORT_SPL
	select UBOOT_CONFIG_IMX8M_LPDDR4

config UBOOT_CONFIG_TARGET_IMX8MM_CL_IOT_GATE_OPTEE
	bool "CompuLab iot-gate-imx8 with optee support"
	select UBOOT_CONFIG_BINMAN
	select UBOOT_CONFIG_IMX8MM
	select UBOOT_CONFIG_SUPPORT_SPL
	select UBOOT_CONFIG_IMX8M_LPDDR4
endchoice

source "../../../../board/beacon/imx8mm/Kconfig"
source "../../../../board/beacon/imx8mn/Kconfig"
source "../../../../board/compulab/imx8mm-cl-iot-gate/Kconfig"
source "../../../../board/engicam/imx8mm/Kconfig"
source "../../../../board/freescale/imx8mq_evk/Kconfig"
source "../../../../board/freescale/imx8mm_evk/Kconfig"
source "../../../../board/freescale/imx8mn_evk/Kconfig"
source "../../../../board/freescale/imx8mp_evk/Kconfig"
source "../../../../board/gateworks/venice/Kconfig"
source "../../../../board/google/imx8mq_phanbell/Kconfig"
source "../../../../board/kontron/sl-mx8mm/Kconfig"
source "../../../../board/phytec/phycore_imx8mm/Kconfig"
source "../../../../board/phytec/phycore_imx8mp/Kconfig"
source "../../../../board/ronetix/imx8mq-cm/Kconfig"
source "../../../../board/technexion/pico-imx8mq/Kconfig"
source "../../../../board/toradex/verdin-imx8mm/Kconfig"

endif
```

## maxlinear/feed_uboot/open_uboot/config/arch/arm/mach-imx/imxrt/Kconfig
```kconfig
if UBOOT_CONFIG_ARCH_IMXRT

config UBOOT_CONFIG_IMXRT
	bool

config UBOOT_CONFIG_IMXRT1020
	bool
	select UBOOT_CONFIG_IMXRT

config UBOOT_CONFIG_IMXRT1050
	bool
	select UBOOT_CONFIG_IMXRT

config UBOOT_CONFIG_SYS_SOC
	default "imxrt"

choice
	prompt "NXP i.MXRT board select"
	optional

config UBOOT_CONFIG_TARGET_IMXRT1020_EVK
	bool "Support imxrt1020 EVK board"
	select UBOOT_CONFIG_IMXRT1020

config UBOOT_CONFIG_TARGET_IMXRT1050_EVK
	bool "Support imxrt1050 EVK board"
	select UBOOT_CONFIG_IMXRT1050

endchoice

source "../../../../board/freescale/imxrt1020-evk/Kconfig"
source "../../../../board/freescale/imxrt1050-evk/Kconfig"

endif
```
