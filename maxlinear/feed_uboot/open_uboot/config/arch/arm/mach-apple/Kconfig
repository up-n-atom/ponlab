## maxlinear/feed_uboot/open_uboot/config/arch/arm/mach-apple/Kconfig
```kconfig
if UBOOT_CONFIG_ARCH_APPLE

config UBOOT_CONFIG_SYS_TEXT_BASE
	default 0x00000000

config UBOOT_CONFIG_SYS_CONFIG_NAME
	default "apple"

config UBOOT_CONFIG_SYS_SOC
	default "m1"

config UBOOT_CONFIG_SYS_MALLOC_LEN
	default 0x4000000

config UBOOT_CONFIG_SYS_MALLOC_F_LEN
	default 0x4000

endif
```

## maxlinear/feed_uboot/open_uboot/config/arch/arm/mach-aspeed/Kconfig
```kconfig
if UBOOT_CONFIG_ARCH_ASPEED

config UBOOT_CONFIG_SYS_ARCH
	default "arm"

config UBOOT_CONFIG_SYS_SOC
	default "aspeed"

config UBOOT_CONFIG_SYS_TEXT_BASE
	default 0x00000000

choice
	prompt "Aspeed SoC select"
	depends on UBOOT_CONFIG_ARCH_ASPEED
	default UBOOT_CONFIG_ASPEED_AST2500

config UBOOT_CONFIG_ASPEED_AST2500
	bool "Support Aspeed AST2500 SoC"
	depends on UBOOT_CONFIG_DM_RESET
	select UBOOT_CONFIG_CPU_ARM1176
	help
	  The Aspeed AST2500 is a ARM-based SoC with arm1176 CPU.
	  It is used as Board Management Controller on many server boards,
	  which is enabled by support of LPC and eSPI peripherals.

config UBOOT_CONFIG_ASPEED_AST2600
	bool "Support Aspeed AST2600 SoC"
	select UBOOT_CONFIG_CPU_V7A
	select UBOOT_CONFIG_CPU_V7_HAS_NONSEC
	select UBOOT_CONFIG_SYS_ARCH_TIMER
	select UBOOT_CONFIG_SUPPORT_SPL
	select UBOOT_CONFIG_ENABLE_ARM_SOC_BOOT0_HOOK
	help
	  The Aspeed AST2600 is a ARM-based SoC with Cortex-A7 CPU.
	  It is used as Board Management Controller on many server boards,
	  which is enabled by support of LPC and eSPI peripherals.

endchoice

source "ast2500/Kconfig"
source "ast2600/Kconfig"

endif
```

## maxlinear/feed_uboot/open_uboot/config/arch/arm/mach-exynos/Kconfig
```kconfig
if UBOOT_CONFIG_ARCH_EXYNOS

choice
	prompt "EXYNOS architecture type select"
	optional

config UBOOT_CONFIG_ARCH_EXYNOS4
	bool "Exynos4 SoC family"
	select UBOOT_CONFIG_BOARD_EARLY_INIT_F
	select UBOOT_CONFIG_CPU_V7A
	select UBOOT_CONFIG_BLK
	select UBOOT_CONFIG_DM_MMC
	help
	  Samsung Exynos4 SoC family are based on ARM Cortex-A9 CPU. There
	  are multiple SoCs in this family including Exynos4210, Exynos4412,
	  and Exynos4212.

config UBOOT_CONFIG_ARCH_EXYNOS5
	bool "Exynos5 SoC family"
	select UBOOT_CONFIG_BOARD_EARLY_INIT_F
	select UBOOT_CONFIG_CPU_V7A
	select UBOOT_CONFIG_SHA_HW_ACCEL
	imply CMD_HASH
	imply CRC32_VERIFY
	imply HASH_VERIFY
	imply USB_ETHER_ASIX
	imply USB_ETHER_RTL8152
	imply USB_ETHER_SMSC95XX
	select UBOOT_CONFIG_BLK
	select UBOOT_CONFIG_DM_MMC

	help
	  Samsung Exynos5 SoC family are based on ARM Cortex-A15 CPU (and
	  Cortex-A7 CPU in big.LITTLE configuration). There are multiple SoCs
	  in this family including Exynos5250, Exynos5420 and Exynos5800.

config UBOOT_CONFIG_ARCH_EXYNOS7
	bool "Exynos7 SoC family"
	select UBOOT_CONFIG_ARM64
	select UBOOT_CONFIG_BOARD_EARLY_INIT_F
	select UBOOT_CONFIG_BLK
	select UBOOT_CONFIG_DM_MMC
	help
	  Samsung Exynos7 SoC family are based on ARM Cortex-A57 CPU or
	  Cortex-A53 CPU (and some in a big.LITTLE configuration). There are
	  multiple SoCs in this family including Exynos7420.

endchoice

if UBOOT_CONFIG_ARCH_EXYNOS4

choice
	prompt "EXYNOS4 board select"

config UBOOT_CONFIG_TARGET_SMDKV310
	bool "Exynos4210 SMDKV310 board"
	select UBOOT_CONFIG_OF_CONTROL
	select UBOOT_CONFIG_SUPPORT_SPL

config UBOOT_CONFIG_TARGET_TRATS
	bool "Exynos4210 Trats board"

config UBOOT_CONFIG_TARGET_S5PC210_UNIVERSAL
	bool "EXYNOS4210 Universal C210 board"

config UBOOT_CONFIG_TARGET_ORIGEN
	bool "Exynos4412 Origen board"
	select UBOOT_CONFIG_SUPPORT_SPL

config UBOOT_CONFIG_TARGET_TRATS2
	bool "Exynos4412 Trat2 board"

config UBOOT_CONFIG_TARGET_ODROID
	bool "Exynos4412 Odroid board"

endchoice
endif

if UBOOT_CONFIG_ARCH_EXYNOS5

config UBOOT_CONFIG_SPL_GPIO
	default y

config UBOOT_CONFIG_SPL_LIBCOMMON_SUPPORT
	default y

config UBOOT_CONFIG_SPL_LIBGENERIC_SUPPORT
	default y

choice
	prompt "EXYNOS5 board select"

config UBOOT_CONFIG_TARGET_ODROID_XU3
	bool "Exynos5422 Odroid board"
	select UBOOT_CONFIG_OF_CONTROL

config UBOOT_CONFIG_TARGET_ARNDALE
	bool "Exynos5250 Arndale board"
	select UBOOT_CONFIG_ARM_ERRATA_773022
	select UBOOT_CONFIG_ARM_ERRATA_774769
	select UBOOT_CONFIG_CPU_V7_HAS_NONSEC
	select UBOOT_CONFIG_CPU_V7_HAS_VIRT
	select UBOOT_CONFIG_OF_CONTROL
	select UBOOT_CONFIG_SUPPORT_SPL

config UBOOT_CONFIG_TARGET_SMDK5250
	bool "SMDK5250 board"
	select UBOOT_CONFIG_OF_CONTROL
	select UBOOT_CONFIG_SUPPORT_SPL

config UBOOT_CONFIG_TARGET_SNOW
	bool "Snow board"
	select UBOOT_CONFIG_OF_CONTROL
	select UBOOT_CONFIG_SUPPORT_SPL

config UBOOT_CONFIG_TARGET_SPRING
	bool "Spring board"
	select UBOOT_CONFIG_OF_CONTROL
	select UBOOT_CONFIG_SUPPORT_SPL

config UBOOT_CONFIG_TARGET_SMDK5420
	bool "SMDK5420 board"
	select UBOOT_CONFIG_OF_CONTROL
	select UBOOT_CONFIG_SUPPORT_SPL

config UBOOT_CONFIG_TARGET_PEACH_PI
	bool "Peach Pi board"
	select UBOOT_CONFIG_OF_CONTROL
	select UBOOT_CONFIG_SUPPORT_SPL

config UBOOT_CONFIG_TARGET_PEACH_PIT
	bool "Peach Pit board"
	select UBOOT_CONFIG_OF_CONTROL
	select UBOOT_CONFIG_SUPPORT_SPL

endchoice
endif

if UBOOT_CONFIG_ARCH_EXYNOS7

choice
	prompt "EXYNOS7 board select"

config UBOOT_CONFIG_TARGET_ESPRESSO7420
	bool "ESPRESSO7420 board"
	select UBOOT_CONFIG_ARM64
	select UBOOT_CONFIG_ARMV8_MULTIENTRY
	select UBOOT_CONFIG_CLK_EXYNOS
	select UBOOT_CONFIG_OF_CONTROL
	select UBOOT_CONFIG_PINCTRL
	select UBOOT_CONFIG_PINCTRL_EXYNOS7420
	select UBOOT_CONFIG_SUPPORT_SPL

config  UBOOT_CONFIG_TARGET_A5Y17LTE
	bool "Samsung SM-A520F board"
	select UBOOT_CONFIG_ARM64
	select UBOOT_CONFIG_CLK_EXYNOS
	select UBOOT_CONFIG_OF_CONTROL
	select UBOOT_CONFIG_PINCTRL
	select UBOOT_CONFIG_PINCTRL_EXYNOS78x0
	select UBOOT_CONFIG_SUPPORT_SPL

config  UBOOT_CONFIG_TARGET_A7Y17LTE
	bool "Samsung SM-A520F board"
	select UBOOT_CONFIG_ARM64
	select UBOOT_CONFIG_CLK_EXYNOS
	select UBOOT_CONFIG_OF_CONTROL
	select UBOOT_CONFIG_PINCTRL
	select UBOOT_CONFIG_PINCTRL_EXYNOS78x0
	select UBOOT_CONFIG_SUPPORT_SPL

config  UBOOT_CONFIG_TARGET_A3Y17LTE
	bool "Samsung SM-A520F board"
	select UBOOT_CONFIG_ARM64
	select UBOOT_CONFIG_CLK_EXYNOS
	select UBOOT_CONFIG_OF_CONTROL
	select UBOOT_CONFIG_PINCTRL
	select UBOOT_CONFIG_PINCTRL_EXYNOS7880
	select UBOOT_CONFIG_SUPPORT_SPL

endchoice
endif

config UBOOT_CONFIG_SYS_SOC
	default "exynos"

source "../../../board/samsung/smdkv310/Kconfig"
source "../../../board/samsung/trats/Kconfig"
source "../../../board/samsung/universal_c210/Kconfig"
source "../../../board/samsung/origen/Kconfig"
source "../../../board/samsung/trats2/Kconfig"
source "../../../board/samsung/odroid/Kconfig"
source "../../../board/samsung/arndale/Kconfig"
source "../../../board/samsung/smdk5250/Kconfig"
source "../../../board/samsung/smdk5420/Kconfig"
source "../../../board/samsung/espresso7420/Kconfig"
source "../../../board/samsung/axy17lte/Kconfig"

config UBOOT_CONFIG_SPL_LDSCRIPT
	default "board/samsung/common/exynos-uboot-spl.lds" if UBOOT_CONFIG_ARCH_EXYNOS5 || UBOOT_CONFIG_ARCH_EXYNOS4

endif
```

## maxlinear/feed_uboot/open_uboot/config/arch/arm/mach-imx/Kconfig
```kconfig
config UBOOT_CONFIG_MACH_IMX
	bool

config UBOOT_CONFIG_HAS_CAAM
	bool

config UBOOT_CONFIG_IMX_CONFIG
	string "DCD script to use"
	depends on UBOOT_CONFIG_MACH_IMX
	default "arch/arm/mach-imx/spl_sd.cfg"

config UBOOT_CONFIG_ROM_UNIFIED_SECTIONS
	bool

config UBOOT_CONFIG_SYSCOUNTER_TIMER
	bool

config UBOOT_CONFIG_GPT_TIMER
	bool

config UBOOT_CONFIG_IMX_RDC
	bool "i.MX Resource domain controller driver"
	depends on UBOOT_CONFIG_ARCH_MX6 || UBOOT_CONFIG_ARCH_MX7
	help
	  i.MX Resource domain controller is used to assign masters
	  and peripherals to differet domains. This can be used to
	  isolate resources.

config UBOOT_CONFIG_IMX_BOOTAUX
	bool "Support boot auxiliary core"
	depends on UBOOT_CONFIG_ARCH_MX7 || UBOOT_CONFIG_ARCH_MX6 || UBOOT_CONFIG_ARCH_VF610 || UBOOT_CONFIG_ARCH_IMX8M
	help
	  bootaux [addr] to boot auxiliary core.

config UBOOT_CONFIG_IMX_MODULE_FUSE
	bool "i.MX Module Fuse"
	depends on UBOOT_CONFIG_ARCH_MX6
	help
	  i.MX module fuse to runtime disable some driver, including
	  Linux OS device node.

config UBOOT_CONFIG_USE_IMXIMG_PLUGIN
	bool "Use imximage plugin code"
	depends on UBOOT_CONFIG_ARCH_MX7 || UBOOT_CONFIG_ARCH_MX6 || UBOOT_CONFIG_ARCH_MX7ULP
	help
	  i.MX6/7 supports DCD and Plugin. Enable this configuration
	  to use Plugin, otherwise DCD will be used.

config UBOOT_CONFIG_IMX_HAB
	bool "Support i.MX HAB features"
	depends on UBOOT_CONFIG_ARCH_MX7 || UBOOT_CONFIG_ARCH_MX6 || UBOOT_CONFIG_ARCH_MX5 || UBOOT_CONFIG_ARCH_IMX8M || UBOOT_CONFIG_ARCH_MX7ULP
	select UBOOT_CONFIG_FSL_CAAM if HAS_CAAM
	imply CMD_DEKBLOB if HAS_CAAM
	help
	  This option enables the support for secure boot (HAB).
	  See doc/imx/habv4/* for more details.

config UBOOT_CONFIG_CSF_SIZE
	hex "Maximum size for Command Sequence File (CSF) binary"
	depends on UBOOT_CONFIG_IMX_HAB
	default 0x2000 if UBOOT_CONFIG_ARCH_IMX8M
	default 0x2060
	help
	  Define the maximum size for Command Sequence File (CSF) binary
	  this information is used to define the image boot data.

config UBOOT_CONFIG_CMD_BMODE
	bool "Support the 'bmode' command"
	default y
	depends on UBOOT_CONFIG_ARCH_MX7 || UBOOT_CONFIG_ARCH_MX6 || UBOOT_CONFIG_ARCH_MX5
	help
	  This enables the 'bmode' (bootmode) command for forcing
	  a boot from specific media.

	  This is useful for forcing the ROM's usb downloader to
	  activate upon a watchdog reset which is nice when iterating
	  on U-Boot.  Using the reset button or running bmode normal
	  will set it back to normal.  This command currently
	  supports i.MX53 and i.MX6.

config UBOOT_CONFIG_CMD_DEKBLOB
	bool "Support the 'dek_blob' command"
	select UBOOT_CONFIG_IMX_CAAM_DEK_ENCAP if ARCH_MX6 || UBOOT_CONFIG_ARCH_MX7 || UBOOT_CONFIG_ARCH_MX7ULP
	select UBOOT_CONFIG_IMX_OPTEE_DEK_ENCAP if ARCH_IMX8M
	select UBOOT_CONFIG_IMX_SECO_DEK_ENCAP if ARCH_IMX8
	help
	  This enables the 'dek_blob' command which is used with the
	  Freescale secure boot mechanism. This command encapsulates and
	  creates a blob of data. See also CMD_BLOB and doc/imx/habv4/* for
	  more information.

config UBOOT_CONFIG_IMX_CAAM_DEK_ENCAP
	bool "Support the DEK blob encapsulation with CAAM U-Boot driver"
	help
	  This enables the DEK blob encapsulation with the U-Boot CAAM driver.
	  This option is only available on imx6, imx7 and imx7ulp.

config UBOOT_CONFIG_IMX_OPTEE_DEK_ENCAP
	select UBOOT_CONFIG_TEE
	select UBOOT_CONFIG_OPTEE
	bool "Support the DEK blob encapsulation with OP-TEE"
	help
	  This enabled the DEK blob encapsulation with OP-TEE. The communication
	  with OP-TEE is done through a SMC call and OP-TEE shared memory. This
	  option is available on imx8mm.

config UBOOT_CONFIG_IMX_SECO_DEK_ENCAP
	bool "Support the DEK blob encapsulation with SECO"
	help
	  This enabled the DEK blob encapsulation with the SECO API. This option
	  is only available on imx8.

config UBOOT_CONFIG_CMD_PRIBLOB
	bool "Support the set_priblob_bitfield command"
	depends on UBOOT_CONFIG_HAS_CAAM && UBOOT_CONFIG_IMX_HAB
	help
	  This option enables the priblob command which can be used
		to set the priblob setting to 0x3.

config UBOOT_CONFIG_CMD_HDMIDETECT
	bool "Support the 'hdmidet' command"
	help
	  This enables the 'hdmidet' command which detects if an HDMI monitor
	  is connected.

config UBOOT_CONFIG_CMD_NANDBCB
	bool "i.MX6 NAND Boot Control Block(BCB) command"
	depends on UBOOT_CONFIG_MTD_RAW_NAND && UBOOT_CONFIG_CMD_MTDPARTS
	select UBOOT_CONFIG_BCH if MX6UL || UBOOT_CONFIG_MX6ULL
	default y if (UBOOT_CONFIG_(ARCH_MX6 || UBOOT_CONFIG_ARCH_MX7 || UBOOT_CONFIG_ARCH_IMX8M) && UBOOT_CONFIG_NAND_MXS)
	help
	  Unlike normal 'nand write/erase' commands, this command update
	  Boot Control Block(BCB) for i.MX6 platform NAND IP's.

	  This is similar to kobs-ng, which is used in Linux as separate
	  rootfs package.

config UBOOT_CONFIG_FSL_MFGPROT
	bool "Support the 'mfgprot' command"
	depends on UBOOT_CONFIG_IMX_HAB && UBOOT_CONFIG_ARCH_MX7
	help
	  This option enables the manufacturing protection command
	  which can be used has a protection feature for Manufacturing
	  process. With this tool is possible to authenticate the
	  chip to the OEM's server.

config UBOOT_CONFIG_NXP_BOARD_REVISION
	bool "Read NXP board revision from fuses"
	depends on UBOOT_CONFIG_ARCH_MX6 || UBOOT_CONFIG_ARCH_MX7
	help
	  NXP boards based on i.MX6/7 contain the board revision information
	  stored in the fuses. Select this option if you want to be able to
	  retrieve the board revision information.

config UBOOT_CONFIG_DDRMC_VF610_CALIBRATION
	bool "Enable DDRMC (DDR3) on-chip calibration"
	depends on UBOOT_CONFIG_ARCH_VF610
	help
	  Vybrid (vf610) SoC provides some on-chip facility to tune the DDR3
	  memory parameters. Select this option if you want to calculate them
	  at boot time.
	  NOTE:
	  NXP does NOT recommend to perform this calibration at each boot. One
	  shall perform it on a new PCB and then use those values to program
	  the ddrmc_cr_setting on relevant board file.

config UBOOT_CONFIG_SPL_IMX_ROMAPI_LOADADDR
	hex "Default load address to load image through ROM API"
	depends on UBOOT_CONFIG_IMX8MN || UBOOT_CONFIG_IMX8MP || UBOOT_CONFIG_IMX8ULP

config UBOOT_CONFIG_IMX_DCD_ADDR
	hex "DCD Blocks location on the image"
	default 0x00910000 if ! UBOOT_CONFIG_ARCH_MX7ULP
	default 0x2f010000 if UBOOT_CONFIG_ARCH_MX7ULP
	help
	  Indicates where the Device Configuration Data, a binary table used by
	  the ROM code to configure the device at early boot stage, is located.
	  This information is shared with the user via mkimage -l just so the
	  image can be signed.

config UBOOT_CONFIG_SPL_LOAD_IMX_CONTAINER
	bool "Enable SPL loading U-Boot as a i.MX Container image"
	depends on UBOOT_CONFIG_SPL
	help
	  This is to let SPL could load i.MX Container image

config UBOOT_CONFIG_IMX_CONTAINER_CFG
	string "i.MX Container config file"
	depends on UBOOT_CONFIG_SPL
	help
	  This is to specific the cfg file for generating container
	  image which will be loaded by SPL.
```
