## maxlinear/feed_uboot/open_uboot/config/arch/arm/mach-imx/mx7/Kconfig
```kconfig
if UBOOT_CONFIG_ARCH_MX7

config UBOOT_CONFIG_MX7
	bool
	default y
	select UBOOT_CONFIG_ARCH_SUPPORT_PSCI
	select UBOOT_CONFIG_CPU_V7_HAS_NONSEC
	select UBOOT_CONFIG_CPU_V7_HAS_VIRT
	select UBOOT_CONFIG_ROM_UNIFIED_SECTIONS
	select UBOOT_CONFIG_SYSCOUNTER_TIMER
	imply CMD_FUSE

config UBOOT_CONFIG_MX7D
	bool
	select UBOOT_CONFIG_HAS_CAAM
	select UBOOT_CONFIG_ROM_UNIFIED_SECTIONS
	imply CMD_FUSE

config UBOOT_CONFIG_SYS_TEXT_BASE
	default 0x87800000

config UBOOT_CONFIG_SPL_TEXT_BASE
	depends on UBOOT_CONFIG_SPL
	default 0x00912000

config UBOOT_CONFIG_OPTEE_TZDRAM_SIZE
	hex "Amount of Trust-Zone RAM for the OPTEE image"
	default 0x0000000
	depends on UBOOT_CONFIG_OPTEE_LIB
	help
	  The size of pre-allocated Trust Zone DRAM to allocate for the OPTEE
	  runtime.

choice
	prompt "MX7 board select"
	optional

config UBOOT_CONFIG_TARGET_CL_SOM_IMX7
	bool "CL-SOM-iMX7"
	select UBOOT_CONFIG_DM
	select UBOOT_CONFIG_DM_THERMAL
	select UBOOT_CONFIG_MX7D
	select UBOOT_CONFIG_SUPPORT_SPL
	imply CMD_DM

config UBOOT_CONFIG_TARGET_IMX7_CM
	bool "Ronetix iMX7-CM"
	select UBOOT_CONFIG_BOARD_LATE_INIT
	select UBOOT_CONFIG_DM
	select UBOOT_CONFIG_DM_THERMAL
	select UBOOT_CONFIG_MX7D
	select UBOOT_CONFIG_SUPPORT_SPL
	imply CMD_DM

config UBOOT_CONFIG_TARGET_MEERKAT96
	bool "NovTech Meerkat96 board"
	select UBOOT_CONFIG_BOARD_LATE_INIT
	select UBOOT_CONFIG_DM
	select UBOOT_CONFIG_DM_SERIAL
	select UBOOT_CONFIG_DM_THERMAL
	select UBOOT_CONFIG_MX7D
	imply CMD_DM

config UBOOT_CONFIG_TARGET_MX7DSABRESD
	bool "mx7dsabresd"
	select UBOOT_CONFIG_BOARD_LATE_INIT
	select UBOOT_CONFIG_DM
	select UBOOT_CONFIG_DM_THERMAL
	select UBOOT_CONFIG_MX7D
	imply CMD_DM

config UBOOT_CONFIG_TARGET_PICO_IMX7D
	bool "pico-imx7d"
	select UBOOT_CONFIG_BOARD_LATE_INIT
	select UBOOT_CONFIG_DM
	select UBOOT_CONFIG_DM_THERMAL
	select UBOOT_CONFIG_MX7D
	select UBOOT_CONFIG_SUPPORT_SPL
	imply CMD_DM

config UBOOT_CONFIG_TARGET_SMEGW01
	bool "smegw01"
	select UBOOT_CONFIG_BOARD_LATE_INIT
	select UBOOT_CONFIG_DM
	select UBOOT_CONFIG_DM_THERMAL
	select UBOOT_CONFIG_MX7D
	imply CMD_DM

config UBOOT_CONFIG_TARGET_WARP7
	bool "warp7"
	select UBOOT_CONFIG_BOARD_LATE_INIT
	select UBOOT_CONFIG_DM
	select UBOOT_CONFIG_DM_THERMAL
	select UBOOT_CONFIG_MX7D
	imply CMD_DM

config UBOOT_CONFIG_TARGET_COLIBRI_IMX7
	bool "Support Colibri iMX7S/iMX7D modules"
	select UBOOT_CONFIG_DM
	select UBOOT_CONFIG_DM_SERIAL
	select UBOOT_CONFIG_DM_THERMAL
	select UBOOT_CONFIG_MX7D
	imply CMD_DM

endchoice

config UBOOT_CONFIG_SYS_SOC
	default "mx7"

source "../../../../board/compulab/cl-som-imx7/Kconfig"
source "../../../../board/ronetix/imx7-cm/Kconfig"
source "../../../../board/freescale/mx7dsabresd/Kconfig"
source "../../../../board/novtech/meerkat96/Kconfig"
source "../../../../board/storopack/smegw01/Kconfig"
source "../../../../board/technexion/pico-imx7d/Kconfig"
source "../../../../board/toradex/colibri_imx7/Kconfig"
source "../../../../board/warp7/Kconfig"

endif
```

## maxlinear/feed_uboot/open_uboot/config/arch/arm/mach-imx/mx7ulp/Kconfig
```kconfig
if UBOOT_CONFIG_ARCH_MX7ULP

config UBOOT_CONFIG_SYS_SOC
	default "mx7ulp"

config UBOOT_CONFIG_LDO_ENABLED_MODE
	bool "i.MX7ULP LDO Enabled Mode"
	help
	  Select this option to enable the PMC1 LDO.

config UBOOT_CONFIG_MX7ULP
	select UBOOT_CONFIG_HAS_CAAM
	bool

choice
	prompt "MX7ULP board select"
	optional

config UBOOT_CONFIG_TARGET_MX7ULP_COM
	bool "Support MX7ULP COM board"
	select UBOOT_CONFIG_MX7ULP
	select UBOOT_CONFIG_SYS_ARCH_TIMER

config UBOOT_CONFIG_TARGET_MX7ULP_EVK
	bool "Support mx7ulp EVK board"
	select UBOOT_CONFIG_MX7ULP
	select UBOOT_CONFIG_SYS_ARCH_TIMER

endchoice

source "../../../../board/ea/mx7ulp_com/Kconfig"
source "../../../../board/freescale/mx7ulp_evk/Kconfig"

endif
```

## maxlinear/feed_uboot/open_uboot/config/arch/arm/mach-integrator/Kconfig
```kconfig
menu "Integrator Options"
	depends on UBOOT_CONFIG_ARCH_INTEGRATOR

choice
	prompt "Integrator platform select"
	optional

config UBOOT_CONFIG_ARCH_INTEGRATOR_AP
	bool "Support Integrator/AP platform"

config UBOOT_CONFIG_ARCH_INTEGRATOR_CP
	bool "Support Integrator/CP platform"
	select UBOOT_CONFIG_ARCH_CINTEGRATOR

endchoice

config UBOOT_CONFIG_ARCH_CINTEGRATOR
	bool

choice
	prompt "Integrator core module select"
	optional

config UBOOT_CONFIG_CM720T
	bool "Core Module for ARM720T"
	select UBOOT_CONFIG_CPU_ARM720T

config UBOOT_CONFIG_CM920T
	bool "Core Module for ARM920T"
	select UBOOT_CONFIG_CPU_ARM920T

config UBOOT_CONFIG_CM926EJ_S
	bool "Core Module for ARM926EJ-STM"
	select UBOOT_CONFIG_CPU_ARM926EJS

config UBOOT_CONFIG_CM946ES
	bool "Core Module for ARM946E-STM"
	select UBOOT_CONFIG_CPU_ARM946ES

config UBOOT_CONFIG_CM1136
	bool "Core Module for ARM1136JF-STM"
	select UBOOT_CONFIG_CPU_ARM1136

endchoice

config UBOOT_CONFIG_SYS_BOARD
	default "integrator"

config UBOOT_CONFIG_SYS_VENDOR
	default "armltd"

config UBOOT_CONFIG_SYS_CONFIG_NAME
	default "integratorap" if UBOOT_CONFIG_ARCH_INTEGRATOR_AP
	default "integratorcp" if UBOOT_CONFIG_ARCH_INTEGRATOR_CP

config UBOOT_CONFIG_SYS_MALLOC_F_LEN
	default 0x2000

endmenu
```

## maxlinear/feed_uboot/open_uboot/config/arch/arm/mach-keystone/Kconfig
```kconfig
if UBOOT_CONFIG_ARCH_KEYSTONE

choice
	prompt "TI Keystone board select"
	optional

config UBOOT_CONFIG_TARGET_K2HK_EVM
	bool "TI Keystone 2 Kepler/Hawking EVM"
	select UBOOT_CONFIG_SOC_K2HK
	select UBOOT_CONFIG_SPL_BOARD_INIT if SPL
	select UBOOT_CONFIG_CMD_DDR3
	imply DM_I2C
	imply SOC_TI
	imply TI_KEYSTONE_SERDES

config UBOOT_CONFIG_TARGET_K2E_EVM
	bool "TI Keystone 2 Edison EVM"
	select UBOOT_CONFIG_SOC_K2E
	select UBOOT_CONFIG_SPL_BOARD_INIT if SPL
	select UBOOT_CONFIG_CMD_DDR3
	imply DM_I2C
	imply SOC_TI
	imply TI_KEYSTONE_SERDES

config UBOOT_CONFIG_TARGET_K2L_EVM
	bool "TI Keystone 2 Lamar EVM"
	select UBOOT_CONFIG_SOC_K2L
	select UBOOT_CONFIG_SPL_BOARD_INIT if SPL
	select UBOOT_CONFIG_CMD_DDR3
	imply DM_I2C
	imply SOC_TI
	imply TI_KEYSTONE_SERDES

config UBOOT_CONFIG_TARGET_K2G_EVM
	bool "TI Keystone 2 Galileo EVM"
        select UBOOT_CONFIG_BOARD_LATE_INIT
	select UBOOT_CONFIG_SOC_K2G
	select UBOOT_CONFIG_SPL_BOARD_INIT if SPL
        select UBOOT_CONFIG_TI_I2C_BOARD_DETECT
	select UBOOT_CONFIG_CMD_DDR3
	imply DM_I2C
	imply SOC_TI
	imply TI_KEYSTONE_SERDES

endchoice

config UBOOT_CONFIG_SOC_K2E
	bool

config UBOOT_CONFIG_SOC_K2G
	bool

config UBOOT_CONFIG_SOC_K2HK
	bool

config UBOOT_CONFIG_SOC_K2L
	bool

config UBOOT_CONFIG_SYS_SOC
	default "keystone"

source "../../../board/ti/ks2_evm/Kconfig"

endif
```

## maxlinear/feed_uboot/open_uboot/config/arch/arm/mach-meson/Kconfig
```kconfig
if UBOOT_CONFIG_ARCH_MESON

config UBOOT_CONFIG_MESON64_COMMON
	bool
	select UBOOT_CONFIG_ARM64
	select UBOOT_CONFIG_CLK
	select UBOOT_CONFIG_DM
	select UBOOT_CONFIG_DM_SERIAL
	select UBOOT_CONFIG_SYSCON
	select UBOOT_CONFIG_REGMAP
	select UBOOT_CONFIG_PWRSEQ
	select UBOOT_CONFIG_MMC_PWRSEQ
	select UBOOT_CONFIG_BOARD_LATE_INIT
	imply CMD_DM

config UBOOT_CONFIG_MESON_GX
	bool
	select UBOOT_CONFIG_MESON64_COMMON

choice
	prompt "Platform select"
	default UBOOT_CONFIG_MESON_GXBB

config UBOOT_CONFIG_MESON_GXBB
	bool "GXBB"
	select UBOOT_CONFIG_MESON_GX
	help
	  Select this if your SoC is an S905

config UBOOT_CONFIG_MESON_GXL
	bool "GXL"
	select UBOOT_CONFIG_MESON_GX
	help
	  Select this if your SoC is an S905X/D or S805X

config UBOOT_CONFIG_MESON_GXM
	bool "GXM"
	select UBOOT_CONFIG_MESON_GX
	help
	  Select this if your SoC is an S912

config UBOOT_CONFIG_MESON_AXG
	bool "AXG"
	select UBOOT_CONFIG_MESON64_COMMON
	help
	  Select this if your SoC is an A113X/D

config UBOOT_CONFIG_MESON_G12A
	bool "G12A"
	select UBOOT_CONFIG_MESON64_COMMON
	help
	  Select this if your SoC is an S905X/D2

endchoice

config UBOOT_CONFIG_SYS_SOC
	default "meson"

config UBOOT_CONFIG_SYS_MALLOC_F_LEN
	default 0x1000

config UBOOT_CONFIG_SYS_VENDOR
	string "Vendor name"
	default "amlogic"
	help
	  This option contains information about board name.
	  Based on this option board/<CONFIG_SYS_VENDOR>/<CONFIG_SYS_BOARD> will
	  be used.

config UBOOT_CONFIG_SYS_BOARD
	string "Board name"
	default "p200" if UBOOT_CONFIG_MESON_GXBB
	default "p212" if UBOOT_CONFIG_MESON_GXL
	default "q200" if UBOOT_CONFIG_MESON_GXM
	default "s400" if UBOOT_CONFIG_MESON_AXG
	default "u200" if UBOOT_CONFIG_MESON_G12A
	default ""
	help
	  This option contains information about board name.
	  Based on this option board/<CONFIG_SYS_VENDOR>/<CONFIG_SYS_BOARD> will
	  be used.

config UBOOT_CONFIG_SYS_CONFIG_NAME
	string "Board configuration name"
	default "meson64"
	help
	  This option contains information about board configuration name.
	  Based on this option include/configs/<CONFIG_SYS_CONFIG_NAME>.h header
	  will be used for board configuration.

endif
```

## maxlinear/feed_uboot/open_uboot/config/arch/arm/mach-nexell/Kconfig
```kconfig
if UBOOT_CONFIG_ARCH_NEXELL

config UBOOT_CONFIG_ARCH_S5P4418
	bool "Nexell S5P4418 SoC"
	select UBOOT_CONFIG_CPU_V7A
	select UBOOT_CONFIG_OF_CONTROL
	select UBOOT_CONFIG_OF_SEPARATE
	select UBOOT_CONFIG_NX_GPIO
	select UBOOT_CONFIG_PL011_SERIAL
	select UBOOT_CONFIG_PL011_SERIAL_FLUSH_ON_INIT
	help
	  Enable support for Nexell S5P4418 SoC.

config UBOOT_CONFIG_ARCH_S5P6818
	bool "Nexell S5P6818 SoC"
	select UBOOT_CONFIG_ARM64
	select UBOOT_CONFIG_ARMV8_MULTIENTRY
	help
	  Enable support for Nexell S5P6818 SoC.

menu "Nexell S5P4418/S5P6818"
	depends on UBOOT_CONFIG_ARCH_NEXELL

choice
	prompt "Nexell S5P4418/S5P6818 board select"
	optional

config UBOOT_CONFIG_TARGET_NANOPI2
	bool "FriendlyARM NanoPi2 / NanoPC-T2 Board"
	select UBOOT_CONFIG_ARCH_S5P4418
	help
	  Enable support for FriendlyARM NanoPi2 and NanoPC-T2 Boards.

endchoice

config UBOOT_CONFIG_SYS_BOARD
	default "nanopi2"

config UBOOT_CONFIG_SYS_VENDOR
	default "friendlyarm"

config UBOOT_CONFIG_SYS_SOC
	default "nexell"

config UBOOT_CONFIG_SYS_CONFIG_NAME
	default "s5p4418_nanopi2"

endmenu

config UBOOT_CONFIG_SYS_PLLFIN
	int

config UBOOT_CONFIG_TIMER_SYS_TICK_CH
	int

source "../../../board/friendlyarm/Kconfig"

endif
```

## maxlinear/feed_uboot/open_uboot/config/arch/arm/mach-octeontx/Kconfig
```kconfig
if UBOOT_CONFIG_ARCH_OCTEONTX

choice
	prompt "OcteonTX board select"
	optional

config UBOOT_CONFIG_TARGET_OCTEONTX_81XX
	bool "Marvell OcteonTX CN81XX"

config UBOOT_CONFIG_TARGET_OCTEONTX_83XX
	bool "Marvell OcteonTX CN83XX"

endchoice

config UBOOT_CONFIG_SYS_SOC
	string
	default "octeontx"

config UBOOT_CONFIG_SYS_PCI_64BIT
	bool
	default y

endif
```

## maxlinear/feed_uboot/open_uboot/config/arch/arm/mach-octeontx2/Kconfig
```kconfig
if UBOOT_CONFIG_ARCH_OCTEONTX2

choice
	prompt "OcteonTX2 board select"
	optional

config UBOOT_CONFIG_TARGET_OCTEONTX2_95XX
	bool "Marvell OcteonTX2 CN95XX"

config UBOOT_CONFIG_TARGET_OCTEONTX2_96XX
	bool "Marvell OcteonTX2 CN96XX"

endchoice

config UBOOT_CONFIG_SYS_SOC
	string
	default "octeontx2"

config UBOOT_CONFIG_SYS_PCI_64BIT
	bool
	default y

endif
```

## maxlinear/feed_uboot/open_uboot/config/arch/arm/mach-omap2/omap3/Kconfig
```kconfig
if UBOOT_CONFIG_OMAP34XX

# We only enable the clocks for the GPIO banks that a given board requies.
config UBOOT_CONFIG_OMAP3_GPIO_2
	bool
	default y if UBOOT_CONFIG_CMD_GPIO

config UBOOT_CONFIG_OMAP3_GPIO_3
	bool
	default y if UBOOT_CONFIG_CMD_GPIO

config UBOOT_CONFIG_OMAP3_GPIO_4
	bool
	default y if UBOOT_CONFIG_CMD_GPIO

config UBOOT_CONFIG_OMAP3_GPIO_5
	bool
	default y if UBOOT_CONFIG_CMD_GPIO

config UBOOT_CONFIG_OMAP3_GPIO_6
	bool
	default y if UBOOT_CONFIG_CMD_GPIO

choice
	prompt "OMAP3 board select"
	optional

config UBOOT_CONFIG_TARGET_AM3517_EVM
	bool "AM3517 EVM"
	select UBOOT_CONFIG_DM
	select UBOOT_CONFIG_DM_GPIO
	select UBOOT_CONFIG_DM_I2C
	select UBOOT_CONFIG_DM_MMC
	select UBOOT_CONFIG_DM_SERIAL
	imply CMD_DM

config UBOOT_CONFIG_TARGET_OMAP3_BEAGLE
	bool "TI OMAP3 BeagleBoard"
	select UBOOT_CONFIG_DM
	select UBOOT_CONFIG_DM_GPIO
	select UBOOT_CONFIG_DM_SERIAL
	select UBOOT_CONFIG_OMAP3_GPIO_5
	select UBOOT_CONFIG_OMAP3_GPIO_6
	imply CMD_DM

config UBOOT_CONFIG_TARGET_CM_T35
	bool "CompuLab CM-T3530 and CM-T3730 boards"
	select UBOOT_CONFIG_OMAP3_GPIO_2
	select UBOOT_CONFIG_OMAP3_GPIO_5
	select UBOOT_CONFIG_OMAP3_GPIO_6 if LED_STATUS

config UBOOT_CONFIG_TARGET_DEVKIT8000
	bool "TimLL OMAP3 Devkit8000"
	select UBOOT_CONFIG_DM
	select UBOOT_CONFIG_DM_GPIO
	select UBOOT_CONFIG_DM_SERIAL
	imply CMD_DM

config UBOOT_CONFIG_TARGET_OMAP3_EVM
	bool "TI OMAP3 EVM"
	select UBOOT_CONFIG_DM
	select UBOOT_CONFIG_DM_GPIO
	select UBOOT_CONFIG_DM_SERIAL
	select UBOOT_CONFIG_OMAP3_GPIO_2
	select UBOOT_CONFIG_OMAP3_GPIO_3
	select UBOOT_CONFIG_OMAP3_GPIO_5
	select UBOOT_CONFIG_OMAP3_GPIO_6
	imply CMD_DM

config UBOOT_CONFIG_TARGET_OMAP3_IGEP00X0
	bool "IGEP"
	select UBOOT_CONFIG_DM
	select UBOOT_CONFIG_DM_GPIO
	select UBOOT_CONFIG_DM_SERIAL
	select UBOOT_CONFIG_OMAP3_GPIO_3
	select UBOOT_CONFIG_OMAP3_GPIO_5
	select UBOOT_CONFIG_OMAP3_GPIO_6
	imply CMD_DM

config UBOOT_CONFIG_TARGET_OMAP3_OVERO
	bool "OMAP35xx Gumstix Overo"
	select UBOOT_CONFIG_DM
	select UBOOT_CONFIG_DM_GPIO
	select UBOOT_CONFIG_DM_SERIAL
	select UBOOT_CONFIG_OMAP3_GPIO_2
	select UBOOT_CONFIG_OMAP3_GPIO_3
	select UBOOT_CONFIG_OMAP3_GPIO_4
	select UBOOT_CONFIG_OMAP3_GPIO_5
	select UBOOT_CONFIG_OMAP3_GPIO_6
	imply CMD_DM

config UBOOT_CONFIG_TARGET_OMAP3_PANDORA
	bool "OMAP3 Pandora"
	select UBOOT_CONFIG_OMAP3_GPIO_4
	select UBOOT_CONFIG_OMAP3_GPIO_6

config UBOOT_CONFIG_TARGET_OMAP3_LOGIC
	bool "OMAP3 Logic"
	select UBOOT_CONFIG_BOARD_LATE_INIT
	select UBOOT_CONFIG_DM
	select UBOOT_CONFIG_DM_GPIO
	select UBOOT_CONFIG_DM_SERIAL
	select UBOOT_CONFIG_OMAP3_GPIO_3
	select UBOOT_CONFIG_OMAP3_GPIO_4
	select UBOOT_CONFIG_OMAP3_GPIO_6
	imply CMD_DM

config UBOOT_CONFIG_TARGET_NOKIA_RX51
	bool "Nokia RX51"

config UBOOT_CONFIG_TARGET_TAO3530
	bool "TAO3530"
	select UBOOT_CONFIG_OMAP3_GPIO_2
	select UBOOT_CONFIG_OMAP3_GPIO_3
	select UBOOT_CONFIG_OMAP3_GPIO_4
	select UBOOT_CONFIG_OMAP3_GPIO_5
	select UBOOT_CONFIG_OMAP3_GPIO_6

config UBOOT_CONFIG_TARGET_SNIPER
	bool "LG Optimus Black"
	select UBOOT_CONFIG_DM
	select UBOOT_CONFIG_DM_GPIO
	select UBOOT_CONFIG_DM_SERIAL
	select UBOOT_CONFIG_OMAP3_GPIO_2
	select UBOOT_CONFIG_OMAP3_GPIO_3
	select UBOOT_CONFIG_OMAP3_GPIO_4
	select UBOOT_CONFIG_OMAP3_GPIO_5
	select UBOOT_CONFIG_OMAP3_GPIO_6
	imply CMD_DM

endchoice

choice
	prompt "Memory Controller"
	default UBOOT_CONFIG_SDRC

config UBOOT_CONFIG_SDRC
	bool "SDRC controller"
	help
	  The default memory controller on most OMAP3 boards is SDRC.

config UBOOT_CONFIG_EMIF4
	bool "EMIF4 controller"
	help
	  Enable this on boards like AM3517 which use EMIF4 controller
endchoice

config UBOOT_CONFIG_SPL_OMAP3_ID_NAND
	bool "Support OMAP3-specific ID and MFR function"
	help
	  Support for an OMAP3-specific set of functions to return the
	  ID and MFR of the first attached NAND chip, if present.

config UBOOT_CONFIG_SYS_SOC
	default "omap3"

source "../../../../board/logicpd/am3517evm/Kconfig"
source "../../../../board/ti/beagle/Kconfig"
source "../../../../board/timll/devkit8000/Kconfig"
source "../../../../board/ti/evm/Kconfig"
source "../../../../board/isee/igep00x0/Kconfig"
source "../../../../board/logicpd/omap3som/Kconfig"
source "../../../../board/nokia/rx51/Kconfig"
source "../../../../board/lg/sniper/Kconfig"

endif
```

## maxlinear/feed_uboot/open_uboot/config/arch/arm/mach-owl/Kconfig
```kconfig
if UBOOT_CONFIG_ARCH_OWL

choice
        prompt "Actions Semi Owl SoC Variant"
        optional

config UBOOT_CONFIG_MACH_S900
        bool "Actions Semi S900 SoC"
        select UBOOT_CONFIG_ARM64

config UBOOT_CONFIG_MACH_S700
        bool "Actions Semi S700 SoC"
        select UBOOT_CONFIG_ARM64

endchoice

config UBOOT_CONFIG_SYS_TEXT_BASE
        default 0x11000000

config UBOOT_CONFIG_SYS_CONFIG_NAME
        default "owl-common"

config UBOOT_CONFIG_SYS_SOC
        default "s900" if UBOOT_CONFIG_MACH_S900
        default "s700" if UBOOT_CONFIG_MACH_S700

endif
```
