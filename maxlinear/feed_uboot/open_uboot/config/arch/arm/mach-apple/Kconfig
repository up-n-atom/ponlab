## maxlinear/feed_uboot/open_uboot/config/arch/arm/mach-rockchip/rk3328/Kconfig
```kconfig
if UBOOT_CONFIG_ROCKCHIP_RK3328

choice
	prompt "RK3328 board select"

config UBOOT_CONFIG_TARGET_EVB_RK3328
	bool "RK3328 evaluation board"
	help
	  RK3328evb is a evaluation board for Rockchip rk3328,
	  with full function and phisical connectors support like
	  usb2.0 host ports, LVDS, JTAG, MAC, SDcard, HDMI, USB-2-serial...

endchoice

config UBOOT_CONFIG_ROCKCHIP_BOOT_MODE_REG
	default 0xff1005c8

config UBOOT_CONFIG_SYS_SOC
	default "rk3328"

config UBOOT_CONFIG_SYS_MALLOC_F_LEN
	default 0x2000

config UBOOT_CONFIG_SPL_LIBCOMMON_SUPPORT
	default y

config UBOOT_CONFIG_SPL_LIBGENERIC_SUPPORT
	default y

config UBOOT_CONFIG_TPL_LDSCRIPT
	default "arch/arm/mach-rockchip/u-boot-tpl-v8.lds"

config UBOOT_CONFIG_TPL_TEXT_BASE
	default 0xff091000

config UBOOT_CONFIG_TPL_MAX_SIZE
	default 28672

config UBOOT_CONFIG_TPL_STACK
	default 0xff098000

source "../../../../board/rockchip/evb_rk3328/Kconfig"

endif
```

## maxlinear/feed_uboot/open_uboot/config/arch/arm/mach-rockchip/rk3568/Kconfig
```kconfig
if UBOOT_CONFIG_ROCKCHIP_RK3568

config UBOOT_CONFIG_TARGET_EVB_RK3568
	bool "RK3568 evaluation board"
	select UBOOT_CONFIG_BOARD_LATE_INIT
	help
	  RK3568 EVB is a evaluation board for Rockchp RK3568.

config UBOOT_CONFIG_ROCKCHIP_BOOT_MODE_REG
	default 0xfdc20200

config UBOOT_CONFIG_SYS_SOC
	default "rk3568"

config UBOOT_CONFIG_SYS_MALLOC_F_LEN
	default 0x2000

source "../../../../board/rockchip/evb_rk3568/Kconfig"

endif
```

## maxlinear/feed_uboot/open_uboot/config/arch/arm/mach-s5pc1xx/Kconfig
```kconfig
if UBOOT_CONFIG_ARCH_S5PC1XX

choice
	prompt "S5PC1XX board select"
	optional

config UBOOT_CONFIG_TARGET_S5P_GONI
	bool "S5P Goni board"
	select UBOOT_CONFIG_OF_CONTROL
	select UBOOT_CONFIG_BLK
	select UBOOT_CONFIG_DM_MMC

config UBOOT_CONFIG_TARGET_SMDKC100
	bool "Support smdkc100 board"
	select UBOOT_CONFIG_OF_CONTROL

endchoice

config UBOOT_CONFIG_SYS_SOC
	default "s5pc1xx"

source "../../../board/samsung/goni/Kconfig"
source "../../../board/samsung/smdkc100/Kconfig"

endif
```

## maxlinear/feed_uboot/open_uboot/config/arch/arm/mach-snapdragon/Kconfig
```kconfig
if UBOOT_CONFIG_ARCH_SNAPDRAGON

config UBOOT_CONFIG_SYS_SOC
	default "snapdragon"

config UBOOT_CONFIG_SYS_MALLOC_F_LEN
	default 0x2000

config UBOOT_CONFIG_SPL_SYS_MALLOC_F_LEN
	default 0x2000

config UBOOT_CONFIG_SDM845
	bool "Qualcomm Snapdragon 845 SoC"
	default n
	select UBOOT_CONFIG_LINUX_KERNEL_IMAGE_HEADER

config UBOOT_CONFIG_LNX_KRNL_IMG_TEXT_OFFSET_BASE
	default 0x80000000

choice
	prompt "Snapdragon board select"

config UBOOT_CONFIG_TARGET_DRAGONBOARD410C
	bool "96Boards Dragonboard 410C"
	select UBOOT_CONFIG_BOARD_LATE_INIT
	select UBOOT_CONFIG_ENABLE_ARM_SOC_BOOT0_HOOK
	help
	  Support for 96Boards Dragonboard 410C. This board complies with
	  96Board Open Platform Specifications. Features:
	  - Qualcomm Snapdragon 410C SoC - APQ8016 (4xCortex A53, Adreno 306)
	  - 1GiB RAM
	  - 8GiB eMMC, uSD slot
	  - WiFi, Bluetooth and GPS module
	  - 2x Host, 1x Device USB port
	  - HDMI
	  - 20-pin low speed and 40-pin high speed expanders, 4 LED, 3 buttons

config UBOOT_CONFIG_TARGET_DRAGONBOARD820C
	bool "96Boards Dragonboard 820C"
	help
	  Support for 96Boards Dragonboard 820C. This board complies with
	  96Board Open Platform Specifications. Features:
	  - Qualcomm Snapdragon 820C SoC - APQ8096 (4xKyro CPU)
	  - 3GiB RAM
	  - 32GiB UFS drive

config UBOOT_CONFIG_TARGET_STARQLTECHN
	bool "Samsung S9 SM-G9600(starqltechn)"
	help
	  Support for Samsung S9 SM-G9600(starqltechn) board.
	  Features:
	  - Qualcomm Snapdragon SDM845 SoC
	  - 4GiB RAM
	  - 64GiB UFS drive
	select UBOOT_CONFIG_MISC_INIT_R
	select UBOOT_CONFIG_SDM845
	select UBOOT_CONFIG_DM_ETH if NET

endchoice

source "../../../board/qualcomm/dragonboard410c/Kconfig"
source "../../../board/qualcomm/dragonboard820c/Kconfig"
source "../../../board/samsung/starqltechn/Kconfig"

endif
```

## maxlinear/feed_uboot/open_uboot/config/arch/arm/mach-socfpga/Kconfig
```kconfig
if UBOOT_CONFIG_ARCH_SOCFPGA

config UBOOT_CONFIG_ERR_PTR_OFFSET
	default 0xfffec000 if UBOOT_CONFIG_TARGET_SOCFPGA_GEN5 # Boot ROM range

config UBOOT_CONFIG_NR_DRAM_BANKS
	default 1

config UBOOT_CONFIG_SOCFPGA_SECURE_VAB_AUTH
	bool "Enable boot image authentication with Secure Device Manager"
	depends on UBOOT_CONFIG_TARGET_SOCFPGA_AGILEX || UBOOT_CONFIG_TARGET_SOCFPGA_N5X
	select UBOOT_CONFIG_FIT_IMAGE_POST_PROCESS
	select UBOOT_CONFIG_SHA384
	select UBOOT_CONFIG_SHA512
	select UBOOT_CONFIG_SPL_FIT_IMAGE_POST_PROCESS
	help
	 All images loaded from FIT will be authenticated by Secure Device
	 Manager.

config UBOOT_CONFIG_SOCFPGA_SECURE_VAB_AUTH_ALLOW_NON_FIT_IMAGE
	bool "Allow non-FIT VAB signed images"
	depends on UBOOT_CONFIG_SOCFPGA_SECURE_VAB_AUTH

config UBOOT_CONFIG_SPL_SIZE_LIMIT
	default 0x10000 if UBOOT_CONFIG_TARGET_SOCFPGA_GEN5

config UBOOT_CONFIG_SPL_SIZE_LIMIT_PROVIDE_STACK
	default 0x200 if UBOOT_CONFIG_TARGET_SOCFPGA_GEN5

config UBOOT_CONFIG_SPL_STACK_R_ADDR
	default 0x00800000 if UBOOT_CONFIG_TARGET_SOCFPGA_GEN5

config UBOOT_CONFIG_SPL_SYS_MALLOC_F_LEN
	default 0x800 if UBOOT_CONFIG_TARGET_SOCFPGA_GEN5

config UBOOT_CONFIG_SYS_MMCSD_RAW_MODE_U_BOOT_PARTITION_TYPE
	default 0xa2

config UBOOT_CONFIG_SYS_MALLOC_F_LEN
	default 0x2000 if UBOOT_CONFIG_TARGET_SOCFPGA_ARRIA10
	default 0x2000 if UBOOT_CONFIG_TARGET_SOCFPGA_GEN5

config UBOOT_CONFIG_SYS_TEXT_BASE
	default 0x01000040 if UBOOT_CONFIG_TARGET_SOCFPGA_ARRIA10
	default 0x01000040 if UBOOT_CONFIG_TARGET_SOCFPGA_GEN5

config UBOOT_CONFIG_TARGET_SOCFPGA_AGILEX
	bool
	select UBOOT_CONFIG_ARMV8_MULTIENTRY
	select UBOOT_CONFIG_ARMV8_SET_SMPEN
	select UBOOT_CONFIG_BINMAN if SPL_ATF
	select UBOOT_CONFIG_CLK
	select UBOOT_CONFIG_FPGA_INTEL_SDM_MAILBOX
	select UBOOT_CONFIG_NCORE_CACHE
	select UBOOT_CONFIG_SPL_CLK if SPL
	select UBOOT_CONFIG_TARGET_SOCFPGA_SOC64

config UBOOT_CONFIG_TARGET_SOCFPGA_ARRIA5
	bool
	select UBOOT_CONFIG_TARGET_SOCFPGA_GEN5

config UBOOT_CONFIG_TARGET_SOCFPGA_ARRIA10
	bool
	select UBOOT_CONFIG_SPL_ALTERA_SDRAM
	select UBOOT_CONFIG_SPL_BOARD_INIT if SPL
	select UBOOT_CONFIG_SPL_CACHE if SPL
	select UBOOT_CONFIG_CLK
	select UBOOT_CONFIG_SPL_CLK if SPL
	select UBOOT_CONFIG_DM_I2C
	select UBOOT_CONFIG_DM_RESET
	select UBOOT_CONFIG_SPL_DM_RESET if SPL
	select UBOOT_CONFIG_REGMAP
	select UBOOT_CONFIG_SPL_REGMAP if SPL
	select UBOOT_CONFIG_SYSCON
	select UBOOT_CONFIG_SPL_SYSCON if SPL
	select UBOOT_CONFIG_ETH_DESIGNWARE_SOCFPGA
	imply FPGA_SOCFPGA
	imply SPL_USE_TINY_PRINTF

config UBOOT_CONFIG_TARGET_SOCFPGA_CYCLONE5
	bool
	select UBOOT_CONFIG_TARGET_SOCFPGA_GEN5

config UBOOT_CONFIG_TARGET_SOCFPGA_GEN5
	bool
	select UBOOT_CONFIG_SPL_ALTERA_SDRAM
	imply FPGA_SOCFPGA
	imply SPL_SIZE_LIMIT_SUBTRACT_GD
	imply SPL_SIZE_LIMIT_SUBTRACT_MALLOC
	imply SPL_STACK_R
	imply SPL_SYS_MALLOC_SIMPLE
	imply SPL_USE_TINY_PRINTF

config UBOOT_CONFIG_TARGET_SOCFPGA_N5X
	bool
	select UBOOT_CONFIG_ARMV8_MULTIENTRY
	select UBOOT_CONFIG_ARMV8_SET_SMPEN
	select UBOOT_CONFIG_BINMAN if SPL_ATF
	select UBOOT_CONFIG_CLK
	select UBOOT_CONFIG_FPGA_INTEL_SDM_MAILBOX
	select UBOOT_CONFIG_NCORE_CACHE
	select UBOOT_CONFIG_SPL_ALTERA_SDRAM
	select UBOOT_CONFIG_SPL_CLK if SPL
	select UBOOT_CONFIG_TARGET_SOCFPGA_SOC64

config UBOOT_CONFIG_TARGET_SOCFPGA_N5X_SOCDK
	bool "Intel eASIC SoCDK (N5X)"
	select UBOOT_CONFIG_TARGET_SOCFPGA_N5X

config UBOOT_CONFIG_TARGET_SOCFPGA_SOC64
	bool

config UBOOT_CONFIG_TARGET_SOCFPGA_STRATIX10
	bool
	select UBOOT_CONFIG_ARMV8_MULTIENTRY
	select UBOOT_CONFIG_ARMV8_SET_SMPEN
	select UBOOT_CONFIG_BINMAN if SPL_ATF
	select UBOOT_CONFIG_FPGA_INTEL_SDM_MAILBOX
	select UBOOT_CONFIG_TARGET_SOCFPGA_SOC64

choice
	prompt "Altera SOCFPGA board select"
	optional

config UBOOT_CONFIG_TARGET_SOCFPGA_AGILEX_SOCDK
	bool "Intel SOCFPGA SoCDK (Agilex)"
	select UBOOT_CONFIG_TARGET_SOCFPGA_AGILEX

config UBOOT_CONFIG_TARGET_SOCFPGA_ARIES_MCVEVK
	bool "Aries MCVEVK (Cyclone V)"
	select UBOOT_CONFIG_TARGET_SOCFPGA_CYCLONE5

config UBOOT_CONFIG_TARGET_SOCFPGA_ARRIA10_SOCDK
	bool "Altera SOCFPGA SoCDK (Arria 10)"
	select UBOOT_CONFIG_TARGET_SOCFPGA_ARRIA10

config UBOOT_CONFIG_TARGET_SOCFPGA_ARRIA5_SECU1
	bool "ABB SECU1 (Arria V)"
	select UBOOT_CONFIG_TARGET_SOCFPGA_ARRIA5
	select UBOOT_CONFIG_VENDOR_KM

config UBOOT_CONFIG_TARGET_SOCFPGA_ARRIA5_SOCDK
	bool "Altera SOCFPGA SoCDK (Arria V)"
	select UBOOT_CONFIG_TARGET_SOCFPGA_ARRIA5

config UBOOT_CONFIG_TARGET_SOCFPGA_CYCLONE5_SOCDK
	bool "Altera SOCFPGA SoCDK (Cyclone V)"
	select UBOOT_CONFIG_TARGET_SOCFPGA_CYCLONE5

config UBOOT_CONFIG_TARGET_SOCFPGA_DEVBOARDS_DBM_SOC1
	bool "Devboards DBM-SoC1 (Cyclone V)"
	select UBOOT_CONFIG_TARGET_SOCFPGA_CYCLONE5

config UBOOT_CONFIG_TARGET_SOCFPGA_EBV_SOCRATES
	bool "EBV SoCrates (Cyclone V)"
	select UBOOT_CONFIG_TARGET_SOCFPGA_CYCLONE5

config UBOOT_CONFIG_TARGET_SOCFPGA_IS1
	bool "IS1 (Cyclone V)"
	select UBOOT_CONFIG_TARGET_SOCFPGA_CYCLONE5

config UBOOT_CONFIG_TARGET_SOCFPGA_SOFTING_VINING_FPGA
	bool "Softing VIN|ING FPGA (Cyclone V)"
	select UBOOT_CONFIG_BOARD_LATE_INIT
	select UBOOT_CONFIG_TARGET_SOCFPGA_CYCLONE5

config UBOOT_CONFIG_TARGET_SOCFPGA_SR1500
	bool "SR1500 (Cyclone V)"
	select UBOOT_CONFIG_TARGET_SOCFPGA_CYCLONE5

config UBOOT_CONFIG_TARGET_SOCFPGA_STRATIX10_SOCDK
	bool "Intel SOCFPGA SoCDK (Stratix 10)"
	select UBOOT_CONFIG_TARGET_SOCFPGA_STRATIX10

config UBOOT_CONFIG_TARGET_SOCFPGA_TERASIC_DE0_NANO
	bool "Terasic DE0-Nano-Atlas (Cyclone V)"
	select UBOOT_CONFIG_TARGET_SOCFPGA_CYCLONE5

config UBOOT_CONFIG_TARGET_SOCFPGA_TERASIC_DE10_NANO
	bool "Terasic DE10-Nano (Cyclone V)"
	select UBOOT_CONFIG_TARGET_SOCFPGA_CYCLONE5

config UBOOT_CONFIG_TARGET_SOCFPGA_TERASIC_DE1_SOC
	bool "Terasic DE1-SoC (Cyclone V)"
	select UBOOT_CONFIG_TARGET_SOCFPGA_CYCLONE5

config UBOOT_CONFIG_TARGET_SOCFPGA_TERASIC_SOCKIT
	bool "Terasic SoCkit (Cyclone V)"
	select UBOOT_CONFIG_TARGET_SOCFPGA_CYCLONE5

endchoice

config UBOOT_CONFIG_SYS_BOARD
	default "agilex-socdk" if UBOOT_CONFIG_TARGET_SOCFPGA_AGILEX_SOCDK
	default "arria5-socdk" if UBOOT_CONFIG_TARGET_SOCFPGA_ARRIA5_SOCDK
	default "arria10-socdk" if UBOOT_CONFIG_TARGET_SOCFPGA_ARRIA10_SOCDK
	default "cyclone5-socdk" if UBOOT_CONFIG_TARGET_SOCFPGA_CYCLONE5_SOCDK
	default "dbm-soc1" if UBOOT_CONFIG_TARGET_SOCFPGA_DEVBOARDS_DBM_SOC1
	default "de0-nano-soc" if UBOOT_CONFIG_TARGET_SOCFPGA_TERASIC_DE0_NANO
	default "de1-soc" if UBOOT_CONFIG_TARGET_SOCFPGA_TERASIC_DE1_SOC
	default "de10-nano" if UBOOT_CONFIG_TARGET_SOCFPGA_TERASIC_DE10_NANO
	default "is1" if UBOOT_CONFIG_TARGET_SOCFPGA_IS1
	default "mcvevk" if UBOOT_CONFIG_TARGET_SOCFPGA_ARIES_MCVEVK
	default "n5x-socdk" if UBOOT_CONFIG_TARGET_SOCFPGA_N5X_SOCDK
	default "secu1" if UBOOT_CONFIG_TARGET_SOCFPGA_ARRIA5_SECU1
	default "sockit" if UBOOT_CONFIG_TARGET_SOCFPGA_TERASIC_SOCKIT
	default "socrates" if UBOOT_CONFIG_TARGET_SOCFPGA_EBV_SOCRATES
	default "sr1500" if UBOOT_CONFIG_TARGET_SOCFPGA_SR1500
	default "stratix10-socdk" if UBOOT_CONFIG_TARGET_SOCFPGA_STRATIX10_SOCDK
	default "vining_fpga" if UBOOT_CONFIG_TARGET_SOCFPGA_SOFTING_VINING_FPGA

config UBOOT_CONFIG_SYS_VENDOR
	default "intel" if UBOOT_CONFIG_TARGET_SOCFPGA_AGILEX_SOCDK
	default "intel" if UBOOT_CONFIG_TARGET_SOCFPGA_N5X_SOCDK
	default "altera" if UBOOT_CONFIG_TARGET_SOCFPGA_ARRIA5_SOCDK
	default "altera" if UBOOT_CONFIG_TARGET_SOCFPGA_ARRIA10_SOCDK
	default "altera" if UBOOT_CONFIG_TARGET_SOCFPGA_CYCLONE5_SOCDK
	default "altera" if UBOOT_CONFIG_TARGET_SOCFPGA_STRATIX10_SOCDK
	default "aries" if UBOOT_CONFIG_TARGET_SOCFPGA_ARIES_MCVEVK
	default "devboards" if UBOOT_CONFIG_TARGET_SOCFPGA_DEVBOARDS_DBM_SOC1
	default "ebv" if UBOOT_CONFIG_TARGET_SOCFPGA_EBV_SOCRATES
	default "keymile" if UBOOT_CONFIG_TARGET_SOCFPGA_ARRIA5_SECU1
	default "softing" if UBOOT_CONFIG_TARGET_SOCFPGA_SOFTING_VINING_FPGA
	default "terasic" if UBOOT_CONFIG_TARGET_SOCFPGA_TERASIC_DE0_NANO
	default "terasic" if UBOOT_CONFIG_TARGET_SOCFPGA_TERASIC_DE1_SOC
	default "terasic" if UBOOT_CONFIG_TARGET_SOCFPGA_TERASIC_DE10_NANO
	default "terasic" if UBOOT_CONFIG_TARGET_SOCFPGA_TERASIC_SOCKIT

config UBOOT_CONFIG_SYS_SOC
	default "socfpga"

config UBOOT_CONFIG_SYS_CONFIG_NAME
	default "socfpga_agilex_socdk" if UBOOT_CONFIG_TARGET_SOCFPGA_AGILEX_SOCDK
	default "socfpga_arria5_secu1" if UBOOT_CONFIG_TARGET_SOCFPGA_ARRIA5_SECU1
	default "socfpga_arria5_socdk" if UBOOT_CONFIG_TARGET_SOCFPGA_ARRIA5_SOCDK
	default "socfpga_arria10_socdk" if UBOOT_CONFIG_TARGET_SOCFPGA_ARRIA10_SOCDK
	default "socfpga_cyclone5_socdk" if UBOOT_CONFIG_TARGET_SOCFPGA_CYCLONE5_SOCDK
	default "socfpga_dbm_soc1" if UBOOT_CONFIG_TARGET_SOCFPGA_DEVBOARDS_DBM_SOC1
	default "socfpga_de0_nano_soc" if UBOOT_CONFIG_TARGET_SOCFPGA_TERASIC_DE0_NANO
	default "socfpga_de1_soc" if UBOOT_CONFIG_TARGET_SOCFPGA_TERASIC_DE1_SOC
	default "socfpga_de10_nano" if UBOOT_CONFIG_TARGET_SOCFPGA_TERASIC_DE10_NANO
	default "socfpga_is1" if UBOOT_CONFIG_TARGET_SOCFPGA_IS1
	default "socfpga_mcvevk" if UBOOT_CONFIG_TARGET_SOCFPGA_ARIES_MCVEVK
	default "socfpga_n5x_socdk" if UBOOT_CONFIG_TARGET_SOCFPGA_N5X_SOCDK
	default "socfpga_sockit" if UBOOT_CONFIG_TARGET_SOCFPGA_TERASIC_SOCKIT
	default "socfpga_socrates" if UBOOT_CONFIG_TARGET_SOCFPGA_EBV_SOCRATES
	default "socfpga_sr1500" if UBOOT_CONFIG_TARGET_SOCFPGA_SR1500
	default "socfpga_stratix10_socdk" if UBOOT_CONFIG_TARGET_SOCFPGA_STRATIX10_SOCDK
	default "socfpga_vining_fpga" if UBOOT_CONFIG_TARGET_SOCFPGA_SOFTING_VINING_FPGA

source "../../../board/keymile/Kconfig"

endif
```
