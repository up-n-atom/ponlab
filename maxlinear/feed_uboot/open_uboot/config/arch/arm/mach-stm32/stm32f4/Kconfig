## maxlinear/feed_uboot/open_uboot/config/arch/mips/mach-mscc/Kconfig
```kconfig
# SPDX-License-Identifier: (GPL-2.0+ OR MIT)

menu "MSCC VCore-III platforms"
	depends on UBOOT_CONFIG_ARCH_MSCC

config UBOOT_CONFIG_SOC_VCOREIII
	select UBOOT_CONFIG_MIPS_TUNE_24KC
	select UBOOT_CONFIG_ROM_EXCEPTION_VECTORS
	select UBOOT_CONFIG_SUPPORTS_BIG_ENDIAN
	select UBOOT_CONFIG_SUPPORTS_CPU_MIPS32_R1
	select UBOOT_CONFIG_SUPPORTS_CPU_MIPS32_R2
	select UBOOT_CONFIG_SUPPORTS_LITTLE_ENDIAN
	bool

config UBOOT_CONFIG_SYS_SOC
	default "mscc"

choice

	prompt "SOC Family Variant"

config UBOOT_CONFIG_SOC_OCELOT
	bool "Ocelot SOC Family"
	select UBOOT_CONFIG_SOC_VCOREIII
	select UBOOT_CONFIG_DESIGNWARE_SPI
	help
	  This supports MSCC Ocelot family of SOCs.

config UBOOT_CONFIG_SOC_LUTON
	bool "Luton SOC Family"
	select UBOOT_CONFIG_SOC_VCOREIII
	help
	  This supports MSCC Luton family of SOCs.

config UBOOT_CONFIG_SOC_JR2
	bool "Jaguar2 SOC Family"
	select UBOOT_CONFIG_SOC_VCOREIII
	select UBOOT_CONFIG_DESIGNWARE_SPI
	help
	  This supports MSCC Jaguar2 family of SOCs.

config UBOOT_CONFIG_SOC_SERVALT
	bool "Servalt SOC Family"
	select UBOOT_CONFIG_SOC_VCOREIII
	select UBOOT_CONFIG_MSCC_BB_SPI
	help
	  This supports MSCC Servalt family of SOCs.

config UBOOT_CONFIG_SOC_SERVAL
	bool "Serval SOC Family"
	select UBOOT_CONFIG_SOC_VCOREIII
	select UBOOT_CONFIG_MSCC_BB_SPI
	help
	  This supports MSCC Serval family of SOCs.

endchoice

config UBOOT_CONFIG_SYS_CONFIG_NAME
	default "vcoreiii"

choice
	prompt "DDR type"

config UBOOT_CONFIG_DDRTYPE_H5TQ4G63MFR
	bool "Hynix H5TQ4G63MFR-PBC (4Gbit, DDR3-800, 256Mbitx16)"

config UBOOT_CONFIG_DDRTYPE_MT41K256M16
	bool "Micron MT41K256M16 (4Gbit, DDR3L-800, 256Mbitx16)"

config UBOOT_CONFIG_DDRTYPE_H5TQ1G63BFA
	bool "Hynix H5TQ1G63BFA (1Gbit DDR3, x16)"

config UBOOT_CONFIG_DDRTYPE_MT41J128M16HA
	bool "Micron MT41J128M16HA-15E:D (2Gbit DDR3, x16)"

config UBOOT_CONFIG_DDRTYPE_MT41K128M16JT
	bool "Micron MT41K128M16JT-125 (2Gbit DDR3L, 128Mbitx16)"

config UBOOT_CONFIG_DDRTYPE_MT47H128M8HQ
	bool "Micron MT47H128M8-3 (1Gbit, DDR-533@CL4 @ 4.80ns 16Mbisx8x8)"

endchoice

source "../../../board/mscc/ocelot/Kconfig"

source "../../../board/mscc/luton/Kconfig"

source "../../../board/mscc/jr2/Kconfig"

source "../../../board/mscc/servalt/Kconfig"

source "../../../board/mscc/serval/Kconfig"
endmenu
```

## maxlinear/feed_uboot/open_uboot/config/arch/mips/mach-mtmips/Kconfig
```kconfig
menu "MediaTek MIPS platforms"
	depends on UBOOT_CONFIG_ARCH_MTMIPS

config UBOOT_CONFIG_SYS_VENDOR
	default "mediatek" if UBOOT_CONFIG_BOARD_MT7628_RFB || UBOOT_CONFIG_BOARD_MT7620_RFB || UBOOT_CONFIG_BOARD_MT7620_MT7530_RFB

config UBOOT_CONFIG_SYS_MALLOC_F_LEN
	default 0x1000

config UBOOT_CONFIG_SYS_SOC
	default "mt7620" if UBOOT_CONFIG_SOC_MT7620
	default "mt7628" if UBOOT_CONFIG_SOC_MT7628

config UBOOT_CONFIG_SYS_DCACHE_SIZE
	default 32768

config UBOOT_CONFIG_SYS_DCACHE_LINE_SIZE
	default 32

config UBOOT_CONFIG_SYS_ICACHE_SIZE
	default 65536

config UBOOT_CONFIG_SYS_ICACHE_LINE_SIZE
	default 32

config UBOOT_CONFIG_SYS_TEXT_BASE
	default 0x9c000000 if ! UBOOT_CONFIG_SPL
	default 0x80200000 if UBOOT_CONFIG_SPL

config UBOOT_CONFIG_SPL_TEXT_BASE
	default 0x9c000000

config UBOOT_CONFIG_SPL_PAYLOAD
	default "u-boot-lzma.img" if UBOOT_CONFIG_SPL_LZMA

config UBOOT_CONFIG_BUILD_TARGET
	default "u-boot-with-spl.bin" if UBOOT_CONFIG_SPL
	default "u-boot.bin"

choice
	prompt "MediaTek MIPS SoC select"

config UBOOT_CONFIG_SOC_MT7620
	bool "MT7620"
	select UBOOT_CONFIG_SYS_CACHE_SHIFT_5
	select UBOOT_CONFIG_SYS_MIPS_CACHE_INIT_RAM_LOAD
	select UBOOT_CONFIG_PINCTRL_MT7620
	select UBOOT_CONFIG_MT7620_SERIAL
	select UBOOT_CONFIG_MISC
	select UBOOT_CONFIG_SPL_SEPARATE_BSS if SPL
	select UBOOT_CONFIG_SPL_LOADER_SUPPORT if SPL
	select UBOOT_CONFIG_SPL_OF_CONTROL if SPL_DM
	select UBOOT_CONFIG_SPL_OF_PLATDATA if SPL_DM
	select UBOOT_CONFIG_SPL_DM_SERIAL if SPL_DM
	help
	  This supports MediaTek MT7620.

config UBOOT_CONFIG_SOC_MT7628
	bool "MT7628"
	select UBOOT_CONFIG_SYS_CACHE_SHIFT_5
	select UBOOT_CONFIG_MIPS_INIT_STACK_IN_SRAM
	select UBOOT_CONFIG_MIPS_SRAM_INIT
	select UBOOT_CONFIG_SYS_MIPS_CACHE_INIT_RAM_LOAD
	select UBOOT_CONFIG_PINCTRL_MT7628
	select UBOOT_CONFIG_MTK_SERIAL
	select UBOOT_CONFIG_SYSRESET
	select UBOOT_CONFIG_SYSRESET_RESETCTL
	select UBOOT_CONFIG_SPL_SEPARATE_BSS if SPL
	select UBOOT_CONFIG_SPL_INIT_STACK_WITHOUT_MALLOC_F if SPL
	select UBOOT_CONFIG_SPL_LOADER_SUPPORT if SPL
	select UBOOT_CONFIG_SPL_OF_CONTROL if SPL_DM
	select UBOOT_CONFIG_SPL_SIMPLE_BUS if SPL_DM
	select UBOOT_CONFIG_SPL_DM_SERIAL if SPL_DM
	select UBOOT_CONFIG_SPL_CLK if SPL_DM && UBOOT_CONFIG_SPL_SERIAL
	select UBOOT_CONFIG_SPL_SYSRESET if SPL_DM
	select UBOOT_CONFIG_SPL_OF_LIBFDT if SPL_OF_CONTROL
	help
	  This supports MediaTek MT7628/MT7688.

endchoice

source "mt7620/Kconfig"
source "mt7628/Kconfig"

endmenu
```

## maxlinear/feed_uboot/open_uboot/config/arch/mips/mach-mtmips/mt7620/Kconfig
```kconfig
if UBOOT_CONFIG_SOC_MT7620

config UBOOT_CONFIG_DEBUG_UART_BOARD_INIT
	default y

choice
	prompt "Board select"

config UBOOT_CONFIG_BOARD_MT7620_RFB
	bool "MediaTek MT7620 RFB"
	help
	  The reference design of MT7620A (WS2120). The board has 64 MiB DDR2,
	  8 MiB SPI-NOR flash, 1 built-in 6 port switch (two GE PHYs and five
	  FE PHYs,one port can be configured to use either FE PHY or GE PHY),
	  1 UART, 1 USB host, 1 SDXC, 1 PCIe socket and JTAG pins.

config UBOOT_CONFIG_BOARD_MT7620_MT7530_RFB
	bool "MediaTek MT7620-MT7530 RFB"
	help
	  The reference design of MT7620DA (MTKC712). The board has 64 MiB
	  intergrated DDR2 KGD, 16 MiB SPI-NOR flash, an external 5-port giga
	  switch MT7530 and 1 UART.

endchoice

choice
	prompt "CPU frequency select"
	default UBOOT_CONFIG_CPU_FREQ_580MHZ

config UBOOT_CONFIG_CPU_FREQ_480MHZ
	bool "480MHz"

config UBOOT_CONFIG_CPU_FREQ_500MHZ
	bool "500MHz"

config UBOOT_CONFIG_CPU_FREQ_520MHZ
	bool "520MHz"

config UBOOT_CONFIG_CPU_FREQ_540MHZ
	bool "540MHz"

config UBOOT_CONFIG_CPU_FREQ_560MHZ
	bool "560MHz"

config UBOOT_CONFIG_CPU_FREQ_580MHZ
	bool "580MHz"

config UBOOT_CONFIG_CPU_FREQ_600MHZ
	bool "600MHz"

config UBOOT_CONFIG_CPU_FREQ_620MHZ
	bool "620MHz"

endchoice

config UBOOT_CONFIG_CPU_FREQ_MULTI
	int
	range 0 7
	default 0 if UBOOT_CONFIG_CPU_FREQ_480MHZ
	default 1 if UBOOT_CONFIG_CPU_FREQ_500MHZ
	default 2 if UBOOT_CONFIG_CPU_FREQ_520MHZ
	default 3 if UBOOT_CONFIG_CPU_FREQ_540MHZ
	default 4 if UBOOT_CONFIG_CPU_FREQ_560MHZ
	default 5 if UBOOT_CONFIG_CPU_FREQ_580MHZ
	default 6 if UBOOT_CONFIG_CPU_FREQ_600MHZ
	default 7 if UBOOT_CONFIG_CPU_FREQ_620MHZ

config UBOOT_CONFIG_SYS_CONFIG_NAME
	string "Board configuration name"
	default "mt7620" if UBOOT_CONFIG_BOARD_MT7620_RFB || UBOOT_CONFIG_BOARD_MT7620_MT7530_RFB

config UBOOT_CONFIG_SYS_BOARD
	string "Board name"
	default "mt7620" if UBOOT_CONFIG_BOARD_MT7620_RFB || UBOOT_CONFIG_BOARD_MT7620_MT7530_RFB

endif
```

## maxlinear/feed_uboot/open_uboot/config/arch/mips/mach-pic32/Kconfig
```kconfig
menu "Microchip PIC32 platforms"
	depends on UBOOT_CONFIG_MACH_PIC32

config UBOOT_CONFIG_SYS_SOC
	default "pic32mzda" if UBOOT_CONFIG_SOC_PIC32MZDA

choice
	prompt "PIC32 SoC select"

config UBOOT_CONFIG_SOC_PIC32MZDA
	bool "Microchip PIC32MZ[DA] family"
	select UBOOT_CONFIG_SYS_CACHE_SHIFT_4
	select UBOOT_CONFIG_ROM_EXCEPTION_VECTORS
	select UBOOT_CONFIG_SUPPORTS_CPU_MIPS32_R1
	select UBOOT_CONFIG_SUPPORTS_CPU_MIPS32_R2
	select UBOOT_CONFIG_SUPPORTS_LITTLE_ENDIAN
	select UBOOT_CONFIG_SYS_MIPS_CACHE_INIT_RAM_LOAD
	help
	  This supports Microchip PIC32MZ[DA] family of microcontrollers.

endchoice

choice
	prompt "Board select"

config UBOOT_CONFIG_TARGET_PIC32MZDASK
	bool "Microchip PIC32MZ[DA] Starter Kit"
	depends on UBOOT_CONFIG_SOC_PIC32MZDA
	help
	  This supports Microchip PIC32MZ[DA] Starter Kit.

endchoice

source "../../../board/microchip/pic32mzda/Kconfig"

endmenu
```

## maxlinear/feed_uboot/open_uboot/config/arch/powerpc/cpu/mpc83xx/Kconfig
```kconfig
menu "mpc83xx CPU"
	depends on UBOOT_CONFIG_MPC83xx

config UBOOT_CONFIG_SYS_CPU
	default "mpc83xx"

choice
	prompt "Target select"
	optional

config UBOOT_CONFIG_TARGET_MPC837XERDB
	bool "Support MPC837XERDB"
	select UBOOT_CONFIG_ARCH_MPC837X
	select UBOOT_CONFIG_BOARD_EARLY_INIT_F

config UBOOT_CONFIG_TARGET_IDS8313
	bool "Support ids8313"
	select UBOOT_CONFIG_ARCH_MPC8313
	select UBOOT_CONFIG_DM
	imply CMD_DM

config UBOOT_CONFIG_TARGET_KMETER1
	bool "Support kmeter1"
	select UBOOT_CONFIG_VENDOR_KM
	select UBOOT_CONFIG_KM_ENABLE_FULL_DM_DTS_SUPPORT

config UBOOT_CONFIG_TARGET_KMCOGE5NE
	bool "Support kmcoge5ne"
	select UBOOT_CONFIG_VENDOR_KM
	select UBOOT_CONFIG_KM_ENABLE_FULL_DM_DTS_SUPPORT

config UBOOT_CONFIG_TARGET_KMTEGR1
	bool "Support kmtegr1"
	select UBOOT_CONFIG_VENDOR_KM
	select UBOOT_CONFIG_KM_ENABLE_FULL_DM_DTS_SUPPORT

config UBOOT_CONFIG_TARGET_TUXX1
	bool "Support tuxx1"
	select UBOOT_CONFIG_VENDOR_KM
	select UBOOT_CONFIG_KM_ENABLE_FULL_DM_DTS_SUPPORT

config UBOOT_CONFIG_TARGET_KMSUPX5
	bool "Support kmsupx5"
	select UBOOT_CONFIG_VENDOR_KM
	select UBOOT_CONFIG_KM_ENABLE_FULL_DM_DTS_SUPPORT

config UBOOT_CONFIG_TARGET_TUGE1
	bool "Support tuge1"
	select UBOOT_CONFIG_VENDOR_KM
	select UBOOT_CONFIG_KM_ENABLE_FULL_DM_DTS_SUPPORT

config UBOOT_CONFIG_TARGET_KMOPTI2
	bool "Support kmopti2"
	select UBOOT_CONFIG_VENDOR_KM
	select UBOOT_CONFIG_KM_ENABLE_FULL_DM_DTS_SUPPORT

config UBOOT_CONFIG_TARGET_KMTEPR2
	bool "Support kmtepr2"
	select UBOOT_CONFIG_VENDOR_KM
	select UBOOT_CONFIG_KM_ENABLE_FULL_DM_DTS_SUPPORT

config UBOOT_CONFIG_TARGET_GAZERBEAM
	bool "Support gazerbeam"
	select UBOOT_CONFIG_ARCH_MPC8308
	select UBOOT_CONFIG_SYS_FSL_ERRATUM_ESDHC111
	imply ENV_IS_IN_FLASH
	help
	  The "Gazerbeam" is a modular system by Guntermann & Drunck GmbH
	  Systementwicklung based on the NXP MPC8308 SoC for usage in KVM
	  appliances.

	  Features include:
	  * Two gigabit ethernet ports
	  * Multiple USB ports (depending on variant)
	  * Several gigabit ethernet or optical fiber ports (depending on
	    variant)
	  * Several display port inputs and outputs, and supporting redrivers
	    (depending on variant)
	  * Several FPGAs with custom logic (depending on variant)

endchoice

config UBOOT_CONFIG_MPC83XX_QUICC_ENGINE
	bool

# TODO: Imply MPC83xx PCI driver
config UBOOT_CONFIG_MPC83XX_PCI_SUPPORT
	bool

# TODO: Imply TSEC driver
config UBOOT_CONFIG_MPC83XX_TSEC1_SUPPORT
	bool

config UBOOT_CONFIG_MPC83XX_TSEC2_SUPPORT
	bool

config UBOOT_CONFIG_MPC83XX_PCIE1_SUPPORT
	bool

config UBOOT_CONFIG_MPC83XX_PCIE2_SUPPORT
	bool

config UBOOT_CONFIG_MPC83XX_SDHC_SUPPORT
	bool

config UBOOT_CONFIG_MPC83XX_SATA
	bool

config UBOOT_CONFIG_MPC83XX_SECOND_I2C
	bool

config UBOOT_CONFIG_MPC83XX_LDP_PIN
	bool

config UBOOT_CONFIG_ARCH_MPC830X
	bool
	select UBOOT_CONFIG_MPC83XX_SDHC_SUPPORT
	select UBOOT_CONFIG_SYS_CACHE_SHIFT_5

config UBOOT_CONFIG_ARCH_MPC8308
	bool
	select UBOOT_CONFIG_ARCH_MPC830X
	select UBOOT_CONFIG_MPC83XX_TSEC1_SUPPORT
	select UBOOT_CONFIG_MPC83XX_TSEC2_SUPPORT
	select UBOOT_CONFIG_MPC83XX_PCIE1_SUPPORT
	select UBOOT_CONFIG_MPC83XX_SECOND_I2C

config UBOOT_CONFIG_ARCH_MPC8309
	bool
	select UBOOT_CONFIG_ARCH_MPC830X
	select UBOOT_CONFIG_MPC83XX_QUICC_ENGINE
	select UBOOT_CONFIG_MPC83XX_PCI_SUPPORT
	select UBOOT_CONFIG_MPC83XX_SECOND_I2C
	select UBOOT_CONFIG_SYS_FSL_ERRATUM_ESDHC111
	select UBOOT_CONFIG_FSL_ELBC

config UBOOT_CONFIG_ARCH_MPC831X
	bool
	select UBOOT_CONFIG_MPC83XX_PCI_SUPPORT
	select UBOOT_CONFIG_MPC83XX_TSEC1_SUPPORT
	select UBOOT_CONFIG_MPC83XX_TSEC2_SUPPORT
	select UBOOT_CONFIG_SYS_CACHE_SHIFT_5

config UBOOT_CONFIG_ARCH_MPC8313
	bool
	select UBOOT_CONFIG_ARCH_MPC831X
	select UBOOT_CONFIG_MPC83XX_SECOND_I2C
	select UBOOT_CONFIG_FSL_ELBC

config UBOOT_CONFIG_ARCH_MPC832X
	bool
	select UBOOT_CONFIG_MPC83XX_QUICC_ENGINE
	select UBOOT_CONFIG_MPC83XX_PCI_SUPPORT
	select UBOOT_CONFIG_SYS_CACHE_SHIFT_5

config UBOOT_CONFIG_ARCH_MPC834X
	bool
	select UBOOT_CONFIG_SYS_CACHE_SHIFT_5

config UBOOT_CONFIG_ARCH_MPC8360
	bool
	select UBOOT_CONFIG_MPC83XX_QUICC_ENGINE
	select UBOOT_CONFIG_MPC83XX_PCI_SUPPORT
	select UBOOT_CONFIG_MPC83XX_LDP_PIN
	select UBOOT_CONFIG_MPC83XX_SECOND_I2C
	select UBOOT_CONFIG_SYS_CACHE_SHIFT_5

config UBOOT_CONFIG_ARCH_MPC837X
	bool
	select UBOOT_CONFIG_MPC83XX_PCI_SUPPORT
	select UBOOT_CONFIG_MPC83XX_TSEC1_SUPPORT
	select UBOOT_CONFIG_MPC83XX_TSEC2_SUPPORT
	select UBOOT_CONFIG_MPC83XX_PCIE1_SUPPORT
	select UBOOT_CONFIG_MPC83XX_PCIE2_SUPPORT
	select UBOOT_CONFIG_MPC83XX_SDHC_SUPPORT
	select UBOOT_CONFIG_MPC83XX_SATA
	select UBOOT_CONFIG_MPC83XX_LDP_PIN
	select UBOOT_CONFIG_MPC83XX_SECOND_I2C
	select UBOOT_CONFIG_SYS_CACHE_SHIFT_5
	select UBOOT_CONFIG_FSL_ELBC

config UBOOT_CONFIG_SYS_IMMR
	hex "Value for IMMR"
	default 0xE0000000
	help
	  Address for the Internal Memory-Mapped Registers (IMMR) window used
	  to configure the features of the SoC.

source "hrcw/Kconfig"
source "bats/Kconfig"
source "lblaw/Kconfig"
source "elbc/Kconfig"
source "hid/Kconfig"
source "sysio/Kconfig"
source "arbiter/Kconfig"
source "initreg/Kconfig"

config UBOOT_CONFIG_FSL_ELBC
	bool

source "../../../../board/freescale/mpc837xerdb/Kconfig"
source "../../../../board/ids/ids8313/Kconfig"
source "../../../../board/keymile/Kconfig"
source "../../../../board/gdsys/mpc8308/Kconfig"

endmenu
```

## maxlinear/feed_uboot/open_uboot/config/arch/powerpc/cpu/mpc83xx/elbc/Kconfig
```kconfig
menu "ELBC register setup"

choice
	prompt "OR/BR for NAND SPL"

config UBOOT_CONFIG_ELBC_BR_OR_NAND_PRELIM_NONE
	bool "None"

config UBOOT_CONFIG_ELBC_BR_OR_NAND_PRELIM_0
	bool "0"

config UBOOT_CONFIG_ELBC_BR_OR_NAND_PRELIM_1
	bool "1"

config UBOOT_CONFIG_ELBC_BR_OR_NAND_PRELIM_2
	bool "2"

config UBOOT_CONFIG_ELBC_BR_OR_NAND_PRELIM_3
	bool "3"

config UBOOT_CONFIG_ELBC_BR_OR_NAND_PRELIM_4
	bool "4"

endchoice

source "Kconfig.elbc0"
source "Kconfig.elbc1"
source "Kconfig.elbc2"
source "Kconfig.elbc3"
source "Kconfig.elbc4"

endmenu
```
