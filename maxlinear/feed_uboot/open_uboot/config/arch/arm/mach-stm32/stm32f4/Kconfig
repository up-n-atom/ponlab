## maxlinear/feed_uboot/open_uboot/config/arch/powerpc/cpu/mpc83xx/initreg/Kconfig
```kconfig
menu "Initial register configuration"

source "Kconfig.spcr"
source "Kconfig.lcrr"

endmenu
```

## maxlinear/feed_uboot/open_uboot/config/arch/powerpc/cpu/mpc83xx/initreg/Kconfig.spcr
```kconfig
menu "SPCR - System priority and configuration register"

choice
	prompt "Optimize"

config UBOOT_CONFIG_SPCR_OPT_UNSET
	bool "Don't set value"

config UBOOT_CONFIG_SPCR_OPT_NONE
	bool "No performance enhancement"

config UBOOT_CONFIG_SPCR_OPT_SPEC_READ
	bool "Performance enhancement by speculative read"

endchoice

if UBOOT_CONFIG_ARCH_MPC8308 || UBOOT_CONFIG_ARCH_MPC831X || UBOOT_CONFIG_ARCH_MPC837X

choice
	prompt "TSEC emergency priority"

config UBOOT_CONFIG_SPCR_TSECEP_UNSET
	bool "Don't set value"

config UBOOT_CONFIG_SPCR_TSECEP_0
	bool "Level 0 (lowest priority)"

config UBOOT_CONFIG_SPCR_TSECEP_1
	bool "Level 1"

config UBOOT_CONFIG_SPCR_TSECEP_2
	bool "Level 2"

config UBOOT_CONFIG_SPCR_TSECEP_3
	bool "Level 3 (highest priority)"

endchoice

endif

config UBOOT_CONFIG_SPCR_OPT
	hex
	default 0x0 if UBOOT_CONFIG_SPCR_OPT_UNSET
	default 0x0 if UBOOT_CONFIG_SPCR_OPT_NONE
	default 0x800000 if UBOOT_CONFIG_SPCR_OPT_SPEC_READ

config UBOOT_CONFIG_SPCR_TSECEP
	hex
	default 0x0 if UBOOT_CONFIG_SPCR_TSECEP_UNSET
	default 0x0 if UBOOT_CONFIG_SPCR_TSECEP_0
	default 0x100 if UBOOT_CONFIG_SPCR_TSECEP_1
	default 0x200 if UBOOT_CONFIG_SPCR_TSECEP_2
	default 0x300 if UBOOT_CONFIG_SPCR_TSECEP_3

config UBOOT_CONFIG_SPCR_TSEC1EP
	hex
	default 0x0 if UBOOT_CONFIG_SPCR_TSEC1EP_UNSET
	default 0x0 if UBOOT_CONFIG_SPCR_TSEC1EP_0
	default 0x100 if UBOOT_CONFIG_SPCR_TSEC1EP_1
	default 0x200 if UBOOT_CONFIG_SPCR_TSEC1EP_2
	default 0x300 if UBOOT_CONFIG_SPCR_TSEC1EP_3

config UBOOT_CONFIG_SPCR_TSEC2EP
	hex
	default 0x0 if UBOOT_CONFIG_SPCR_TSEC2EP_UNSET
	default 0x0 if UBOOT_CONFIG_SPCR_TSEC2EP_0
	default 0x1 if UBOOT_CONFIG_SPCR_TSEC2EP_1
	default 0x2 if UBOOT_CONFIG_SPCR_TSEC2EP_2
	default 0x3 if UBOOT_CONFIG_SPCR_TSEC2EP_3

endmenu
```

## maxlinear/feed_uboot/open_uboot/config/arch/powerpc/cpu/mpc83xx/sysio/Kconfig
```kconfig
menu "System I/O configuration"

if UBOOT_CONFIG_ARCH_MPC8308
source "Kconfig.mpc8308"
endif

endmenu
```

## maxlinear/feed_uboot/open_uboot/config/arch/powerpc/cpu/mpc83xx/sysio/Kconfig.mpc8308
```kconfig
choice
	prompt "SPI group"

config UBOOT_CONFIG_SICR_SPI_SPI
	bool "SPI"

config UBOOT_CONFIG_SICR_SPI_MSRCID
	bool "MSRCID"

config UBOOT_CONFIG_SICR_SPI_LSRCID
	bool "LSRCID"

endchoice

choice
	prompt "UART group"

config UBOOT_CONFIG_SICR_UART_SPI
	bool "UART"

config UBOOT_CONFIG_SICR_UART_MSRCID
	bool "MSRCID"

config UBOOT_CONFIG_SICR_UART_LSRCID
	bool "LSRCID"

endchoice

choice
	prompt "IRQ group"

config UBOOT_CONFIG_SICR_IRQ_SPI
	bool "IRQ"

config UBOOT_CONFIG_SICR_IRQ_MCP_CKSTOP
	bool "MCP/CKSTOP"

config UBOOT_CONFIG_SICR_IRQ_INTA
	bool "INTA"

endchoice

choice
	prompt "I2C2 group"

config UBOOT_CONFIG_SICR_I2C2_I2C
	bool "IRQ"

config UBOOT_CONFIG_SICR_I2C2_CKSTOP
	bool "CKSTOP"

endchoice

choice
	prompt "ETSEC1 A group"

config UBOOT_CONFIG_SICR_ETSEC1_A_TSEC2
	bool "TSEC1"

config UBOOT_CONFIG_SICR_ETSEC1_A_TSEC_GTX_CLK125
	bool "TSEC1 GTX_CLK125"

endchoice

choice
	prompt "eSDHC A group"

config UBOOT_CONFIG_SICR_ESDHC_A_SD
	bool "SD"

config UBOOT_CONFIG_SICR_ESDHC_A_GTM
	bool "GTM"

config UBOOT_CONFIG_SICR_ESDHC_A_GPIO
	bool "GPIO"

endchoice

choice
	prompt "eSDHC B group"

config UBOOT_CONFIG_SICR_ESDHC_B_SD
	bool "SD"

config UBOOT_CONFIG_SICR_ESDHC_B_GTM
	bool "GTM"

config UBOOT_CONFIG_SICR_ESDHC_B_GPIO
	bool "GPIO"

endchoice

choice
	prompt "eSDHC C group"

config UBOOT_CONFIG_SICR_ESDHC_C_SD
	bool "SD"

config UBOOT_CONFIG_SICR_ESDHC_C_GTM
	bool "GTM"

config UBOOT_CONFIG_SICR_ESDHC_C_GPIO
	bool "GPIO"

endchoice

choice
	prompt "GPIO A group"

config UBOOT_CONFIG_SICR_GPIO_A_GPIO
	bool "GPIO"

config UBOOT_CONFIG_SICR_GPIO_A_TSEC2
	bool "TSEC2"

endchoice

choice
	prompt "GPIO B group"

config UBOOT_CONFIG_SICR_GPIO_B_GPIO
	bool "GPIO"

config UBOOT_CONFIG_SICR_GPIO_B_TSEC2
	bool "TSEC2"

config UBOOT_CONFIG_SICR_GPIO_B_TSEC_GTX_CLK125
	bool "TSEC2 GTX_CLK125"

endchoice

choice
	prompt "IEEE1588 A group"

config UBOOT_CONFIG_SICR_IEEE1588_A_TSEC
	bool "TSEC"

config UBOOT_CONFIG_SICR_IEEE1588_A_GPIO
	bool "GPIO"

endchoice

choice
	prompt "USB group"

config UBOOT_CONFIG_SICR_USB_TSEC
	bool "USB"

endchoice

choice
	prompt "GTM group"

config UBOOT_CONFIG_SICR_GTM_TSEC
	bool "GTM"

config UBOOT_CONFIG_SICR_GTM_GPIO
	bool "GPIO"

endchoice

choice
	prompt "IEEE1588 B group"

config UBOOT_CONFIG_SICR_IEEE1588_B_GPIO
	bool "GPIO"

endchoice

choice
	prompt "ETSEC2 group"

config UBOOT_CONFIG_SICR_ETSEC2_TSEC2
	bool "TSEC2"

config UBOOT_CONFIG_SICR_ETSEC2_GPIO
	bool "GPIO"

endchoice

choice
	prompt "GPIO selection"

config UBOOT_CONFIG_SICR_GPIOSEL_GPIO
	bool "GPIO_A, GPIO_B"

config UBOOT_CONFIG_SICR_GPIOSEL_IEEE1588
	bool "IEEE1588_A, IEEE1588_B, ETSEC2"

endchoice

choice
	prompt "IEEE1588 timer output buffer impedance"

config UBOOT_CONFIG_SICR_TMROBI_3_3_V
	bool "40 Ohm, 3.3V"

config UBOOT_CONFIG_SICR_TMROBI_2_5_V
	bool "40 Ohm, 2.5V"

endchoice

choice
	prompt "TSEC1 output buffer impedance"

config UBOOT_CONFIG_SICR_TMSOBI1_3_3_V
	bool "40 Ohm, 3.3V"

config UBOOT_CONFIG_SICR_TMSOBI1_2_5_V
	bool "40 Ohm, 2.5V"

endchoice

choice
	prompt "TSEC2 output buffer impedance"

config UBOOT_CONFIG_SICR_TMSOBI2_3_3_V
	bool "40 Ohm, 3.3V"

config UBOOT_CONFIG_SICR_TMSOBI2_2_5_V
	bool "40 Ohm, 2.5V"

endchoice

config UBOOT_CONFIG_SICRL_SPI
	hex
	default 0x0 if UBOOT_CONFIG_SICR_SPI_SPI
	default 0x10000000 if UBOOT_CONFIG_SICR_SPI_MSRCID
	default 0x30000000 if UBOOT_CONFIG_SICR_SPI_LSRCID

config UBOOT_CONFIG_SICRL_UART
	hex
	default 0x0 if UBOOT_CONFIG_SICR_UART_SPI
	default 0x4000000 if UBOOT_CONFIG_SICR_UART_MSRCID
	default 0xc000000 if UBOOT_CONFIG_SICR_UART_LSRCID

config UBOOT_CONFIG_SICRL_IRQ
	hex
	default 0x0 if UBOOT_CONFIG_SICR_IRQ_SPI
	default 0x1000000 if UBOOT_CONFIG_SICR_IRQ_MCP_CKSTOP
	default 0x3000000 if UBOOT_CONFIG_SICR_IRQ_INTA

config UBOOT_CONFIG_SICRL_I2C2
	hex
	default 0x0 if UBOOT_CONFIG_SICR_I2C2_I2C
	default 0x100000 if UBOOT_CONFIG_SICR_I2C2_CKSTOP

config UBOOT_CONFIG_SICRL_ETSEC1_A
	hex
	default 0x0 if UBOOT_CONFIG_SICR_ETSEC1_A_TSEC2
	default 0x40 if UBOOT_CONFIG_SICR_ETSEC1_A_TSEC_GTX_CLK125

config UBOOT_CONFIG_SICRH_ESDHC_A
	hex
	default 0x0 if UBOOT_CONFIG_SICR_ESDHC_A_SD
	default 0x40000000 if UBOOT_CONFIG_SICR_ESDHC_A_GTM
	default 0xc0000000 if UBOOT_CONFIG_SICR_ESDHC_A_GPIO

config UBOOT_CONFIG_SICRH_ESDHC_B
	hex
	default 0x0 if UBOOT_CONFIG_SICR_ESDHC_B_SD
	default 0x10000000 if UBOOT_CONFIG_SICR_ESDHC_B_GTM
	default 0x30000000 if UBOOT_CONFIG_SICR_ESDHC_B_GPIO

config UBOOT_CONFIG_SICRH_ESDHC_C
	hex
	default 0x0 if UBOOT_CONFIG_SICR_ESDHC_C_SD
	default 0x4000000 if UBOOT_CONFIG_SICR_ESDHC_C_GTM
	default 0xc000000 if UBOOT_CONFIG_SICR_ESDHC_C_GPIO

config UBOOT_CONFIG_SICRH_GPIO_A
	hex
	default 0x0 if UBOOT_CONFIG_SICR_GPIO_A_GPIO
	default 0x1000000 if UBOOT_CONFIG_SICR_GPIO_A_TSEC2

config UBOOT_CONFIG_SICRH_GPIO_B
	hex
	default 0x0 if UBOOT_CONFIG_SICR_GPIO_B_GPIO
	default 0x400000 if UBOOT_CONFIG_SICR_GPIO_B_TSEC2
	default 0x800000 if UBOOT_CONFIG_SICR_GPIO_B_TSEC_GTX_CLK125

config UBOOT_CONFIG_SICRH_IEEE1588_A
	hex
	default 0x100000 if UBOOT_CONFIG_SICR_IEEE1588_A_TSEC
	default 0x300000 if UBOOT_CONFIG_SICR_IEEE1588_A_GPIO

config UBOOT_CONFIG_SICRH_USB
	hex
	default 0x40000 if UBOOT_CONFIG_SICR_USB_TSEC

config UBOOT_CONFIG_SICRH_GTM
	hex
	default 0x10000 if UBOOT_CONFIG_SICR_GTM_TSEC
	default 0x30000 if UBOOT_CONFIG_SICR_GTM_GPIO

config UBOOT_CONFIG_SICRH_IEEE1588_B
	hex
	default 0xc000 if UBOOT_CONFIG_SICR_IEEE1588_B_GPIO

config UBOOT_CONFIG_SICRH_ETSEC2
	hex
	default 0x1000 if UBOOT_CONFIG_SICR_ETSEC2_TSEC2
	default 0x3000 if UBOOT_CONFIG_SICR_ETSEC2_GPIO

config UBOOT_CONFIG_SICRH_GPIOSEL
	hex
	default 0x0 if UBOOT_CONFIG_SICR_GPIOSEL_GPIO
	default 0x100 if UBOOT_CONFIG_SICR_GPIOSEL_IEEE1588

config UBOOT_CONFIG_SICRH_TMROBI
	hex
	default 0x0 if UBOOT_CONFIG_SICR_TMROBI_3_3_V
	default 0x10 if UBOOT_CONFIG_SICR_TMROBI_2_5_V

config UBOOT_CONFIG_SICRH_TMSOBI1
	hex
	default 0x0 if UBOOT_CONFIG_SICR_TMSOBI1_3_3_V
	default 0x2 if UBOOT_CONFIG_SICR_TMSOBI1_2_5_V

config UBOOT_CONFIG_SICRH_TMSOBI2
	hex
	default 0x0 if UBOOT_CONFIG_SICR_TMSOBI2_3_3_V
	default 0x1 if UBOOT_CONFIG_SICR_TMSOBI2_2_5_V
```

## maxlinear/feed_uboot/open_uboot/config/arch/x86/cpu/baytrail/Kconfig
```kconfig
# SPDX-License-Identifier: GPL-2.0+
#
# Copyright (C) 2015 Google, Inc

config UBOOT_CONFIG_INTEL_BAYTRAIL
	bool
	select UBOOT_CONFIG_HAVE_FSP
	select UBOOT_CONFIG_ARCH_MISC_INIT
	select UBOOT_CONFIG_CPU_INTEL_TURBO_NOT_PACKAGE_SCOPED
	imply HAVE_INTEL_ME
	imply ENABLE_MRC_CACHE
	imply AHCI_PCI
	imply ICH_SPI
	imply INTEL_ICH6_GPIO
	imply PINCTRL_ICH6
	imply MMC
	imply MMC_PCI
	imply MMC_SDHCI
	imply MMC_SDHCI_SDMA
	imply SCSI
	imply SCSI_AHCI
	imply SPI_FLASH
	imply SYS_NS16550
	imply USB
	imply USB_EHCI_HCD
	imply USB_XHCI_HCD
	imply VIDEO_VESA

if UBOOT_CONFIG_INTEL_BAYTRAIL
config UBOOT_CONFIG_INTERNAL_UART
	bool "Enable the SoC integrated legacy UART"
	help
	  There is a legacy UART integrated into the Bay Trail SoC.
	  A maximum baud rate of 115200 bps is supported. For this
	  reason, it is recommended that the UART port be used for
	  debug purposes only, eg: U-Boot console.

config UBOOT_CONFIG_DEBUG_UART
	bool
	select UBOOT_CONFIG_DEBUG_UART_BOARD_INIT

endif
```

## maxlinear/feed_uboot/open_uboot/config/arch/x86/cpu/braswell/Kconfig
```kconfig
# SPDX-License-Identifier: GPL-2.0+
#
# Copyright (C) 2017, Bin Meng <bmeng.cn@gmail.com>

config UBOOT_CONFIG_INTEL_BRASWELL
	bool
	select UBOOT_CONFIG_HAVE_FSP
	select UBOOT_CONFIG_ARCH_MISC_INIT
	select UBOOT_CONFIG_CPU_INTEL_TURBO_NOT_PACKAGE_SCOPED
	imply HAVE_INTEL_ME
	imply HAVE_VBT
	imply ENABLE_MRC_CACHE
	imply AHCI_PCI
	imply ICH_SPI
	imply MMC
	imply MMC_PCI
	imply MMC_SDHCI
	imply MMC_SDHCI_SDMA
	imply SCSI
	imply SCSI_AHCI
	imply SPI_FLASH
	imply SYS_NS16550
	imply USB
	imply USB_XHCI_HCD
	imply VIDEO_FSP

if UBOOT_CONFIG_INTEL_BRASWELL

config UBOOT_CONFIG_FSP_ADDR
	hex
	default 0xfff20000

endif
```
