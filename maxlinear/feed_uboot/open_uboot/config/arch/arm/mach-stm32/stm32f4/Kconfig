## maxlinear/feed_uboot/open_uboot/config/arch/arm/mach-stm32/stm32f4/Kconfig
```kconfig
if UBOOT_CONFIG_STM32F4

config UBOOT_CONFIG_TARGET_STM32F429_DISCOVERY
	bool "STM32F429 Discovery board"

config UBOOT_CONFIG_TARGET_STM32F429_EVALUATION
	bool "STM32F429 Evaluation board"

config UBOOT_CONFIG_TARGET_STM32F469_DISCOVERY
	bool "STM32F469 Discovery board"

source "../../../../board/st/stm32f429-discovery/Kconfig"
source "../../../../board/st/stm32f429-evaluation/Kconfig"
source "../../../../board/st/stm32f469-discovery/Kconfig"

endif
```

## maxlinear/feed_uboot/open_uboot/config/arch/arm/mach-stm32/stm32f7/Kconfig
```kconfig
if UBOOT_CONFIG_STM32F7

config UBOOT_CONFIG_TARGET_STM32F746_DISCO
	bool "STM32F746 Discovery board"

source "../../../../board/st/stm32f746-disco/Kconfig"

endif
```

## maxlinear/feed_uboot/open_uboot/config/arch/arm/mach-tegra/Kconfig
```kconfig
if UBOOT_CONFIG_ARCH_TEGRA

config UBOOT_CONFIG_SPL_GPIO
	default y

config UBOOT_CONFIG_SPL_LIBCOMMON_SUPPORT
	default y

config UBOOT_CONFIG_SPL_LIBGENERIC_SUPPORT
	default y

config UBOOT_CONFIG_SPL_SERIAL
	default y

config UBOOT_CONFIG_TEGRA_CLKRST
	bool

config UBOOT_CONFIG_TEGRA_GP_PADCTRL
	bool

config UBOOT_CONFIG_TEGRA_IVC
	bool "Tegra IVC protocol"
	help
	  IVC (Inter-VM Communication) protocol is a Tegra-specific IPC
	  (Inter Processor Communication) framework. Within the context of
	  U-Boot, it is typically used for communication between the main CPU
	  and various auxiliary processors.

config UBOOT_CONFIG_TEGRA_MC
	bool

config UBOOT_CONFIG_TEGRA_PINCTRL
	bool

config UBOOT_CONFIG_TEGRA_PMC
	bool

config UBOOT_CONFIG_TEGRA_PMC_SECURE
	bool
	depends on UBOOT_CONFIG_TEGRA_PMC

config UBOOT_CONFIG_TEGRA_COMMON
	bool "Tegra common options"
	select UBOOT_CONFIG_BOARD_EARLY_INIT_F
	select UBOOT_CONFIG_CLK
	select UBOOT_CONFIG_DM
	select UBOOT_CONFIG_DM_ETH
	select UBOOT_CONFIG_DM_GPIO
	select UBOOT_CONFIG_DM_I2C
	select UBOOT_CONFIG_DM_KEYBOARD
	select UBOOT_CONFIG_DM_MMC
	select UBOOT_CONFIG_DM_PWM
	select UBOOT_CONFIG_DM_RESET
	select UBOOT_CONFIG_DM_SERIAL
	select UBOOT_CONFIG_DM_SPI
	select UBOOT_CONFIG_DM_SPI_FLASH
	select UBOOT_CONFIG_MISC
	select UBOOT_CONFIG_OF_CONTROL
	select UBOOT_CONFIG_SPI
	imply CMD_DM
	imply CRC32_VERIFY

config UBOOT_CONFIG_TEGRA_NO_BPMP
	bool "Tegra common options for SoCs without BPMP"
	select UBOOT_CONFIG_TEGRA_CAR
	select UBOOT_CONFIG_TEGRA_CAR_CLOCK
	select UBOOT_CONFIG_TEGRA_CAR_RESET

config UBOOT_CONFIG_TEGRA_ARMV7_COMMON
	bool "Tegra 32-bit common options"
	select UBOOT_CONFIG_BINMAN
	select UBOOT_CONFIG_CPU_V7A
	select UBOOT_CONFIG_SPL
	select UBOOT_CONFIG_SPL_BOARD_INIT if SPL
	select UBOOT_CONFIG_SPL_SKIP_LOWLEVEL_INIT_ONLY if SPL
	select UBOOT_CONFIG_SUPPORT_SPL
	select UBOOT_CONFIG_TEGRA_CLKRST
	select UBOOT_CONFIG_TEGRA_COMMON
	select UBOOT_CONFIG_TEGRA_GPIO
	select UBOOT_CONFIG_TEGRA_GP_PADCTRL
	select UBOOT_CONFIG_TEGRA_MC
	select UBOOT_CONFIG_TEGRA_NO_BPMP
	select UBOOT_CONFIG_TEGRA_PINCTRL
	select UBOOT_CONFIG_TEGRA_PMC

config UBOOT_CONFIG_TEGRA_ARMV8_COMMON
	bool "Tegra 64-bit common options"
	select UBOOT_CONFIG_ARM64
	select UBOOT_CONFIG_INIT_SP_RELATIVE
	select UBOOT_CONFIG_LINUX_KERNEL_IMAGE_HEADER
	select UBOOT_CONFIG_POSITION_INDEPENDENT
	select UBOOT_CONFIG_TEGRA_COMMON

if UBOOT_CONFIG_TEGRA_ARMV8_COMMON
config UBOOT_CONFIG_LNX_KRNL_IMG_TEXT_OFFSET_BASE
	default 0x80000000
endif

choice
	prompt "Tegra SoC select"
	optional

config UBOOT_CONFIG_TEGRA20
	bool "Tegra20 family"
	select UBOOT_CONFIG_ARM_ERRATA_716044
	select UBOOT_CONFIG_ARM_ERRATA_742230
	select UBOOT_CONFIG_ARM_ERRATA_751472
	select UBOOT_CONFIG_TEGRA_ARMV7_COMMON

config UBOOT_CONFIG_TEGRA30
	bool "Tegra30 family"
	select UBOOT_CONFIG_ARM_ERRATA_743622
	select UBOOT_CONFIG_ARM_ERRATA_751472
	select UBOOT_CONFIG_TEGRA_ARMV7_COMMON

config UBOOT_CONFIG_TEGRA114
	bool "Tegra114 family"
	select UBOOT_CONFIG_TEGRA_ARMV7_COMMON

config UBOOT_CONFIG_TEGRA124
	bool "Tegra124 family"
	select UBOOT_CONFIG_TEGRA_ARMV7_COMMON
	imply REGMAP
	imply SYSCON

config UBOOT_CONFIG_TEGRA210
	bool "Tegra210 family"
	select UBOOT_CONFIG_GICV2
	select UBOOT_CONFIG_TEGRA_ARMV8_COMMON
	select UBOOT_CONFIG_TEGRA_CLKRST
	select UBOOT_CONFIG_TEGRA_GPIO
	select UBOOT_CONFIG_TEGRA_GP_PADCTRL
	select UBOOT_CONFIG_TEGRA_MC
	select UBOOT_CONFIG_TEGRA_NO_BPMP
	select UBOOT_CONFIG_TEGRA_PINCTRL
	select UBOOT_CONFIG_TEGRA_PMC
	select UBOOT_CONFIG_TEGRA_PMC_SECURE

config UBOOT_CONFIG_TEGRA186
	bool "Tegra186 family"
	select UBOOT_CONFIG_DM_MAILBOX
	select UBOOT_CONFIG_GICV2
	select UBOOT_CONFIG_TEGRA186_BPMP
	select UBOOT_CONFIG_TEGRA186_CLOCK
	select UBOOT_CONFIG_TEGRA186_GPIO
	select UBOOT_CONFIG_TEGRA186_RESET
	select UBOOT_CONFIG_TEGRA_ARMV8_COMMON
	select UBOOT_CONFIG_TEGRA_HSP
	select UBOOT_CONFIG_TEGRA_IVC

endchoice

config UBOOT_CONFIG_TEGRA_DISCONNECT_UDC_ON_BOOT
	bool "Disconnect USB device mode controller on boot"
	depends on UBOOT_CONFIG_CI_UDC
	default y
	help
	  When loading U-Boot into RAM over USB protocols using tools such as
	  tegrarcm or L4T's exec-uboot.sh/tegraflash.py, Tegra's USB device
	  mode controller is initialized and enumerated by the host PC running
	  the tool. Unfortunately, these tools do not shut down the USB
	  controller before executing the downloaded code, and so the host PC
	  does not "de-enumerate" the USB device. This option shuts down the
	  USB controller when U-Boot boots to avoid leaving a stale USB device
	  present.

config UBOOT_CONFIG_SYS_MALLOC_F_LEN
	default 0x1800

source "tegra20/Kconfig"
source "tegra30/Kconfig"
source "tegra114/Kconfig"
source "tegra124/Kconfig"
source "tegra210/Kconfig"
source "tegra186/Kconfig"

config UBOOT_CONFIG_CMD_ENTERRCM
	bool "Enable 'enterrcm' command"
	default y
	help
	  Tegra's boot ROM supports a mode whereby code may be downloaded and
	  flash-programmed over a USB connection. On dev boards, this is
	  typically entered by holding down a "force recovery" button and
	  resetting the CPU. However, not all boards have such a button (one
	  example is the Compulab Trimslice), so a method to enter RCM from
	  software is useful.

	  Even on boards other than Trimslice, controlling this over a UART
	  may be useful, e.g. to allow simple remote control without the need
	  for mechanical button actuators, or hooking up relays/... to the
	  button.

endif
```

## maxlinear/feed_uboot/open_uboot/config/arch/arm/mach-tegra/tegra30/Kconfig
```kconfig
if UBOOT_CONFIG_TEGRA30

choice
	prompt "Tegra30 board select"
	optional

config UBOOT_CONFIG_TARGET_APALIS_T30
	bool "Toradex Apalis T30 board"
	select UBOOT_CONFIG_BOARD_LATE_INIT

config UBOOT_CONFIG_TARGET_BEAVER
	bool "NVIDIA Tegra30 Beaver evaluation board"
	select UBOOT_CONFIG_BOARD_LATE_INIT

config UBOOT_CONFIG_TARGET_CARDHU
	bool "NVIDIA Tegra30 Cardhu evaluation board"
	select UBOOT_CONFIG_BOARD_LATE_INIT

config UBOOT_CONFIG_TARGET_COLIBRI_T30
	bool "Toradex Colibri T30 board"
	select UBOOT_CONFIG_BOARD_LATE_INIT

config UBOOT_CONFIG_TARGET_TEC_NG
	bool "Avionic Design TEC-NG board"
	select UBOOT_CONFIG_BOARD_LATE_INIT

endchoice

config UBOOT_CONFIG_SYS_SOC
	default "tegra30"

source "../../../../board/toradex/apalis_t30/Kconfig"
source "../../../../board/nvidia/beaver/Kconfig"
source "../../../../board/nvidia/cardhu/Kconfig"
source "../../../../board/toradex/colibri_t30/Kconfig"
source "../../../../board/avionic-design/tec-ng/Kconfig"

endif
```

## maxlinear/feed_uboot/open_uboot/config/arch/m68k/Kconfig
```kconfig
menu "M68000 architecture"
	depends on UBOOT_CONFIG_M68K

config UBOOT_CONFIG_SYS_ARCH
	default "m68k"

# processor family
config UBOOT_CONFIG_MCF520x
	select UBOOT_CONFIG_OF_CONTROL
	select UBOOT_CONFIG_DM
        select UBOOT_CONFIG_DM_SERIAL
	bool

config UBOOT_CONFIG_MCF52x2
	select UBOOT_CONFIG_OF_CONTROL
	select UBOOT_CONFIG_DM
        select UBOOT_CONFIG_DM_SERIAL
	bool

config UBOOT_CONFIG_MCF523x
	select UBOOT_CONFIG_OF_CONTROL
	select UBOOT_CONFIG_DM
        select UBOOT_CONFIG_DM_SERIAL
	bool

config UBOOT_CONFIG_MCF530x
	select UBOOT_CONFIG_OF_CONTROL
	select UBOOT_CONFIG_DM
        select UBOOT_CONFIG_DM_SERIAL
	bool

config UBOOT_CONFIG_MCF5301x
	select UBOOT_CONFIG_OF_CONTROL
	select UBOOT_CONFIG_DM
        select UBOOT_CONFIG_DM_SERIAL
	bool

config UBOOT_CONFIG_MCF532x
	select UBOOT_CONFIG_OF_CONTROL
	select UBOOT_CONFIG_DM
        select UBOOT_CONFIG_DM_SERIAL
	bool

config UBOOT_CONFIG_MCF537x
	select UBOOT_CONFIG_OF_CONTROL
	select UBOOT_CONFIG_DM
        select UBOOT_CONFIG_DM_SERIAL
	bool

config UBOOT_CONFIG_MCF5441x
	select UBOOT_CONFIG_OF_CONTROL
	select UBOOT_CONFIG_DM
        select UBOOT_CONFIG_DM_SERIAL
	bool

config UBOOT_CONFIG_MCF5227x
	select UBOOT_CONFIG_OF_CONTROL
	select UBOOT_CONFIG_DM
        select UBOOT_CONFIG_DM_SERIAL
	bool

# processor type
config UBOOT_CONFIG_M5208
	bool
	select UBOOT_CONFIG_MCF520x

config UBOOT_CONFIG_M5235
	bool
	select UBOOT_CONFIG_MCF523x

config UBOOT_CONFIG_M5249
	bool
	select UBOOT_CONFIG_MCF52x2

config UBOOT_CONFIG_M5253
	bool
	select UBOOT_CONFIG_MCF52x2

config UBOOT_CONFIG_M5271
	bool
	select UBOOT_CONFIG_MCF52x2

config UBOOT_CONFIG_M5272
	bool
	select UBOOT_CONFIG_MCF52x2

config UBOOT_CONFIG_M5275
	bool
	select UBOOT_CONFIG_MCF52x2

config UBOOT_CONFIG_M5282
	bool
	select UBOOT_CONFIG_MCF52x2

config UBOOT_CONFIG_M5307
	bool
	select UBOOT_CONFIG_MCF530x

config UBOOT_CONFIG_M53015
	bool
	select UBOOT_CONFIG_MCF5301x

config UBOOT_CONFIG_M5329
	bool
	select UBOOT_CONFIG_MCF532x

config UBOOT_CONFIG_M5373
	bool
	select UBOOT_CONFIG_MCF532x
	select UBOOT_CONFIG_MCF537x

config UBOOT_CONFIG_M54418
	bool
	select UBOOT_CONFIG_MCF5441x

choice
	prompt "Target select"
	optional

config UBOOT_CONFIG_TARGET_M5235EVB
	bool "Support M5235EVB"
	select UBOOT_CONFIG_M5235

config UBOOT_CONFIG_TARGET_COBRA5272
	bool "Support cobra5272"
	select UBOOT_CONFIG_M5272

config UBOOT_CONFIG_TARGET_EB_CPU5282
	bool "Support eb_cpu5282"
	select UBOOT_CONFIG_M5282

config UBOOT_CONFIG_TARGET_M5208EVBE
	bool "Support M5208EVBE"
	select UBOOT_CONFIG_M5208

config UBOOT_CONFIG_TARGET_M5249EVB
	bool "Support M5249EVB"
	select UBOOT_CONFIG_M5249

config UBOOT_CONFIG_TARGET_M5253DEMO
	bool "Support M5253DEMO"
	select UBOOT_CONFIG_M5253

config UBOOT_CONFIG_TARGET_M5272C3
	bool "Support M5272C3"
	select UBOOT_CONFIG_M5272

config UBOOT_CONFIG_TARGET_M5275EVB
	bool "Support M5275EVB"
	select UBOOT_CONFIG_M5275

config UBOOT_CONFIG_TARGET_M5282EVB
	bool "Support M5282EVB"
	select UBOOT_CONFIG_M5282

config UBOOT_CONFIG_TARGET_ASTRO_MCF5373L
	bool "Support astro_mcf5373l"
	select UBOOT_CONFIG_M5373

config UBOOT_CONFIG_TARGET_M53017EVB
	bool "Support M53017EVB"
	select UBOOT_CONFIG_M53015

config UBOOT_CONFIG_TARGET_M5329EVB
	bool "Support M5329EVB"
	select UBOOT_CONFIG_M5329

config UBOOT_CONFIG_TARGET_M5373EVB
	bool "Support M5373EVB"
	select UBOOT_CONFIG_M5373

config UBOOT_CONFIG_TARGET_AMCORE
	bool "Support AMCORE"
	select UBOOT_CONFIG_M5307

config UBOOT_CONFIG_TARGET_STMARK2
        bool "Support stmark2"
        select UBOOT_CONFIG_M54418

endchoice

source "../../board/BuS/eb_cpu5282/Kconfig"
source "../../board/astro/mcf5373l/Kconfig"
source "../../board/cobra5272/Kconfig"
source "../../board/freescale/m5208evbe/Kconfig"
source "../../board/freescale/m5235evb/Kconfig"
source "../../board/freescale/m5249evb/Kconfig"
source "../../board/freescale/m5253demo/Kconfig"
source "../../board/freescale/m5272c3/Kconfig"
source "../../board/freescale/m5275evb/Kconfig"
source "../../board/freescale/m5282evb/Kconfig"
source "../../board/freescale/m53017evb/Kconfig"
source "../../board/freescale/m5329evb/Kconfig"
source "../../board/freescale/m5373evb/Kconfig"
source "../../board/sysam/amcore/Kconfig"
source "../../board/sysam/stmark2/Kconfig"

endmenu
```

## maxlinear/feed_uboot/open_uboot/config/arch/mips/mach-ath79/Kconfig
```kconfig
menu "QCA/Atheros 7xxx/9xxx platforms"
	depends on UBOOT_CONFIG_ARCH_ATH79

config UBOOT_CONFIG_SYS_SOC
	default "ath79"

config UBOOT_CONFIG_SOC_AR933X
	bool
	select UBOOT_CONFIG_MIPS_TUNE_24KC
	select UBOOT_CONFIG_ROM_EXCEPTION_VECTORS
	select UBOOT_CONFIG_SUPPORTS_BIG_ENDIAN
	select UBOOT_CONFIG_SUPPORTS_CPU_MIPS32_R1
	select UBOOT_CONFIG_SUPPORTS_CPU_MIPS32_R2
	help
	  This supports QCA/Atheros ar933x family SOCs.

config UBOOT_CONFIG_SOC_AR934X
	bool
	select UBOOT_CONFIG_MIPS_TUNE_74KC
	select UBOOT_CONFIG_SUPPORTS_BIG_ENDIAN
	select UBOOT_CONFIG_SUPPORTS_CPU_MIPS32_R1
	select UBOOT_CONFIG_SUPPORTS_CPU_MIPS32_R2
	select UBOOT_CONFIG_USB_EHCI_IS_TDI if USB_EHCI_HCD
	help
	  This supports QCA/Atheros ar934x family SOCs.

config UBOOT_CONFIG_SOC_QCA953X
	bool
	select UBOOT_CONFIG_MIPS_TUNE_24KC
	select UBOOT_CONFIG_ROM_EXCEPTION_VECTORS
	select UBOOT_CONFIG_SUPPORTS_BIG_ENDIAN
	select UBOOT_CONFIG_SUPPORTS_CPU_MIPS32_R1
	select UBOOT_CONFIG_SUPPORTS_CPU_MIPS32_R2
	help
	  This supports QCA/Atheros qca953x family SOCs.

config UBOOT_CONFIG_SOC_QCA956X
	bool
	select UBOOT_CONFIG_MIPS_TUNE_74KC
	select UBOOT_CONFIG_SUPPORTS_BIG_ENDIAN
	select UBOOT_CONFIG_SUPPORTS_CPU_MIPS32_R1
	select UBOOT_CONFIG_SUPPORTS_CPU_MIPS32_R2
	help
	  This supports QCA/Atheros qca956x family SOCs.

choice
	prompt "Board select"

config UBOOT_CONFIG_TARGET_AP121
	bool "AP121 Reference Board"
	select UBOOT_CONFIG_SOC_AR933X

config UBOOT_CONFIG_TARGET_AP143
	bool "AP143 Reference Board"
	select UBOOT_CONFIG_SOC_QCA953X

config UBOOT_CONFIG_TARGET_AP152
	bool "AP152 Reference Board"
	select UBOOT_CONFIG_SOC_QCA956X

config UBOOT_CONFIG_BOARD_TPLINK_WDR4300
	bool "TP-Link WDR4300 Board"
	select UBOOT_CONFIG_SOC_AR934X

endchoice

source "../../../board/qca/ap121/Kconfig"
source "../../../board/qca/ap143/Kconfig"
source "../../../board/qca/ap152/Kconfig"
source "../../../board/tplink/wdr4300/Kconfig"

endmenu
```

## maxlinear/feed_uboot/open_uboot/config/arch/mips/mach-jz47xx/Kconfig
```kconfig
menu "Ingenic JZ47xx platforms"
	depends on UBOOT_CONFIG_ARCH_JZ47XX

config UBOOT_CONFIG_SYS_SOC
	default "jz47xx"

config UBOOT_CONFIG_SOC_JZ4780
	bool
	select UBOOT_CONFIG_SUPPORTS_LITTLE_ENDIAN
	select UBOOT_CONFIG_SUPPORTS_CPU_MIPS32_R1
	select UBOOT_CONFIG_SUPPORTS_CPU_MIPS32_R2
	help
	  Support for Ingenic JZ4780 family SoCs.

choice
	prompt "Board select"

config UBOOT_CONFIG_TARGET_JZ4780_CI20
	bool "Creator CI20 Reference Board"
	select UBOOT_CONFIG_SOC_JZ4780

endchoice

source "../../../board/imgtec/ci20/Kconfig"

endmenu
```
