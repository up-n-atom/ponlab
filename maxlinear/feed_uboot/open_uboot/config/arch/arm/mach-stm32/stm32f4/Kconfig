## maxlinear/feed_uboot/open_uboot/config/arch/x86/cpu/lightning_mountain/Kconfig
```kconfig
# SoC specific configurations

config UBOOT_CONFIG_ATOM
	bool "Powered by Atom"
	select UBOOT_CONFIG_USE_CAR
	depends on UBOOT_CONFIG_VENDOR_MAXLINEAR
	help
	  Ultra-low-voltage IA-32 and x86-64 microprocessors used in systems on a chip (SoCs).
	  x86 CPU specific configuration and support.

menu "Atom Specific configurations"
	depends on UBOOT_CONFIG_ATOM

config UBOOT_CONFIG_SYS_CPU
	default "atom"

config UBOOT_CONFIG_SYS_VENDOR
	default "maxlinear"

config UBOOT_CONFIG_SYS_SOC
	default "lightning"

config UBOOT_CONFIG_DEBUG_SIMPLIFY
	bool "simplify uboot debug message"
	default y

#TODO: x86 atom architecture-specific options below
config UBOOT_CONFIG_SYS_MALLOC_F_LEN
	default 0x1000

config UBOOT_CONFIG_CPU_ADDR_BITS
	int "x86 CPU Address bit"
	default 36
	help
	  Map the number of address space bits supported by the CPU to the
	  mask field value as it needs to be written into the upper 32 bits
	  of the various MTRRphysMask_MSR MSRs.

	  mask field @ 0x00000000 if CPU_ADDR_BITS is 32
	  mask field @ 0x0000000f if CPU_ADDR_BITS is 36
	  mask field @ 0x000000ff if CPU_ADDR_BITS is 40
	  mask field @ 0x0000ffff if CPU_ADDR_BITS is 48

#TODO: Cache-As-RAM, EXCEPTION, LMU_BASE, LMU_SIZE
config UBOOT_CONFIG_SYS_CAR_ADDR
	hex
	default 0xBFF00000
	help
	  Internal SRAM base address.

config UBOOT_CONFIG_SYS_CAR_SIZE
	hex
	default 0x80000
	help
	  Internal SRAM size.

config UBOOT_CONFIG_SMP_CORES
	hex "The number of cores"
	default 0x4
	help
	  Customise option for SoC.
endmenu

menu "LGM SOC Platform Configuration"
	depends on UBOOT_CONFIG_LIGHTNING_MOUNTAIN_SOC

config UBOOT_CONFIG_DDR_SCRAMBLE
	bool "Enable DDR Scrambler"
	default n
	help
		Yes to enable DDR Scrambler

menu "DDR Scrambler configurations"
	depends on UBOOT_CONFIG_DDR_SCRAMBLE

config UBOOT_CONFIG_DDR_SCRAMBLE_REGION_BYPASS
	bool "Enable DDR Scramble Region Bypass"
    default n
    help
        Yes if want to bypass scrambler effect

config UBOOT_CONFIG_SCRAMBLE_BYPASS_REGION_TOGGLE
	bool "Toggle DDR Scramble Region"
	default y
	help
		Yes to scramble content of the bypass region

config UBOOT_CONFIG_SCRAMBLE_BYPASS_REGION_START_LSB
	hex "Start address of bypass region LSB"
	default 0x0
	help
	  Start address of bypass region LSB.

config UBOOT_CONFIG_SCRAMBLE_BYPASS_REGION_START_MSB
	hex "Start address of bypass region MSB"
	default 0x0
	help
	  Start address of bypass region MSB.

config UBOOT_CONFIG_SCRAMBLE_BYPASS_REGION_END_LSB
	hex "End address of bypass region LSB"
	default 0xFFFFFFFF
	help
	  End address of bypass region LSB.

config UBOOT_CONFIG_SCRAMBLE_BYPASS_REGION_END_MSB
	hex "End address of bypass region MSB"
	default 0xF
	help
	  End address of bypass region MSB.
endmenu

config UBOOT_CONFIG_LGM_EPU
	bool "EPU hardware in LGM SoC"
	help
	  Selects EPU hardware support

choice
	prompt "Chosen CPU Frequency"

config UBOOT_CONFIG_LGM_CPU_624M
	bool "624Mhz"

config UBOOT_CONFIG_LGM_CPU_1560M
	bool "1560Mhz"

config UBOOT_CONFIG_LGM_CPU_1716M
	bool "1716Mhz"

if ( UBOOT_CONFIG_URX851_SOC )
config UBOOT_CONFIG_LGM_CPU_1872M
	bool "1872Mhz"

config UBOOT_CONFIG_LGM_CPU_2028M
	bool "2028Mhz"

config UBOOT_CONFIG_LGM_CPU_2496M
	bool "2496Mhz"
endif

endchoice

config UBOOT_CONFIG_LGM_CPU_FREQ
	hex
	default 0x8 if UBOOT_CONFIG_LGM_CPU_624M
	default 0x14 if UBOOT_CONFIG_LGM_CPU_1560M
	default 0x16 if UBOOT_CONFIG_LGM_CPU_1716M
	default 0x18 if UBOOT_CONFIG_LGM_CPU_1872M
	default 0x1A if UBOOT_CONFIG_LGM_CPU_2028M
	default 0x20 if UBOOT_CONFIG_LGM_CPU_2496M

config UBOOT_CONFIG_TARGET_U_BOOT_LIGHTNING
	bool "U-Boot target Lightning-Mountain"
	select UBOOT_CONFIG_DM

config UBOOT_CONFIG_INTEL_UCODE_PATCH
	bool "Enable microcode patch for LGM"
	default n

config UBOOT_CONFIG_ASSERT_FIREWALL_RULES
	bool "Allow only small sets of firewall access"
	default n
	help
	  Select to assert firewall rules to the LGM subsystem.

config UBOOT_CONFIG_ENABLE_IA_VMM_SWITCH
	bool "Enable switch from IA_BOOT to IA_VMM"
	default n
	help
	  Select to enable switch from IA_BOOT to IA_VMM.

config UBOOT_CONFIG_TEP_PKG
	bool "Lightning Mountain platform with TEP enabled"
	default n
	help
	  Select to enable TEP with LGM

config UBOOT_CONFIG_TEP_LOAD_ADDR
	hex "Start address of the TEP core"
	default 0x01000000
	depends on UBOOT_CONFIG_TEP_PKG
	help
	  Bootstrap address of the TEP core

config UBOOT_CONFIG_TEP_FLASH_OFFSET
	hex "Offset of TEP firmware img in flash"
	default 0xC0000
	depends on ( UBOOT_CONFIG_TEP_PKG && !UBOOT_CONFIG_BOOT_FROM_EMMC )
	help
	  Offset in raw flash, only used in NAND/NOR
	  boot modes.

config UBOOT_CONFIG_TEP_FLASH_SIZE
	hex "Size of TEP firmware img in flash"
	default 0x100000
	depends on UBOOT_CONFIG_TEP_PKG
	help
	  size to read from raw flash

config UBOOT_CONFIG_SYS_TEXT_BASE
	hex "U-Boot starting address in DRAM"
	default 0x20400000

config UBOOT_CONFIG_SPL_TEXT_BASE
	hex "SPL U-Boot starting address in DRAM"
	default 0xecd20000

config UBOOT_CONFIG_SFDDR_TEXT_BASE
	hex "Serial flash starting address in DRAM"
	default 0xecd20000
	depends on UBOOT_CONFIG_BOOT_FROM_SPI || UBOOT_CONFIG_BOOT_FROM_QSPI_NOR || UBOOT_CONFIG_BOOT_FROM_QSPI_NAND

config UBOOT_CONFIG_NAND_SPL_TEXT_BASE
	hex "NAND flash starting address in DRAM"
	default 0xecd20000
	depends on UBOOT_CONFIG_BOOT_FROM_NAND

config UBOOT_CONFIG_BOOT_FROM_QSPI_NOR
	bool "Boot from Serial NOR"
	default n
	depends on UBOOT_CONFIG_QSPI_BOOT
	help
	  Boot from QSPI Serial NOR Flash

config UBOOT_CONFIG_BOOT_FROM_QSPI_NAND
	bool "Boot from Serial NAND"
	default n
	depends on UBOOT_CONFIG_QSPI_BOOT
	help
	  Boot from QSPI NAND Flash

config UBOOT_CONFIG_BOOT_FROM_NAND
	bool
	default y if UBOOT_CONFIG_NAND_BOOT
	select UBOOT_CONFIG_NAND_FLASH_MXL
	help
	  Boots from NAND Flash.

config UBOOT_CONFIG_BOOT_FROM_EMMC
	bool
	default y if UBOOT_CONFIG_SD_BOOT
	help
	  Boots from eMMC

config UBOOT_CONFIG_BOOT_FROM_MEM
	bool "Boot from memory (without flash/emmc dependency)"
	default n
	help
	  Boots from memory. Use this if you want to boot
	  from jtag/asc without having to worry about flash
	  or emmc availability

# secureboot configurations
config UBOOT_CONFIG_CHD_SECURE_BOOT
	bool "AnyWAN SECURE BOOT"
	default n
	depends on UBOOT_CONFIG_DRIVER_LIGHTNING

config UBOOT_CONFIG_CHD_SECURE_BOOT_WITHOUT_SIGNING
	bool "Images will be sign externally"
	default n
	depends on UBOOT_CONFIG_CHD_SECURE_BOOT

config UBOOT_CONFIG_SIGNTOOL
	string "signtool path"
	default "signtool"
	depends on UBOOT_CONFIG_CHD_SECURE_BOOT && !UBOOT_CONFIG_CHD_SECURE_BOOT_WITHOUT_SIGNING

config UBOOT_CONFIG_PRIVATE_KEY
	string "private key(path)"
	default "privatekey.der"
	depends on UBOOT_CONFIG_CHD_SECURE_BOOT && !UBOOT_CONFIG_CHD_SECURE_BOOT_WITHOUT_SIGNING

config UBOOT_CONFIG_PROD_UNIQUE_KEY
	string "product unique key(path)"
	default "CRkey.bin"
	depends on UBOOT_CONFIG_CHD_SECURE_BOOT && !UBOOT_CONFIG_CHD_SECURE_BOOT_WITHOUT_SIGNING

config UBOOT_CONFIG_ENCRYPTION_SUPPORT
	bool "Encryption Key Support"
	default n
	depends on UBOOT_CONFIG_CHD_SECURE_BOOT

config UBOOT_CONFIG_ENCRYPTION_KEY
	string "encryption key(path)"
	default "ENCkey.bin"
	depends on UBOOT_CONFIG_CHD_SECURE_BOOT && !UBOOT_CONFIG_CHD_SECURE_BOOT_WITHOUT_SIGNING
	depends on UBOOT_CONFIG_ENCRYPTION_SUPPORT

config UBOOT_CONFIG_ROLLBACKID_SUPPORT
	bool "Anti Roll Back ID  Support"
	default n
	depends on UBOOT_CONFIG_CHD_SECURE_BOOT

config UBOOT_CONFIG_ROLLBACKID_VALUE
	int "Anti Roll Back ID Value"
	default 2
	depends on UBOOT_CONFIG_CHD_SECURE_BOOT
	depends on UBOOT_CONFIG_ROLLBACKID_SUPPORT

config UBOOT_CONFIG_FLEXI_RBID
	bool "Enable flexible rollback id feature"
	default n
	depends on UBOOT_CONFIG_ROLLBACKID_SUPPORT

config UBOOT_CONFIG_COMPATIBILITY_VER
	bool "Compatibility Version Support"
	default n
	depends on UBOOT_CONFIG_CHD_SECURE_BOOT

config UBOOT_CONFIG_UDT_STATUS_SUPPORT
	bool "UDT Status Support"
	default n

config UBOOT_CONFIG_CERTIFICATION_SUPPORT
	bool "Certification Support"
	default n
	depends on UBOOT_CONFIG_CHD_SECURE_BOOT

config UBOOT_CONFIG_CERTIFICATION
	string "certification(path)"
	default "cert.bin"
	depends on UBOOT_CONFIG_CHD_SECURE_BOOT && !UBOOT_CONFIG_CHD_SECURE_BOOT_WITHOUT_SIGNING
	depends on UBOOT_CONFIG_CERTIFICATION_SUPPORT

config UBOOT_CONFIG_RBE_SEPERATE_SIGNATURE
	bool "Support seperate signature for RBE"
	depends on UBOOT_CONFIG_CHD_SECURE_BOOT
	default n

config UBOOT_CONFIG_RBE_PRIVATE_KEY
	string "RBE private key"
	default "rbe_privatekey.der"
	depends on UBOOT_CONFIG_RBE_SEPERATE_SIGNATURE
	help
	  Path to ECDSA private key for RBE

config UBOOT_CONFIG_RBE_PROD_UNIQUE_KEY
	string "RBE product unique key"
	default "rbe_crkey.bin"
	depends on UBOOT_CONFIG_RBE_SEPERATE_SIGNATURE

config UBOOT_CONFIG_RBE_CERIFICATION_SUPPORT
	bool "Support certification for RBE binary"
	depends on UBOOT_CONFIG_RBE_SEPERATE_SIGNATURE

config UBOOT_CONFIG_RBE_CERTIFICATION
	string "RBE certificate"
	default "rbe_cert.bin"
	depends on UBOOT_CONFIG_RBE_SEPERATE_SIGNATURE

config UBOOT_CONFIG_RBE_ROLLBACKID_VALUE
	hex "Anti-rollback ID for RBE binary"
	depends on UBOOT_CONFIG_RBE_SEPERATE_SIGNATURE
	default 2

# manufacturing boot configurations
config UBOOT_CONFIG_MANUBOOT
	bool "Manufacturing Boot ( UBOOT_CONFIG_Root Of Trust Transfer )"
	default n
	depends on UBOOT_CONFIG_CHD_SECURE_BOOT

config UBOOT_CONFIG_MANUBOOT_OTP_SBCROTP_KEY
	string "sbcr otp key(path) manuboot"
	default "SBCRotpkey.bin"
	depends on UBOOT_CONFIG_MANUBOOT

config UBOOT_CONFIG_MANUBOOT_IMG_OFFSET
	hex "Image offset of the Manufacturing Boot Image within the RoT Transfer image"
	depends on UBOOT_CONFIG_MANUBOOT || UBOOT_CONFIG_CUSTOMER_TEST_IMG_BUILD
	default 0x100000
	help
	  This points to the offset of the Manufacturing boot image
	  within the full RoT Transfer image. This is used to overwrite
	  the bootrom header with the correct jump offset.

config UBOOT_CONFIG_MANUBOOT_IMAGE
	string "Manufacturing U-Boot Image"
	depends on UBOOT_CONFIG_MANUBOOT
	default "manuboot-img.bin"
	help
	  This image points to the manufacturing u-boot image

config UBOOT_CONFIG_CUSTOMER_TEST_IMG_BUILD
	bool "Build Reference Customer ODM Image"
	default n
	help
	  A reference build for Customer ODM use in RoT

config UBOOT_CONFIG_CUSTOMER_TEST_IMG_OFFSET
	hex "Image offset of the Customer test image within the RoT Transfer image"
	depends on UBOOT_CONFIG_MANUBOOT || UBOOT_CONFIG_CUSTOMER_TEST_IMG_BUILD
	default 0x80000
	help
	  This points to the offset of the Manufacturing boot image
	  within the full RoT Transfer image. This is used to overwrite
	  the bootrom header with the correct jump offset.

config UBOOT_CONFIG_CUSTOMER_TEST_IMAGE
	string "Test image used for RoT transfer"
	depends on UBOOT_CONFIG_MANUBOOT
	default "customer-test-img.bin"
	help
	  This image points to the location of the customer test image

config UBOOT_CONFIG_FIELD_IMAGE
	string "Field Image (Prodcut) used for RoT transfer"
	depends on UBOOT_CONFIG_MANUBOOT
	default "field-img.bin"
	help
	  This image points to the location of the prodcut field image

config UBOOT_CONFIG_MANUBOOT_OTP_CREDENTIAL_SUPPORT
	bool "Manufacturing Boot Feature Credential Support"
	default n
	depends on UBOOT_CONFIG_CHD_SECURE_BOOT
	depends on UBOOT_CONFIG_MANUBOOT

config UBOOT_CONFIG_MANUBOOT_OTP_CREDENTIAL
	string "Manufacturing Boot Feature Credential(path)"
	default "cred.bin"
	depends on UBOOT_CONFIG_CHD_SECURE_BOOT
	depends on UBOOT_CONFIG_MANUBOOT
	depends on UBOOT_CONFIG_MANUBOOT_OTP_CREDENTIAL_SUPPORT

config UBOOT_CONFIG_MANUBOOT_OTP_KEYBLOB_SUPPORT
	bool "Manufacturing Boot OTP Keyblob Support"
	default n
	depends on UBOOT_CONFIG_CHD_SECURE_BOOT
	depends on UBOOT_CONFIG_MANUBOOT

config UBOOT_CONFIG_MANUBOOT_OTP_KEYBLOB
	string "Manufacturing Boot OTP Keyblob binary(path)"
	default "otp.bin"
	depends on UBOOT_CONFIG_CHD_SECURE_BOOT
	depends on UBOOT_CONFIG_MANUBOOT
	depends on UBOOT_CONFIG_MANUBOOT_OTP_KEYBLOB_SUPPORT

config UBOOT_CONFIG_MANUBOOT_OTP_CERT
	string "Manufacturing Boot OTP Certification(path)"
	default "otp_cert.bin"
	depends on UBOOT_CONFIG_MANUBOOT
	depends on UBOOT_CONFIG_MANUBOOT_OTP_KEYBLOB_SUPPORT

config UBOOT_CONFIG_LGM_SECURE_UART
	bool "Secure UART Access"
	default n
	depends on UBOOT_CONFIG_CHD_SECURE_BOOT

config UBOOT_CONFIG_SB_ENV_PROTECTION
	bool "Secure Boot ENV protection"
	default n
	depends on UBOOT_CONFIG_CHD_SECURE_BOOT

endmenu
```

## maxlinear/feed_uboot/open_uboot/config/arch/xtensa/Kconfig
```kconfig
menu "Xtensa architecture"
	depends on UBOOT_CONFIG_XTENSA

config UBOOT_CONFIG_SYS_ARCH
	string
	default "xtensa"

config UBOOT_CONFIG_SYS_CPU
	string "Xtensa Core Variant"

choice
	prompt "Target select"

config UBOOT_CONFIG_TARGET_XTFPGA
	bool "Support XTFPGA"

endchoice

config UBOOT_CONFIG_SYS_ICACHE_OFF
	bool "Do not enable icache"
	help
	  Do not enable instruction cache in U-Boot.

config UBOOT_CONFIG_SPL_SYS_ICACHE_OFF
	bool "Do not enable icache in SPL"
	depends on UBOOT_CONFIG_SPL
	default UBOOT_CONFIG_SYS_ICACHE_OFF
	help
	  Do not enable instruction cache in SPL.

config UBOOT_CONFIG_SYS_DCACHE_OFF
	bool "Do not enable dcache"
	help
	  Do not enable data cache in U-Boot.

config UBOOT_CONFIG_SPL_SYS_DCACHE_OFF
	bool "Do not enable dcache in SPL"
	depends on UBOOT_CONFIG_SPL
	default UBOOT_CONFIG_SYS_DCACHE_OFF
	help
	  Do not enable data cache in SPL.

source "../../board/cadence/xtfpga/Kconfig"

endmenu
```

## maxlinear/feed_uboot/open_uboot/config/board/AndesTech/adp-ae3xx/Kconfig
```kconfig
if UBOOT_CONFIG_TARGET_ADP_AE3XX

config UBOOT_CONFIG_SYS_CPU
	default "n1213"

config UBOOT_CONFIG_SYS_BOARD
	default "adp-ae3xx"

config UBOOT_CONFIG_SYS_VENDOR
	default "AndesTech"

config UBOOT_CONFIG_SYS_SOC
	default "ae3xx"

config UBOOT_CONFIG_SYS_CONFIG_NAME
	default "adp-ae3xx"

endif
```

## maxlinear/feed_uboot/open_uboot/config/board/BuR/brppt2/Kconfig
```kconfig
if UBOOT_CONFIG_TARGET_BRPPT2

config UBOOT_CONFIG_SYS_BOARD
	default "brppt2"

config UBOOT_CONFIG_SYS_VENDOR
	default "BuR"

config UBOOT_CONFIG_SYS_SOC
	default "mx6"

config UBOOT_CONFIG_SYS_CONFIG_NAME
	default "brppt2"

config UBOOT_CONFIG_SPL_DM_SPI
	def_bool y

endif
```

## maxlinear/feed_uboot/open_uboot/config/board/LaCie/edminiv2/Kconfig
```kconfig
if UBOOT_CONFIG_TARGET_EDMINIV2

config UBOOT_CONFIG_SYS_BOARD
	default "edminiv2"

config UBOOT_CONFIG_SYS_VENDOR
	default "LaCie"

config UBOOT_CONFIG_SYS_CONFIG_NAME
	default "edminiv2"

endif
```
