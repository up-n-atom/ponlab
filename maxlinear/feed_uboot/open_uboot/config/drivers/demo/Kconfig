## maxlinear/feed_uboot/open_uboot/config/drivers/demo/Kconfig
```kconfig
menu "Demo for driver model"

config UBOOT_CONFIG_DM_DEMO
	bool "Enable demo uclass support"
	depends on UBOOT_CONFIG_DM
	help
	  This uclass allows you to play around with driver model. It provides
	  an interface to a couple of demo devices. You can access it using
	  the 'demo' command or by calling the uclass functions from your
	  own code.

config UBOOT_CONFIG_DM_DEMO_SIMPLE
	bool "Enable simple demo device for driver model"
	depends on UBOOT_CONFIG_DM_DEMO
	help
	  This device allows you to play around with driver model. It prints
	  a message when the 'demo hello' command is executed which targets
	  this device. It can be used to help understand how driver model
	  works.

config UBOOT_CONFIG_DM_DEMO_SHAPE
	bool "Enable shape demo device for driver model"
	depends on UBOOT_CONFIG_DM_DEMO
	help
	  This device allows you to play around with driver model. It prints
	  a shape when the 'demo hello' command is executed which targets
	  this device. It can be used to help understand how driver model
	  works.

endmenu
```

## maxlinear/feed_uboot/open_uboot/config/drivers/dma/Kconfig
```kconfig
menu "DMA Support"

config UBOOT_CONFIG_DMA
	bool "Enable Driver Model for DMA drivers"
	depends on UBOOT_CONFIG_DM
	help
	  Enable driver model for DMA. DMA engines can do
	  asynchronous data transfers without involving the host
	  CPU. Currently, this framework can be used to offload
	  memory copies to and from devices like qspi, ethernet
	  etc Drivers provide methods to access the DMA devices
	  buses that is used to transfer data to and from memory.
	  The uclass interface is defined in include/dma.h.

config UBOOT_CONFIG_DMA_CHANNELS
	bool "Enable DMA channels support"
	depends on UBOOT_CONFIG_DMA
	help
	  Enable channels support for DMA. Some DMA controllers have multiple
	  channels which can either transfer data to/from different devices.

config UBOOT_CONFIG_SANDBOX_DMA
	bool "Enable the sandbox DMA test driver"
	depends on UBOOT_CONFIG_DMA && UBOOT_CONFIG_DMA_CHANNELS && UBOOT_CONFIG_SANDBOX
	help
	  Enable support for a test DMA uclass implementation. It stimulates
	  DMA transfer by simple copying data between channels.

config UBOOT_CONFIG_BCM6348_IUDMA
	bool "BCM6348 IUDMA driver"
	depends on UBOOT_CONFIG_ARCH_BMIPS
	select UBOOT_CONFIG_DMA_CHANNELS
	help
	  Enable the BCM6348 IUDMA driver.
	  This driver support data transfer from devices to
	  memory and from memory to devices.

config UBOOT_CONFIG_DMA_LPC32XX
	bool "LPC32XX DMA driver"
	select UBOOT_CONFIG_DMA_LEGACY
	help
	  Enable some legacy DMA code for lpc32xx. It provides some direct
	  functions likes lpc32xx_dma_wait_status() which can be called from
	  other code.

	  This should be converted to use driver model and UCLASS_DMA.

config UBOOT_CONFIG_TI_EDMA3
	bool "TI EDMA3 driver"
	select UBOOT_CONFIG_DMA_LEGACY
	help
	  Enable the TI EDMA3 driver for DRA7xx and AM43xx evms.
	  This driver support data transfer between memory
	  regions.

config UBOOT_CONFIG_TI_KSNAV
	bool "TI Keystone Navigator DMA driver"
	depends on UBOOT_CONFIG_ARCH_KEYSTONE
	default y
	select UBOOT_CONFIG_DMA_LEGACY
	help
	  Enable the Keystone Navigator driver for Keystone 2 platforms.

config UBOOT_CONFIG_APBH_DMA
	bool "Support APBH DMA"
	depends on UBOOT_CONFIG_MX23 || UBOOT_CONFIG_MX28 || UBOOT_CONFIG_MX6 || UBOOT_CONFIG_MX7 || UBOOT_CONFIG_IMX8 || UBOOT_CONFIG_IMX8M
	select UBOOT_CONFIG_DMA_LEGACY
	help
	  Enable APBH DMA driver.


if UBOOT_CONFIG_APBH_DMA
config UBOOT_CONFIG_APBH_DMA_BURST
	bool "Enable DMA BURST"

config UBOOT_CONFIG_APBH_DMA_BURST8
	bool "Enable DMA BURST8"

endif

config UBOOT_CONFIG_DMA_LEGACY
	bool "Legacy DMA support"
	default y if UBOOT_CONFIG_FSLDMAFEC
	help
	  Enable legacy DMA support. This does not use driver model and should
	  be migrated to the new API.

	  It is required for some PowerPC boards.

source "ti/Kconfig"

endmenu # menu "DMA Support"
```

## maxlinear/feed_uboot/open_uboot/config/drivers/dma/ti/Kconfig
```kconfig
# SPDX-License-Identifier: GPL-2.0+

if UBOOT_CONFIG_ARCH_K3

config UBOOT_CONFIG_TI_K3_NAVSS_UDMA
        bool "Texas Instruments UDMA"
        depends on UBOOT_CONFIG_ARCH_K3
        select UBOOT_CONFIG_DMA
        select UBOOT_CONFIG_TI_K3_NAVSS_RINGACC
        select UBOOT_CONFIG_TI_K3_NAVSS_PSILCFG
        select UBOOT_CONFIG_TI_K3_PSIL
        help
          Support for UDMA used in K3 devices.
endif

config UBOOT_CONFIG_TI_K3_PSIL
	bool
```

## maxlinear/feed_uboot/open_uboot/config/drivers/fastboot/Kconfig
```kconfig
menu "Fastboot support"

config UBOOT_CONFIG_FASTBOOT
	bool
	imply ANDROID_BOOT_IMAGE
	imply CMD_FASTBOOT

config UBOOT_CONFIG_USB_FUNCTION_FASTBOOT
	bool "Enable USB fastboot gadget"
	depends on UBOOT_CONFIG_USB_GADGET
	default y if UBOOT_CONFIG_ARCH_SUNXI && UBOOT_CONFIG_USB_MUSB_GADGET
	select UBOOT_CONFIG_FASTBOOT
	select UBOOT_CONFIG_USB_GADGET_DOWNLOAD
	help
	  This enables the USB part of the fastboot gadget.

config UBOOT_CONFIG_UDP_FUNCTION_FASTBOOT
	depends on UBOOT_CONFIG_NET
	select UBOOT_CONFIG_FASTBOOT
	bool "Enable fastboot protocol over UDP"
	help
	  This enables the fastboot protocol over UDP.

if UBOOT_CONFIG_FASTBOOT

config UBOOT_CONFIG_FASTBOOT_BUF_ADDR
	hex "Define FASTBOOT buffer address"
	default 0x82000000 if UBOOT_CONFIG_MX6SX || UBOOT_CONFIG_MX6SL || UBOOT_CONFIG_MX6UL || UBOOT_CONFIG_MX6SLL
	default 0x81000000 if UBOOT_CONFIG_ARCH_OMAP2PLUS
	default 0x42000000 if UBOOT_CONFIG_ARCH_SUNXI && !UBOOT_CONFIG_MACH_SUN9I
	default 0x22000000 if UBOOT_CONFIG_ARCH_SUNXI && UBOOT_CONFIG_MACH_SUN9I
	default 0x60800800 if UBOOT_CONFIG_ROCKCHIP_RK3036 || UBOOT_CONFIG_ROCKCHIP_RK3188 || \
				ROCKCHIP_RK322X
	default 0x800800 if UBOOT_CONFIG_ROCKCHIP_RK3288 || UBOOT_CONFIG_ROCKCHIP_RK3329 || \
				ROCKCHIP_RK3399
	default 0x280000 if UBOOT_CONFIG_ROCKCHIP_RK3368
	default 0x100000 if UBOOT_CONFIG_ARCH_ZYNQMP
	default 0 if UBOOT_CONFIG_SANDBOX
	help
	  The fastboot protocol requires a large memory buffer for
	  downloads. Define this to the starting RAM address to use for
	  downloaded images.

config UBOOT_CONFIG_FASTBOOT_BUF_SIZE
	hex "Define FASTBOOT buffer size"
	default 0x8000000 if UBOOT_CONFIG_ARCH_ROCKCHIP
	default 0x6000000 if UBOOT_CONFIG_ARCH_ZYNQMP
	default 0x2000000 if UBOOT_CONFIG_ARCH_SUNXI
	default 0x8192 if UBOOT_CONFIG_SANDBOX
	default 0x7000000
	help
	  The fastboot protocol requires a large memory buffer for
	  downloads. This buffer should be as large as possible for a
	  platform. Define this to the size available RAM for fastboot.

config UBOOT_CONFIG_FASTBOOT_USB_DEV
	int "USB controller number"
	depends on UBOOT_CONFIG_USB_FUNCTION_FASTBOOT
	default 0
	help
	  Some boards have USB OTG controller other than 0. Define this
	  option so it can be used in compiled environment (e.g. in
	  CONFIG_BOOTCOMMAND).

config UBOOT_CONFIG_FASTBOOT_FLASH
	bool "Enable FASTBOOT FLASH command"
	default y if UBOOT_CONFIG_ARCH_SUNXI || UBOOT_CONFIG_ARCH_ROCKCHIP
	depends on UBOOT_CONFIG_MMC || (MTD_RAW_NAND && UBOOT_CONFIG_CMD_MTDPARTS)
	select UBOOT_CONFIG_IMAGE_SPARSE
	help
	  The fastboot protocol includes a "flash" command for writing
	  the downloaded image to a non-volatile storage device. Define
	  this to enable the "fastboot flash" command.

config UBOOT_CONFIG_FASTBOOT_UUU_SUPPORT
	bool "Enable FASTBOOT i.MX UUU special command"
	help
	  The fastboot protocol includes "UCmd" and "ACmd" command.
	  Be aware that you provide full access to any U-Boot command,
	  including working with memory and may open a huge backdoor,
	  when enabling this option.

choice
	prompt "Flash provider for FASTBOOT"
	depends on UBOOT_CONFIG_FASTBOOT_FLASH

config UBOOT_CONFIG_FASTBOOT_FLASH_MMC
	bool "FASTBOOT on MMC"
	depends on UBOOT_CONFIG_MMC

config UBOOT_CONFIG_FASTBOOT_FLASH_NAND
	bool "FASTBOOT on NAND"
	depends on UBOOT_CONFIG_MTD_RAW_NAND && UBOOT_CONFIG_CMD_MTDPARTS

endchoice

config UBOOT_CONFIG_FASTBOOT_FLASH_MMC_DEV
	int "Define FASTBOOT MMC FLASH default device"
	depends on UBOOT_CONFIG_FASTBOOT_FLASH_MMC
	default 0 if UBOOT_CONFIG_ARCH_ROCKCHIP
	default 0 if UBOOT_CONFIG_ARCH_SUNXI && UBOOT_CONFIG_MMC_SUNXI_SLOT_EXTRA = -1
	default 1 if UBOOT_CONFIG_ARCH_SUNXI && UBOOT_CONFIG_MMC_SUNXI_SLOT_EXTRA != -1
	help
	  The fastboot "flash" command requires additional information
	  regarding the non-volatile storage device. Define this to
	  the eMMC device that fastboot should use to store the image.

config UBOOT_CONFIG_FASTBOOT_FLASH_NAND_TRIMFFS
	bool "Skip empty pages when flashing NAND"
	depends on UBOOT_CONFIG_FASTBOOT_FLASH_NAND
	help
	  When flashing NAND enable the DROP_FFS flag to drop trailing all-0xff
	  pages.

config UBOOT_CONFIG_FASTBOOT_MMC_BOOT_SUPPORT
	bool "Enable EMMC_BOOT flash/erase"
	depends on UBOOT_CONFIG_FASTBOOT_FLASH_MMC
	help
	  The fastboot "flash" and "erase" commands normally does operations
	  on eMMC userdata. Define this to enable the special commands to
	  flash/erase eMMC boot partition.
	  The default target name for updating eMMC boot partition 1/2 is
	  CONFIG_FASTBOOT_MMC_BOOT1_NAME/CONFIG_FASTBOOT_MMC_BOOT2_NAME.

config UBOOT_CONFIG_FASTBOOT_MMC_BOOT1_NAME
	string "Target name for updating EMMC_BOOT1"
	depends on UBOOT_CONFIG_FASTBOOT_MMC_BOOT_SUPPORT
	default "mmc0boot0"
	help
	  The fastboot "flash" and "erase" commands support operations on
	  EMMC_BOOT1. This occurs when the specified "EMMC_BOOT1 name" on
	  the "fastboot flash" and "fastboot erase" commands match the value
	  defined here.
	  The default target name for updating EMMC_BOOT1 is "mmc0boot0".

config UBOOT_CONFIG_FASTBOOT_MMC_BOOT2_NAME
	string "Target name for updating EMMC_BOOT2"
	depends on UBOOT_CONFIG_FASTBOOT_MMC_BOOT_SUPPORT
	default "mmc0boot1"
	help
	  The fastboot "flash" and "erase" commands support operations on
	  EMMC_BOOT2. This occurs when the specified "EMMC_BOOT2 name" on
	  the "fastboot flash" and "fastboot erase" commands match the value
	  defined here.
	  The default target name for updating EMMC_BOOT2 is "mmc0boot1".

config UBOOT_CONFIG_FASTBOOT_MMC_USER_SUPPORT
	bool "Enable eMMC userdata partition flash/erase"
	depends on UBOOT_CONFIG_FASTBOOT_FLASH_MMC
	help
	  Define this to enable the support "flash" and "erase" command on
	  eMMC userdata. The "flash" command only update the MBR and GPT
	  header when CONFIG_EFI_PARTITION is supported.
	  The "erase" command erase all the userdata.
	  This occurs when the specified "partition name" on the
	  fastboot command line matches the value CONFIG_FASTBOOT_MMC_USER_NAME.

config UBOOT_CONFIG_FASTBOOT_MMC_USER_NAME
	string "Target name for updating EMMC_USER"
	depends on UBOOT_CONFIG_FASTBOOT_MMC_USER_SUPPORT
	default "mmc0"
	help
	  The fastboot "flash" and "erase" command supports EMMC_USER.
	  This occurs when the specified "EMMC_USER name" on the
	  "fastboot flash" and the "fastboot erase" commands match the value
	  defined here.
	  The default target name for erasing EMMC_USER is "mmc0".

config UBOOT_CONFIG_FASTBOOT_GPT_NAME
	string "Target name for updating GPT"
	depends on UBOOT_CONFIG_FASTBOOT_FLASH_MMC && UBOOT_CONFIG_EFI_PARTITION
	default "gpt"
	help
	  The fastboot "flash" command supports writing the downloaded
	  image to the Protective MBR and the Primary GUID Partition
	  Table. (Additionally, this downloaded image is post-processed
	  to generate and write the Backup GUID Partition Table.)
	  This occurs when the specified "partition name" on the
	  "fastboot flash" command line matches the value defined here.
	  The default target name for updating GPT is "gpt".

config UBOOT_CONFIG_FASTBOOT_MBR_NAME
	string "Target name for updating MBR"
	depends on UBOOT_CONFIG_FASTBOOT_FLASH_MMC && UBOOT_CONFIG_DOS_PARTITION
	default "mbr"
	help
	  The fastboot "flash" command allows to write the downloaded image
	  to the Master Boot Record. This occurs when the "partition name"
	  specified on the "fastboot flash" command line matches the value
	  defined here. The default target name for updating MBR is "mbr".

config UBOOT_CONFIG_FASTBOOT_CMD_OEM_FORMAT
	bool "Enable the 'oem format' command"
	depends on UBOOT_CONFIG_FASTBOOT_FLASH_MMC && UBOOT_CONFIG_CMD_GPT
	help
	  Add support for the "oem format" command from a client. This
	  relies on the env variable partitions to contain the list of
	  partitions as required by the gpt command.

config UBOOT_CONFIG_FASTBOOT_CMD_OEM_PARTCONF
	bool "Enable the 'oem partconf' command"
	depends on UBOOT_CONFIG_FASTBOOT_FLASH_MMC && UBOOT_CONFIG_SUPPORT_EMMC_BOOT
	help
	  Add support for the "oem partconf" command from a client. This set
	  the mmc boot-partition for the selecting eMMC device.

config UBOOT_CONFIG_FASTBOOT_CMD_OEM_BOOTBUS
	bool "Enable the 'oem bootbus' command"
	depends on UBOOT_CONFIG_FASTBOOT_FLASH_MMC && UBOOT_CONFIG_SUPPORT_EMMC_BOOT
	help
	  Add support for the "oem bootbus" command from a client. This set
	  the mmc boot configuration for the selecting eMMC device.

endif # FASTBOOT

endmenu
```

## maxlinear/feed_uboot/open_uboot/config/drivers/firmware/Kconfig
```kconfig
config UBOOT_CONFIG_FIRMWARE
	bool "Enable Firmware driver support"

config UBOOT_CONFIG_SPL_FIRMWARE
	bool "Enable Firmware driver support in SPL"
	depends on UBOOT_CONFIG_FIRMWARE

config UBOOT_CONFIG_SPL_ARM_PSCI_FW
	bool
	select UBOOT_CONFIG_SPL_FIRMWARE

config UBOOT_CONFIG_ARM_PSCI_FW
	bool
	select UBOOT_CONFIG_FIRMWARE

config UBOOT_CONFIG_TI_SCI_PROTOCOL
	tristate "TI System Control Interface (TISCI) Message Protocol"
	depends on UBOOT_CONFIG_K3_SEC_PROXY
	select UBOOT_CONFIG_FIRMWARE
	select UBOOT_CONFIG_SPL_FIRMWARE if SPL
	help
	  TI System Control Interface (TISCI) Message Protocol is used to manage
	  compute systems such as ARM, DSP etc with the system controller in
	  complex System on Chip (SoC) such as those found on certain K3
	  generation SoC from TI.

	  This protocol library is used by client drivers to use the features
	  provided by the system controller.

config UBOOT_CONFIG_ZYNQMP_FIRMWARE
	bool "ZynqMP Firmware interface"
	select UBOOT_CONFIG_FIRMWARE
	help
	  Firmware interface driver is used by different
	  drivers to communicate with the firmware for
	  various platform management services.
	  Say yes to enable ZynqMP firmware interface driver.
	  If in doubt, say N.

source "scmi/Kconfig"
```

## maxlinear/feed_uboot/open_uboot/config/drivers/firmware/scmi/Kconfig
```kconfig
config UBOOT_CONFIG_SCMI_FIRMWARE
	bool "Enable SCMI support"
	select UBOOT_CONFIG_FIRMWARE
	select UBOOT_CONFIG_OF_TRANSLATE
	depends on UBOOT_CONFIG_SANDBOX || UBOOT_CONFIG_DM_MAILBOX || UBOOT_CONFIG_ARM_SMCCC
	help
	  System Control and Management Interface (SCMI) is a communication
	  protocol that defines standard interfaces for power, performance
	  and system management. The SCMI specification is available at
	  https://developer.arm.com/architectures/system-architectures/software-standards/scmi

	  An SCMI agent communicates with a related SCMI server firmware
	  located in another sub-system, as a companion micro controller
	  or a companion host in the CPU system.

	  Communications between agent (client) and the SCMI server are
	  based on message exchange. Messages can be exchange over tranport
	  channels as a mailbox device or an Arm SMCCC service with some
	  piece of identified shared memory.
```
