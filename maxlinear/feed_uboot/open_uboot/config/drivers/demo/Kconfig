## maxlinear/feed_uboot/open_uboot/config/drivers/fpga/Kconfig
```kconfig
menu "FPGA support"

config UBOOT_CONFIG_FPGA
	bool

config UBOOT_CONFIG_FPGA_ALTERA
	bool "Enable Altera FPGA drivers"
	select UBOOT_CONFIG_FPGA
	help
	  Say Y here to enable the Altera FPGA driver

	  This provides basic infrastructure to support Altera FPGA devices.
	  Enable Altera FPGA specific functions which includes bitstream
	  (in BIT format), fpga and device validation.

config UBOOT_CONFIG_FPGA_SOCFPGA
	bool "Enable Gen5 and Arria10 common FPGA drivers"
	select UBOOT_CONFIG_FPGA_ALTERA
	help
	  Say Y here to enable the Gen5 and Arria10 common FPGA driver

	  This provides common functionality for Gen5 and Arria10 devices.

config UBOOT_CONFIG_FPGA_CYCLON2
	bool "Enable Altera FPGA driver for Cyclone II"
	depends on UBOOT_CONFIG_FPGA_ALTERA
	help
	  Say Y here to enable the Altera Cyclone II FPGA specific driver

	  This provides common functionality for Altera Cyclone II devices.
	  Enable FPGA driver for loading bitstream in BIT and BIN format
	  on Altera Cyclone II device.

config UBOOT_CONFIG_FPGA_INTEL_SDM_MAILBOX
	bool "Enable Intel FPGA Full Reconfiguration SDM Mailbox driver"
	depends on UBOOT_CONFIG_TARGET_SOCFPGA_SOC64
	select UBOOT_CONFIG_FPGA_ALTERA
	help
	  Say Y here to enable the Intel FPGA Full Reconfig SDM Mailbox driver

	  This provides common functionality for Intel FPGA devices.
	  Enable FPGA driver for writing full bitstream into Intel FPGA
	  devices through SDM (Secure Device Manager) Mailbox.

config UBOOT_CONFIG_FPGA_XILINX
	bool "Enable Xilinx FPGA drivers"
	select UBOOT_CONFIG_FPGA
	help
	  Enable Xilinx FPGA specific functions which includes bitstream
	  (in BIT format), fpga and device validation.

config UBOOT_CONFIG_FPGA_ZYNQMPPL
	bool "Enable Xilinx FPGA driver for ZynqMP"
	depends on UBOOT_CONFIG_FPGA_XILINX
	help
	  Enable FPGA driver for loading bitstream in BIT and BIN format
	  on Xilinx Zynq UltraScale+ (ZynqMP) device.

config UBOOT_CONFIG_FPGA_VERSALPL
	bool "Enable Xilinx FPGA driver for Versal"
	depends on UBOOT_CONFIG_FPGA_XILINX
	help
	  Enable FPGA driver for loading bitstream in PDI format on Xilinx
	  Versal device. PDI is a new programmable device image format for
	  Versal. The bitstream will only be generated as PDI for Versal
	  platform.

config UBOOT_CONFIG_FPGA_SPARTAN3
	bool "Enable Spartan3 FPGA driver"
	depends on UBOOT_CONFIG_FPGA_XILINX
	help
	  Enable Spartan3 FPGA driver for loading in BIT format.

config UBOOT_CONFIG_FPGA_VIRTEX2
	bool "Enable Xilinx Virtex-II and later FPGA driver"
	depends on UBOOT_CONFIG_FPGA_XILINX
	help
	  Enable Virtex-II FPGA driver for loading in BIT format. This driver
	  also supports many newer Xilinx FPGA families.

config UBOOT_CONFIG_FPGA_ZYNQPL
	bool "Enable Xilinx FPGA for Zynq"
	depends on UBOOT_CONFIG_ARCH_ZYNQ
	help
	  Enable FPGA driver for loading bitstream in BIT and BIN format
	  on Xilinx Zynq devices.

endmenu
```

## maxlinear/feed_uboot/open_uboot/config/drivers/input/Kconfig
```kconfig
config UBOOT_CONFIG_INPUT
	bool "Enable input subsystem"
	depends on UBOOT_CONFIG_DM
	default y

config UBOOT_CONFIG_SPL_INPUT
	bool "Enable input subsystem for SPL"
	depends on UBOOT_CONFIG_SPL_DM

config UBOOT_CONFIG_TPL_INPUT
	bool "Enable input subsystem for TPL"
	depends on UBOOT_CONFIG_TPL_DM

config UBOOT_CONFIG_DM_KEYBOARD
	bool "Enable driver model keyboard support"
	depends on UBOOT_CONFIG_DM
	help
	  This adds a uclass for keyboards and implements keyboard support
	  using driver model. The API is implemented by keyboard.h and
	  includes methods to start/stop the device, check for available
	  input and update LEDs if the keyboard has them.

config UBOOT_CONFIG_SPL_DM_KEYBOARD
	bool "Enable driver model keyboard support for SPL"
	depends on UBOOT_CONFIG_SPL_DM
	help
	  This adds a uclass for keyboards and implements keyboard support
	  using driver model. The API is implemented by keyboard.h and
	  includes methods to start/stop the device, check for available
	  input and update LEDs if the keyboard has them.

config UBOOT_CONFIG_TPL_DM_KEYBOARD
	bool "Enable driver model keyboard support for TPL"
	depends on UBOOT_CONFIG_TPL_DM
	help
	  This adds a uclass for keyboards and implements keyboard support
	  using driver model. The API is implemented by keyboard.h and
	  includes methods to start/stop the device, check for available
	  input and update LEDs if the keyboard has them.

config UBOOT_CONFIG_CROS_EC_KEYB
	bool "Enable Chrome OS EC keyboard support"
	depends on UBOOT_CONFIG_INPUT
	help
	  Most ARM Chromebooks use an EC to provide access to the keyboard.
	  Messages are used to request key scans from the EC and these are
	  then decoded into keys by this driver.

config UBOOT_CONFIG_SPL_CROS_EC_KEYB
	bool "Enable Chrome OS EC keyboard support in SPL"
	depends on UBOOT_CONFIG_SPL_INPUT
	help
	  Most ARM Chromebooks use an EC to provide access to the keyboard.
	  Messages are used to request key scans from the EC and these are
	  then decoded into keys by this driver.

config UBOOT_CONFIG_TPL_CROS_EC_KEYB
	bool "Enable Chrome OS EC keyboard support in TPL"
	depends on UBOOT_CONFIG_TPL_INPUT
	help
	  Most ARM Chromebooks use an EC to provide access to the keyboard.
	  Messages are used to request key scans from the EC and these are
	  then decoded into keys by this driver.

config UBOOT_CONFIG_I8042_KEYB
	bool "Enable Intel i8042 keyboard support"
	depends on UBOOT_CONFIG_DM_KEYBOARD
	default UBOOT_CONFIG_X86
	help
	  This adds a driver for the i8042 keyboard controller, allowing the
	  keyboard to be used on devices which support this controller. The
	  driver handles English and German keyboards - set the environment
	  variable 'keymap' to "de" to select German. Keyboard repeat is
	  handled by the keyboard itself.

config UBOOT_CONFIG_TEGRA_KEYBOARD
	bool "NVIDIA Tegra internal matrix keyboard controller support"
	help
	  A matrix keyboard connected directly to the internal keyboard
	  controller on Tegra SoCs.

config UBOOT_CONFIG_TWL4030_INPUT
	bool "Enable TWL4030 Input controller"
	help
	  Enable TWL4030 Input controller
```
