## maxlinear/feed_uboot/open_uboot/config/drivers/mtd/Kconfig
```kconfig
menu "MTD Support"

config UBOOT_CONFIG_MTD_PARTITIONS
	bool

config UBOOT_CONFIG_MTD
	bool "Enable MTD layer"
	help
	  Enable the MTD stack, necessary to interact with NAND, NOR,
	  SPI-NOR, SPI-NAND, OneNAND, etc.

config UBOOT_CONFIG_DM_MTD
	bool "Enable Driver Model for MTD drivers"
	depends on UBOOT_CONFIG_DM
	help
	  Enable driver model for Memory Technology Devices (MTD), such as
	  flash, RAM and similar chips, often used for solid state file
	  systems on embedded devices.

config UBOOT_CONFIG_MTD_NOR_FLASH
	bool "Enable parallel NOR flash support"
	help
	  Enable support for parallel NOR flash.

config UBOOT_CONFIG_SYS_MTDPARTS_RUNTIME
	bool "Allow MTDPARTS to be configured at runtime"
	depends on UBOOT_CONFIG_MTD
	help
	  This option allows to call the function board_mtdparts_default to
	  dynamically build the variables mtdids and mtdparts at runtime.

config UBOOT_CONFIG_FLASH_CFI_DRIVER
	bool "Enable CFI Flash driver"
	help
	  The Common Flash Interface specification was developed by Intel,
	  AMD and other flash manufactures. It provides a universal method
	  for probing the capabilities of flash devices. If you wish to
	  support any device that is CFI-compliant, you need to enable this
	  option. Visit <http://www.amd.com/products/nvd/overview/cfi.html>
	  for more information on CFI.

config UBOOT_CONFIG_CFI_FLASH
	bool "Enable Driver Model for CFI Flash driver"
	depends on UBOOT_CONFIG_DM_MTD
	select UBOOT_CONFIG_FLASH_CFI_DRIVER
	help
	  The Common Flash Interface specification was developed by Intel,
	  AMD and other flash manufactures. It provides a universal method
	  for probing the capabilities of flash devices. If you wish to
	  support any device that is CFI-compliant, you need to enable this
	  option. Visit <http://www.amd.com/products/nvd/overview/cfi.html>
	  for more information on CFI.

config UBOOT_CONFIG_SYS_FLASH_USE_BUFFER_WRITE
	bool "Enable buffered writes to flash"
	depends on UBOOT_CONFIG_FLASH_CFI_DRIVER
	help
	  Use buffered writes to flash.

config UBOOT_CONFIG_FLASH_CFI_MTD
	bool "Enable CFI MTD driver"
	depends on UBOOT_CONFIG_FLASH_CFI_DRIVER
	help
	  This option enables the building of the cfi_mtd driver
	  in the drivers directory. The driver exports CFI flash
	  to the MTD layer.

config UBOOT_CONFIG_SYS_FLASH_PROTECTION
	bool "Use hardware flash protection"
	depends on UBOOT_CONFIG_FLASH_CFI_DRIVER
	help
	  If defined, hardware flash sectors protection is used
	  instead of U-Boot software protection.

config UBOOT_CONFIG_SYS_FLASH_CFI
	bool "Define extra elements in CFI for flash geometry"
	depends on UBOOT_CONFIG_FLASH_CFI_DRIVER
	help
	  Define if the flash driver uses extra elements in the
	  common flash structure for storing flash geometry.

config UBOOT_CONFIG_ALTERA_QSPI
	bool "Altera Generic Quad SPI Controller"
	depends on UBOOT_CONFIG_DM_MTD
	help
	  This enables access to Altera EPCQ/EPCS flash chips using the
	  Altera Generic Quad SPI Controller. The controller converts SPI
	  NOR flash to parallel flash interface. Please find details on the
	  "Embedded Peripherals IP User Guide" of Altera.

config UBOOT_CONFIG_FLASH_PIC32
	bool "Microchip PIC32 Flash driver"
	depends on UBOOT_CONFIG_MACH_PIC32 && UBOOT_CONFIG_DM_MTD
	help
	  This enables access to Microchip PIC32 internal non-CFI flash
	  chips through PIC32 Non-Volatile-Memory Controller.

config UBOOT_CONFIG_RENESAS_RPC_HF
	bool "Renesas RCar Gen3 RPC HyperFlash driver"
	depends on UBOOT_CONFIG_RCAR_GEN3 && UBOOT_CONFIG_DM_MTD
	help
	  This enables access to HyperFlash memory through the Renesas
	  RCar Gen3 RPC controller.

config UBOOT_CONFIG_HBMC_AM654
	bool "HyperBus controller driver for AM65x SoC"
	depends on UBOOT_CONFIG_SYSCON
	help
	 This is the driver for HyperBus controller on TI's AM65x and
	 other SoCs

config UBOOT_CONFIG_STM32_FLASH
	bool "STM32 MCU Flash driver"
	depends on UBOOT_CONFIG_ARCH_STM32
	help
	 This is the driver of embedded flash for some STMicroelectronics
	 STM32 MCU.

source "nand/Kconfig"

config UBOOT_CONFIG_SYS_NAND_MAX_CHIPS
	int "NAND max chips"
	depends on UBOOT_CONFIG_MTD_RAW_NAND || UBOOT_CONFIG_CMD_ONENAND || UBOOT_CONFIG_TARGET_S5PC210_UNIVERSAL || \
		SPL_OMAP3_ID_NAND || UBOOT_CONFIG_MTD_SPI_NAND
	default 1
	help
	  The maximum number of NAND chips per device to be supported.

source "spi/Kconfig"

source "ubi/Kconfig"

endmenu
```

## maxlinear/feed_uboot/open_uboot/config/drivers/mtd/nand/Kconfig
```kconfig
config UBOOT_CONFIG_MTD_NAND_CORE
	tristate

source "raw/Kconfig"

source "spi/Kconfig"
```

## maxlinear/feed_uboot/open_uboot/config/drivers/mtd/nand/spi/Kconfig
```kconfig
menuconfig UBOOT_CONFIG_MTD_SPI_NAND
	bool "SPI NAND device Support"
	depends on UBOOT_CONFIG_DM_MTD && UBOOT_CONFIG_DM_SPI
	select UBOOT_CONFIG_MTD_NAND_CORE
	select UBOOT_CONFIG_SPI_MEM
	help
	  This is the framework for the SPI NAND device drivers.

config UBOOT_CONFIG_MXL_SPI_NAND
	bool "MXL Serial (SPI/QSPI) NAND driver"
	select UBOOT_CONFIG_MXL_QSPI
	help
	  Enable MXL SPI NAND flash platforms.

config UBOOT_CONFIG_QSPI_QUAD_MODE
	depends on UBOOT_CONFIG_MXL_SPI_NAND
	bool "Use QSPI controller in QUAD I/O mode"
	default n
	help
	  Force the controller to use QUAD IO instead of
	  Single IO (must be supported by the flash)

config UBOOT_CONFIG_SYS_NAND_BLOCK_SIZE
	hex "NAND chip eraseblock size"
	depends on UBOOT_CONFIG_MXL_SPI_NAND
	help
	  Number of data bytes in one eraseblock for the NAND chip on the
	  board. This is the multiple of NAND_PAGE_SIZE and the number of
	  pages.

config UBOOT_CONFIG_SYS_NAND_PAGE_SIZE
	hex "NAND chip page size"
	depends on UBOOT_CONFIG_MXL_SPI_NAND
	help
	  Number of data bytes in one page for the NAND chip on the
	  board, not including the OOB area.

config UBOOT_CONFIG_RAW_NAND_OOB_COMPATIBLE
	bool "OOB layout compatible with RAW NAND flash"
	help
	  This allows the SPI NAND to use the same OOB layout
	  as the RAW flash, without hiding the first bytes of the
	  OOB area.
```

## maxlinear/feed_uboot/open_uboot/config/drivers/mux/Kconfig
```kconfig
menu "Multiplexer drivers"

config UBOOT_CONFIG_MULTIPLEXER
	bool "Multiplexer Support"
	depends on UBOOT_CONFIG_DM
	help
	 The mux framework is a minimalistic subsystem that handles multiplexer
	 controllers. It provides the same API as Linux and mux drivers should
	 be portable with a minimum effort.

if UBOOT_CONFIG_MULTIPLEXER

config UBOOT_CONFIG_MUX_MMIO
	bool "MMIO register bitfield-controlled Multiplexer"
	depends on UBOOT_CONFIG_MULTIPLEXER && UBOOT_CONFIG_SYSCON
	help
	  MMIO register bitfield-controlled Multiplexer controller.

	  The driver builds multiplexer controllers for bitfields in a syscon
	  register. For N bit wide bitfields, there will be 2^N possible
	  multiplexer states.

endif

endmenu
```

## maxlinear/feed_uboot/open_uboot/config/drivers/net/fsl-mc/Kconfig
```kconfig
#
# NXP Management Complex
#

menuconfig UBOOT_CONFIG_FSL_MC_ENET
	bool "NXP Management Complex"
	depends on UBOOT_CONFIG_ARCH_LS2080A || UBOOT_CONFIG_ARCH_LS1088A || UBOOT_CONFIG_ARCH_LX2160A || UBOOT_CONFIG_ARCH_LX2162A
	default y
	select UBOOT_CONFIG_RESV_RAM
	help
	  Enable Management Complex (MC) network
	  This is NXP Management Complex menuconfig
	  that contains all MC related config options

if UBOOT_CONFIG_FSL_MC_ENET

config UBOOT_CONFIG_SYS_MC_RSV_MEM_ALIGN
	hex "Management Complex reserved memory alignment"
	depends on UBOOT_CONFIG_RESV_RAM
	default 0x20000000 if UBOOT_CONFIG_ARCH_LS2080A || UBOOT_CONFIG_ARCH_LS1088A || UBOOT_CONFIG_ARCH_LX2160A || UBOOT_CONFIG_ARCH_LX2162A
	help
	  Reserved memory needs to be aligned for MC to use. Default value
	  is 512MB.

config UBOOT_CONFIG_MC_DRAM_SPB_OFFSET
	hex "Soft Parser SPB DRAM offset"
	default 0x00F40000
	help
	  Set the DRAM offset for Soft Parser Blob.

config UBOOT_CONFIG_MC_SPB_MAX_SIZE
	hex "Soft Parser SPB maximum size"
	default 0x00020000
	help
	  Set the maximum size for Soft Parser Blob.

endif # FSL_MC_ENET
```

## maxlinear/feed_uboot/open_uboot/config/drivers/net/pfe_eth/Kconfig
```kconfig
menuconfig UBOOT_CONFIG_FSL_PFE
	bool "NXP PFE Ethernet driver"
	help
	  This driver provides support for NXP's Packet Forwarding Engine.

if UBOOT_CONFIG_FSL_PFE

config UBOOT_CONFIG_SYS_FSL_PFE_ADDR
	hex "PFE base address"
	default 0x04000000

endif
```

## maxlinear/feed_uboot/open_uboot/config/drivers/net/qe/Kconfig
```kconfig
# SPDX-License-Identifier: GPL-2.0+
#
# Copyright (C) 2020 Heiko Schocher <hs@denx.de>

config UBOOT_CONFIG_QE_UEC
	bool "NXP QE UEC Ethernet controller"
	depends on UBOOT_CONFIG_DM_ETH
	help
	  This driver supports the NXP QE UEC ethernet controller
```
