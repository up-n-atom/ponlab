## maxlinear/feed_uboot/open_uboot/config/drivers/led/Kconfig
```kconfig
menu "LED Support"

config UBOOT_CONFIG_LED
	bool "Enable LED support"
	depends on UBOOT_CONFIG_DM
	help
	  Many boards have LEDs which can be used to signal status or alerts.
	  U-Boot provides a uclass API to implement this feature. LED drivers
	  can provide access to board-specific LEDs. Use of the device tree
	  for configuration is encouraged.

config UBOOT_CONFIG_LED_BCM6328
	bool "LED Support for BCM6328"
	depends on UBOOT_CONFIG_LED && UBOOT_CONFIG_ARCH_BMIPS
	help
	  This option enables support for LEDs connected to the BCM6328
	  LED HW controller accessed via MMIO registers.
	  HW blinking is supported and up to 24 LEDs can be controlled.
	  All LEDs can blink at the same time but the delay is shared, which
	  means that if one LED is set to blink at 100ms and then a different
	  LED is set to blink at 200ms, both will blink at 200ms.

config UBOOT_CONFIG_LED_BCM6358
	bool "LED Support for BCM6358"
	depends on UBOOT_CONFIG_LED && UBOOT_CONFIG_ARCH_BMIPS
	help
	  This option enables support for LEDs connected to the BCM6358
	  LED HW controller accessed via MMIO registers.
	  HW has no blinking capabilities and up to 32 LEDs can be controlled.

config UBOOT_CONFIG_LED_BCM6858
	bool "LED Support for BCM6858"
	depends on UBOOT_CONFIG_LED && (ARCH_BCM68360 || UBOOT_CONFIG_ARCH_BCM6858 || UBOOT_CONFIG_ARCH_BCM63158)
	help
	  This option enables support for LEDs connected to the BCM6858
	  HW has blinking capabilities and up to 32 LEDs can be controlled.

config UBOOT_CONFIG_LED_CORTINA
	bool "LED Support for Cortina Access CAxxxx SoCs"
	depends on UBOOT_CONFIG_LED && (CORTINA_PLATFORM)
	help
	  This option enables support for LEDs connected to the Cortina
	  Access CAxxxx SOCs.


config UBOOT_CONFIG_LED_BLINK
	bool "Support LED blinking"
	depends on UBOOT_CONFIG_LED
	help
	  Some drivers can support automatic blinking of LEDs with a given
	  period, without needing timers or extra code to handle the timing.
	  This option enables support for this which adds slightly to the
	  code size.

config UBOOT_CONFIG_SPL_LED
	bool "Enable LED support in SPL"
	depends on UBOOT_CONFIG_SPL && UBOOT_CONFIG_SPL_DM
	help
	  The LED subsystem adds a small amount of overhead to the image.
	  If this is acceptable and you have a need to use LEDs in SPL,
	  enable this option. You will need to enable device tree in SPL
	  for this to work.

config UBOOT_CONFIG_LED_GPIO
	bool "LED support for GPIO-connected LEDs"
	depends on UBOOT_CONFIG_LED && UBOOT_CONFIG_DM_GPIO
	help
	  Enable support for LEDs which are connected to GPIO lines. These
	  GPIOs may be on the SoC or some other device which provides GPIOs.
	  The GPIO driver must used driver model. LEDs are configured using
	  the device tree.

config UBOOT_CONFIG_SPL_LED_GPIO
	bool "LED support for GPIO-connected LEDs in SPL"
        depends on UBOOT_CONFIG_SPL_LED && UBOOT_CONFIG_DM_GPIO
	help
	  This option is an SPL-variant of the LED_GPIO option.
	  See the help of LED_GPIO for details.

config UBOOT_CONFIG_LED_LGM_SSO
	bool "Enable LED driver for Lightning mountain using SSO interface"
	depends on UBOOT_CONFIG_LIGHTNING_MOUNTAIN_SOC
	help
	  This driver uses the SSO interface to operate on the LED
	  functionalities.

config UBOOT_CONFIG_LGM_SSO_PORT
	int "LED on SSO connected to Port 0/1"
	default 0
	depends on UBOOT_CONFIG_LED_LGM_SSO
	help
	  Which SSO port are the LEDs connected to

menu "Lightning Mountain LED configurations"
	depends on UBOOT_CONFIG_LED_LGM_SSO

config UBOOT_CONFIG_LGM_SSO_LED_DUTY_CYCLE
	int "LED_DUTY_CYCLE 0-255"
	default 255
	help
	  Defines the LED duty cycle

config UBOOT_CONFIG_LGM_SSO_LED1_PIN
	bool "Support LED_1 SSO pin"
	help
	  Defines the pin connected to LED1

config UBOOT_CONFIG_LGM_SSO_LED1_PIN_NO
	int "LED_1 pin value"
	depends on UBOOT_CONFIG_LGM_SSO_LED1_PIN

config UBOOT_CONFIG_LGM_SSO_LED2_PIN
	bool "Support LED_2 SSO pin"
	help
	  Defines the pin connected to LED2

config UBOOT_CONFIG_LGM_SSO_LED2_PIN_NO
	int "LED_2 pin value"
	depends on UBOOT_CONFIG_LGM_SSO_LED2_PIN

config UBOOT_CONFIG_LGM_SSO_LED3_PIN
	bool "Support LED_3 SSO pin"
	help
	  Defines the pin connected to LED3

config UBOOT_CONFIG_LGM_SSO_LED3_PIN_NO
	int "LED_3 pin value"
	depends on UBOOT_CONFIG_LGM_SSO_LED3_PIN

config UBOOT_CONFIG_LGM_SSO_LED4_PIN
	bool "Support LED_4 SSO pin"
	help
	  Defines the pin connected to LED4

config UBOOT_CONFIG_LGM_SSO_LED4_PIN_NO
	int "LED_4 pin value"
	depends on UBOOT_CONFIG_LGM_SSO_LED4_PIN

config UBOOT_CONFIG_LGM_SSO_LED5_PIN
	bool "Support LED_5 SSO pin"
	help
	  Defines the pin connected to LED5

config UBOOT_CONFIG_LGM_SSO_LED5_PIN_NO
	int "LED_5 pin value"
	depends on UBOOT_CONFIG_LGM_SSO_LED5_PIN

config UBOOT_CONFIG_LGM_SSO_BLUE_LED_PIN
	bool "Support Blue LED on SSO pin"
	help
	  Defines the pin connected to the blue LED

config UBOOT_CONFIG_LGM_SSO_BLUE_LED_PIN_NO
	int "LED_BLUE pin value"
	depends on UBOOT_CONFIG_LGM_SSO_BLUE_LED_PIN

config UBOOT_CONFIG_LGM_SSO_GREEN_LED_PIN
	bool "Support Green LED on SSO pin"
	help
	  Defines the pin connected to the green LED

config UBOOT_CONFIG_LGM_SSO_GREEN_LED_PIN_NO
	int "LED_GREEN pin value"
	depends on UBOOT_CONFIG_LGM_SSO_GREEN_LED_PIN

config UBOOT_CONFIG_LGM_SSO_RED_LED_PIN
	bool "Support Red LED on SSO pin"
	help
	  Defines the pin connected to the red LED

config UBOOT_CONFIG_LGM_SSO_RED_LED_PIN_NO
	int "LED_RED pin value"
	depends on UBOOT_CONFIG_LGM_SSO_RED_LED_PIN

endmenu

config UBOOT_CONFIG_LED_STATUS
	bool "Enable status LED API"
	help
	  Allows common u-boot commands to use a board's leds to
	  provide status for activities like booting and downloading files.

if UBOOT_CONFIG_LED_STATUS

# Hidden constants

config UBOOT_CONFIG_LED_STATUS_OFF
	int
	default 0

config UBOOT_CONFIG_LED_STATUS_BLINKING
	int
	default 1

config UBOOT_CONFIG_LED_STATUS_ON
	int
	default 2

# Hidden constants end

config UBOOT_CONFIG_LED_STATUS_GPIO
	bool "GPIO status LED implementation"
	help
	  The status LED can be connected to a GPIO pin. In such cases, the
	  gpio_led driver can be used as a status LED backend implementation.

config UBOOT_CONFIG_LED_STATUS_BOARD_SPECIFIC
	bool "Specific board"
	default y
	help
	  LED support is only for a specific board.

comment "LEDs parameters"

config UBOOT_CONFIG_LED_STATUS0
	bool "Enable status LED 0"

if UBOOT_CONFIG_LED_STATUS0

config UBOOT_CONFIG_LED_STATUS_BIT
	int "identification"
	help
	  CONFIG_LED_STATUS_BIT is passed into the __led_* functions to identify
	  which LED is being acted on.  As such, the chosen value must be unique
	  with respect to the other CONFIG_LED_STATUS_BIT's. Mapping the value
	  to a physical LED is the responsibility of the __led_* function.

config UBOOT_CONFIG_LED_STATUS_STATE
	int "initial state"
	range LED_STATUS_OFF LED_STATUS_ON
	default UBOOT_CONFIG_LED_STATUS_OFF
	help
	  Should be set one of the following:
	  0 - off
	  1 - blinking
	  2 - on

config UBOOT_CONFIG_LED_STATUS_FREQ
	int "blink frequency"
	range 2 10
	default 2
	help
	  The LED blink period calculated from LED_STATUS_FREQ:
	  LED_STATUS_PERIOD = CONFIG_SYS_HZ/LED_STATUS_FREQ
	  Values range: 2 - 10

endif # LED_STATUS0

config UBOOT_CONFIG_LED_STATUS1
	bool "Enable status LED 1"

if UBOOT_CONFIG_LED_STATUS1

config UBOOT_CONFIG_LED_STATUS_BIT1
	int "identification"
	help
	  CONFIG_LED_STATUS_BIT1 is passed into the __led_* functions to
	  identify which LED is being acted on.  As such, the chosen value must
	  be unique with respect to the other CONFIG_LED_STATUS_BIT's. Mapping
	  the value to a physical LED is the responsibility of the __led_*
	  function.

config UBOOT_CONFIG_LED_STATUS_STATE1
	int "initial state"
	range LED_STATUS_OFF LED_STATUS_ON
	default UBOOT_CONFIG_LED_STATUS_OFF
	help
	  Should be set one of the following:
	  0 - off
	  1 - blinking
	  2 - on

config UBOOT_CONFIG_LED_STATUS_FREQ1
	int "blink frequency"
	range 2 10
	default 2
	help
	  The LED blink period calculated from LED_STATUS_FREQ1:
	  LED_STATUS_PERIOD1 = CONFIG_SYS_HZ/LED_STATUS_FREQ1
	  Values range: 2 - 10

endif # LED_STATUS1

config UBOOT_CONFIG_LED_STATUS2
	bool "Enable status LED 2"

if UBOOT_CONFIG_LED_STATUS2

config UBOOT_CONFIG_LED_STATUS_BIT2
	int "identification"
	help
	  CONFIG_LED_STATUS_BIT2 is passed into the __led_* functions to
	  identify which LED is being acted on.  As such, the chosen value must
	  be unique with respect to the other CONFIG_LED_STATUS_BIT's. Mapping
	  the value to a physical LED is the responsibility of the __led_*
	  function.

config UBOOT_CONFIG_LED_STATUS_STATE2
	int "initial state"
	range LED_STATUS_OFF LED_STATUS_ON
	default UBOOT_CONFIG_LED_STATUS_OFF
	help
	  Should be set one of the following:
	  0 - off
	  1 - blinking
	  2 - on

config UBOOT_CONFIG_LED_STATUS_FREQ2
	int "blink frequency"
	range 2 10
	default 2
	help
	  The LED blink period calculated from LED_STATUS_FREQ2:
	  LED_STATUS_PERIOD2 = CONFIG_SYS_HZ/LED_STATUS_FREQ2
	  Values range: 2 - 10

endif # LED_STATUS2

config UBOOT_CONFIG_LED_STATUS3
	bool "Enable status LED 3"

if UBOOT_CONFIG_LED_STATUS3

config UBOOT_CONFIG_LED_STATUS_BIT3
	int "identification"
	help
	  CONFIG_LED_STATUS_BIT3 is passed into the __led_* functions to
	  identify which LED is being acted on.  As such, the chosen value must
	  be unique with respect to the other CONFIG_LED_STATUS_BIT's. Mapping
	  the value to a physical LED is the responsibility of the __led_*
	  function.

config UBOOT_CONFIG_LED_STATUS_STATE3
	int "initial state"
	range LED_STATUS_OFF LED_STATUS_ON
	default UBOOT_CONFIG_LED_STATUS_OFF
	help
	  Should be set one of the following:
	  0 - off
	  1 - blinking
	  2 - on

config UBOOT_CONFIG_LED_STATUS_FREQ3
	int "blink frequency"
	range 2 10
	default 2
	help
	  The LED blink period calculated from LED_STATUS_FREQ3:
	  LED_STATUS_PERIOD3 = CONFIG_SYS_HZ/LED_STATUS_FREQ3
	  Values range: 2 - 10

endif # LED_STATUS3

config UBOOT_CONFIG_LED_STATUS4
	bool "Enable status LED 4"

if UBOOT_CONFIG_LED_STATUS4

config UBOOT_CONFIG_LED_STATUS_BIT4
	int "identification"
	help
	  CONFIG_LED_STATUS_BIT4 is passed into the __led_* functions to
	  identify which LED is being acted on.  As such, the chosen value must
	  be unique with respect to the other CONFIG_LED_STATUS_BIT's. Mapping
	  the value to a physical LED is the responsibility of the __led_*
	  function.

config UBOOT_CONFIG_LED_STATUS_STATE4
	int "initial state"
	range LED_STATUS_OFF LED_STATUS_ON
	default UBOOT_CONFIG_LED_STATUS_OFF
	help
	  Should be set one of the following:
	  0 - off
	  1 - blinking
	  2 - on

config UBOOT_CONFIG_LED_STATUS_FREQ4
	int "blink frequency"
	range 2 10
	default 2
	help
	  The LED blink period calculated from LED_STATUS_FREQ4:
	  LED_STATUS_PERIOD4 = CONFIG_SYS_HZ/LED_STATUS_FREQ4
	  Values range: 2 - 10

endif # LED_STATUS4

config UBOOT_CONFIG_LED_STATUS5
	bool "Enable status LED 5"

if UBOOT_CONFIG_LED_STATUS5

config UBOOT_CONFIG_LED_STATUS_BIT5
	int "identification"
	help
	  CONFIG_LED_STATUS_BIT5 is passed into the __led_* functions to
	  identify which LED is being acted on.  As such, the chosen value must
	  be unique with respect to the other CONFIG_LED_STATUS_BIT's. Mapping
	  the value to a physical LED is the responsibility of the __led_*
	  function.

config UBOOT_CONFIG_LED_STATUS_STATE5
	int "initial state"
	range LED_STATUS_OFF LED_STATUS_ON
	default UBOOT_CONFIG_LED_STATUS_OFF
	help
	  Should be set one of the following:
	  0 - off
	  1 - blinking
	  2 - on

config UBOOT_CONFIG_LED_STATUS_FREQ5
	int "blink frequency"
	range 2 10
	default 2
	help
	  The LED blink period calculated from LED_STATUS_FREQ5:
	  LED_STATUS_PERIOD5 = CONFIG_SYS_HZ/LED_STATUS_FREQ5
	  Values range: 2 - 10

endif # LED_STATUS5

config UBOOT_CONFIG_LED_STATUS_BOOT_ENABLE
	bool "Enable BOOT LED"
	help
	  Enable to turn an LED on when the board is booting.

if UBOOT_CONFIG_LED_STATUS_BOOT_ENABLE

config UBOOT_CONFIG_LED_STATUS_BOOT
	int "LED to light when the board is booting"
	help
	  Valid enabled LED device number.

endif # LED_STATUS_BOOT_ENABLE

config UBOOT_CONFIG_LED_STATUS_RED_ENABLE
	bool "Enable red LED"
	help
	  Enable red status LED.

if UBOOT_CONFIG_LED_STATUS_RED_ENABLE

config UBOOT_CONFIG_LED_STATUS_RED
	int "Red LED identification"
	help
	  Valid enabled LED device number.

endif # LED_STATUS_RED_ENABLE

config UBOOT_CONFIG_LED_STATUS_YELLOW_ENABLE
	bool "Enable yellow LED"
	help
	  Enable yellow status LED.

if UBOOT_CONFIG_LED_STATUS_YELLOW_ENABLE

config UBOOT_CONFIG_LED_STATUS_YELLOW
	int "Yellow LED identification"
	help
	  Valid enabled LED device number.

endif # LED_STATUS_YELLOW_ENABLE

config UBOOT_CONFIG_LED_STATUS_BLUE_ENABLE
	bool "Enable blue LED"
	help
	  Enable blue status LED.

if UBOOT_CONFIG_LED_STATUS_BLUE_ENABLE

config UBOOT_CONFIG_LED_STATUS_BLUE
	int "Blue LED identification"
	help
	  Valid enabled LED device number.

endif # LED_STATUS_BLUE_ENABLE

config UBOOT_CONFIG_LED_STATUS_GREEN_ENABLE
	bool "Enable green LED"
	help
	  Enable green status LED.

if UBOOT_CONFIG_LED_STATUS_GREEN_ENABLE

config UBOOT_CONFIG_LED_STATUS_GREEN
	int "Green LED identification"
	help
	  Valid enabled LED device number (0-5).

endif # LED_STATUS_GREEN_ENABLE

config UBOOT_CONFIG_LED_STATUS_CMD
	bool "Enable status LED commands"

endif # LED_STATUS

endmenu
```
