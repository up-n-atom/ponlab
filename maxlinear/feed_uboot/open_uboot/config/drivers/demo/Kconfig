## maxlinear/feed_uboot/open_uboot/config/drivers/pci/Kconfig
```kconfig
menuconfig UBOOT_CONFIG_PCI
	bool "PCI support"
	depends on UBOOT_CONFIG_DM
	default y if UBOOT_CONFIG_PPC
	help
	  Enable support for PCI (Peripheral Interconnect Bus), a type of bus
	  used on some devices to allow the CPU to communicate with its
	  peripherals.

	  This subsystem requires driver model.

if UBOOT_CONFIG_PCI

config UBOOT_CONFIG_DM_PCI_COMPAT
	bool "Enable compatible functions for PCI"
	help
	  Enable compatibility functions for PCI so that old code can be used
	  with CONFIG_PCI enabled. This should be used as an interim
	  measure when porting a board to use driver model for PCI. Once the
	  board is fully supported, this option should be disabled.

config UBOOT_CONFIG_PCI_AARDVARK
	bool "Enable Aardvark PCIe driver"
	depends on UBOOT_CONFIG_DM_GPIO
	depends on UBOOT_CONFIG_ARMADA_3700
	help
	  Say Y here if you want to enable PCIe controller support on
	  Armada37x0 SoCs. The PCIe controller on Armada37x0 is based on
	  Aardvark hardware.

config UBOOT_CONFIG_PCI_PNP
	bool "Enable Plug & Play support for PCI"
	default y
	help
	  Enable PCI memory and I/O space resource allocation and assignment.

config UBOOT_CONFIG_PCI_REGION_MULTI_ENTRY
	bool "Enable Multiple entries of region type MEMORY in ranges for PCI"
	help
	  Enable PCI memory regions to be of multiple entry. Multiple entry
	  here refers to allow more than one count of address ranges for MEMORY
	  region type. This helps to add support for SoC's like OcteonTX/TX2
	  where every peripheral is on the PCI bus.

config UBOOT_CONFIG_PCI_MAP_SYSTEM_MEMORY
	bool "Map local system memory from a virtual base address"
	depends on UBOOT_CONFIG_MIPS
	help
	  Say Y if base address of system memory is being used as a virtual address
	  instead of a physical address (e.g. on MIPS). The PCI core will then remap
	  the virtual memory base address to a physical address when adding the PCI
	  region of type PCI_REGION_SYS_MEMORY.
	  This should only be required on MIPS where CONFIG_SYS_SDRAM_BASE is still
	  being used as virtual address.

config UBOOT_CONFIG_PCI_SRIOV
	bool "Enable Single Root I/O Virtualization support for PCI"
	help
	  Say Y here if you want to enable PCI Single Root I/O Virtualization
	  capability support. This helps to enumerate Virtual Function devices
	  if available on a PCI Physical Function device and probe for
	  applicable drivers.

config UBOOT_CONFIG_PCI_ARID
        bool "Enable Alternate Routing-ID support for PCI"
        help
          Say Y here if you want to enable Alternate Routing-ID capability
          support on PCI devices. This helps to skip some devices in BDF
          scan that are not present.

config UBOOT_CONFIG_PCIE_ECAM_GENERIC
	bool "Generic ECAM-based PCI host controller support"
	help
	  Say Y here if you want to enable support for generic ECAM-based
	  PCIe host controllers, such as the one emulated by QEMU.

config UBOOT_CONFIG_PCIE_ECAM_SYNQUACER
	bool "SynQuacer ECAM-based PCI host controller support"
	select UBOOT_CONFIG_PCI_INIT_R
	select UBOOT_CONFIG_PCI_REGION_MULTI_ENTRY
	help
	  Say Y here if you want to enable support for Socionext
	  SynQuacer SoC's ECAM-based PCIe host controllers.
	  Note that this must be configured when boot because Linux driver
	  expects the PCIe RC has been configured in the bootloader.

config UBOOT_CONFIG_PCI_PHYTIUM
	bool "Phytium PCIe support"
	help
	  Say Y here if you want to enable PCIe controller support on
	  Phytium SoCs.

config UBOOT_CONFIG_PCIE_DW_MVEBU
	bool "Enable Armada-8K PCIe driver (DesignWare core)"
	depends on UBOOT_CONFIG_ARMADA_8K
	help
	  Say Y here if you want to enable PCIe controller support on
	  Armada-8K SoCs. The PCIe controller on Armada-8K is based on
	  DesignWare hardware.

config UBOOT_CONFIG_PCIE_DW_SIFIVE
	bool "Enable SiFive FU740 PCIe"
	depends on UBOOT_CONFIG_CLK_SIFIVE_PRCI
	depends on UBOOT_CONFIG_RESET_SIFIVE
	depends on UBOOT_CONFIG_SIFIVE_GPIO
	select UBOOT_CONFIG_PCIE_DW_COMMON
	help
	  Say Y here if you want to enable PCIe controller support on
	  FU740.

config UBOOT_CONFIG_PCIE_FSL
	bool "FSL PowerPC PCIe support"
	help
	  Say Y here if you want to enable PCIe controller support on FSL
	  PowerPC MPC85xx, MPC86xx, B series, P series and T series SoCs.
	  This driver does not support SRIO_PCIE_BOOT feature.

config UBOOT_CONFIG_PCI_MPC85XX
	bool "MPC85XX PowerPC PCI support"
	help
	  Say Y here if you want to enable PCI controller support on FSL
	  PowerPC MPC85xx SoC.

config UBOOT_CONFIG_PCI_RCAR_GEN2
	bool "Renesas RCar Gen2 PCIe driver"
	depends on UBOOT_CONFIG_RCAR_32
	help
	  Say Y here if you want to enable PCIe controller support on
	  Renesas RCar Gen2 SoCs. The PCIe controller on RCar Gen2 is
	  also used to access EHCI USB controller on the SoC.

config UBOOT_CONFIG_PCI_RCAR_GEN3
	bool "Renesas RCar Gen3 PCIe driver"
	depends on UBOOT_CONFIG_RCAR_GEN3
	help
	  Say Y here if you want to enable PCIe controller support on
	  Renesas RCar Gen3 SoCs.

config UBOOT_CONFIG_PCI_SANDBOX
	bool "Sandbox PCI support"
	depends on UBOOT_CONFIG_SANDBOX
	help
	  Support PCI on sandbox, as an emulated bus. This permits testing of
	  PCI feature such as bus scanning, device configuration and device
	  access. The available (emulated) devices are defined statically in
	  the device tree but the normal PCI scan technique is used to find
	  then.

config UBOOT_CONFIG_PCI_TEGRA
	bool "Tegra PCI support"
	depends on UBOOT_CONFIG_ARCH_TEGRA
	depends on (TEGRA186 && UBOOT_CONFIG_POWER_DOMAIN) || (!TEGRA186)
	help
	  Enable support for the PCIe controller found on some generations of
	  Tegra. Tegra20 has 2 root ports with a total of 4 lanes, Tegra30 has
	  3 root ports with a total of 6 lanes and Tegra124 has 2 root ports
	  with a total of 5 lanes. Some boards require this for Ethernet
	  support to work (e.g. beaver, jetson-tk1).

config UBOOT_CONFIG_PCI_OCTEONTX
	bool "OcteonTX PCI support"
	depends on (ARCH_OCTEONTX || UBOOT_CONFIG_ARCH_OCTEONTX2)
	help
	  Enable support for the OcteonTX/TX2 SoC family ECAM/PEM controllers.
	  These controllers provide PCI configuration access to all on-board
	  peripherals so it should only be disabled for testing purposes

config UBOOT_CONFIG_PCIE_OCTEON
	bool "MIPS Octeon PCIe support"
	depends on UBOOT_CONFIG_ARCH_OCTEON
	help
	  Enable support for the MIPS Octeon SoC family PCIe controllers.

config UBOOT_CONFIG_PCI_XILINX
	bool "Xilinx AXI Bridge for PCI Express"
	help
	  Enable support for the Xilinx AXI bridge for PCI express, an IP block
	  which can be used on some generations of Xilinx FPGAs.

config UBOOT_CONFIG_PCIE_LAYERSCAPE
	bool

config UBOOT_CONFIG_PCIE_LAYERSCAPE_RC
	bool "Layerscape PCIe Root Complex mode support"
	select UBOOT_CONFIG_PCIE_LAYERSCAPE
	help
	  Enable Layerscape PCIe Root Complex mode driver support. The Layerscape
	  SoC may have one or several PCIe controllers. Each controller can be
	  configured to Root Complex mode by clearing the corresponding bit of
	  RCW[HOST_AGT_PEX].

config UBOOT_CONFIG_PCI_IOMMU_EXTRA_MAPPINGS
	bool "Support for specifying extra IOMMU mappings for PCI"
	depends on UBOOT_CONFIG_PCIE_LAYERSCAPE_RC
	help
	  Enable support for specifying extra IOMMU mappings for PCI
	  controllers through a special env var called "pci_iommu_extra" or
	  through a device tree property named "pci-iommu-extra" placed in
	  the node describing the PCI controller.
	  The intent is to cover SR-IOV scenarios which need mappings for VFs
	  and PCI hot-plug scenarios. More documentation can be found under:
	    arch/arm/cpu/armv8/fsl-layerscape/doc/README.pci_iommu_extra

config UBOOT_CONFIG_PCIE_LAYERSCAPE_EP
	bool "Layerscape PCIe Endpoint mode support"
	select UBOOT_CONFIG_PCIE_LAYERSCAPE
	select UBOOT_CONFIG_PCI_ENDPOINT
	help
	  Enable Layerscape PCIe Endpoint mode driver support. The Layerscape
	  SoC may have one or several PCIe controllers. Each controller can be
	  configured to Endpoint mode by setting the corresponding bit of
	  RCW[HOST_AGT_PEX].

config UBOOT_CONFIG_PCIE_LAYERSCAPE_GEN4
	bool "Layerscape Gen4 PCIe support"
	help
	  Support PCIe Gen4 on NXP Layerscape SoCs, which may have one or
	  several PCIe controllers. The PCIe controller can work in RC or
	  EP mode according to RCW[HOST_AGT_PEX] setting.

config UBOOT_CONFIG_FSL_PCIE_COMPAT
	string "PCIe compatible of Kernel DT"
	depends on UBOOT_CONFIG_PCIE_LAYERSCAPE_RC || UBOOT_CONFIG_PCIE_LAYERSCAPE_GEN4
	default "fsl,ls1012a-pcie" if UBOOT_CONFIG_ARCH_LS1012A
	default "fsl,ls1028a-pcie" if UBOOT_CONFIG_ARCH_LS1028A
	default "fsl,ls1043a-pcie" if UBOOT_CONFIG_ARCH_LS1043A
	default "fsl,ls1046a-pcie" if UBOOT_CONFIG_ARCH_LS1046A
	default "fsl,ls2080a-pcie" if UBOOT_CONFIG_ARCH_LS2080A
	default "fsl,ls1088a-pcie" if UBOOT_CONFIG_ARCH_LS1088A
	default "fsl,lx2160a-pcie" if UBOOT_CONFIG_ARCH_LX2160A
	default "fsl,ls2088a-pcie" if UBOOT_CONFIG_ARCH_LX2162A
	default "fsl,ls1021a-pcie" if UBOOT_CONFIG_ARCH_LS1021A
	help
	  This compatible is used to find pci controller node in Kernel DT
	  to complete fixup.

config UBOOT_CONFIG_FSL_PCIE_EP_COMPAT
	string "PCIe EP compatible of Kernel DT"
	depends on UBOOT_CONFIG_PCIE_LAYERSCAPE_RC || UBOOT_CONFIG_PCIE_LAYERSCAPE_GEN4
	default "fsl,lx2160a-pcie-ep" if UBOOT_CONFIG_ARCH_LX2160A
	default "fsl,ls-pcie-ep"
	help
	  This compatible is used to find pci controller ep node in Kernel DT
	  to complete fixup.

config UBOOT_CONFIG_PCIE_INTEL_FPGA
	bool "Intel FPGA PCIe support"
	help
	  Say Y here if you want to enable PCIe controller support on Intel
	  FPGA, example Stratix 10.

config UBOOT_CONFIG_PCIE_IPROC
	bool "Iproc PCIe support"
	help
	  Broadcom iProc PCIe controller driver.
	  Say Y here if you want to enable Broadcom iProc PCIe controller,

config UBOOT_CONFIG_PCI_MVEBU
	bool "Enable Armada XP/38x PCIe driver"
	depends on UBOOT_CONFIG_ARCH_MVEBU
	select UBOOT_CONFIG_MISC
	help
	  Say Y here if you want to enable PCIe controller support on
	  Armada XP/38x SoCs.

config UBOOT_CONFIG_PCIE_DW_COMMON
	bool

config UBOOT_CONFIG_PCI_KEYSTONE
	bool "TI Keystone PCIe controller"
	select UBOOT_CONFIG_PCIE_DW_COMMON
	help
	  Say Y here if you want to enable PCI controller support on AM654 SoC.

config UBOOT_CONFIG_PCIE_MEDIATEK
	bool "MediaTek PCIe Gen2 controller"
	depends on UBOOT_CONFIG_ARCH_MEDIATEK
	help
	  Say Y here if you want to enable Gen2 PCIe controller,
	  which could be found on MT7623 SoC family.

config UBOOT_CONFIG_PCIE_DW_MESON
	bool "Amlogic Meson DesignWare based PCIe controller"
	depends on UBOOT_CONFIG_ARCH_MESON
	select UBOOT_CONFIG_PCIE_DW_COMMON
	help
	  Say Y here if you want to enable DW PCIe controller support on
	  Amlogic SoCs.

config UBOOT_CONFIG_PCIE_ROCKCHIP
	bool "Enable Rockchip PCIe driver"
	depends on UBOOT_CONFIG_ARCH_ROCKCHIP
	select UBOOT_CONFIG_PHY_ROCKCHIP_PCIE
	default y if UBOOT_CONFIG_ROCKCHIP_RK3399
	help
	  Say Y here if you want to enable PCIe controller support on
	  Rockchip SoCs.

config UBOOT_CONFIG_PCIE_DW_ROCKCHIP
	bool "Rockchip DesignWare based PCIe controller"
	depends on UBOOT_CONFIG_ARCH_ROCKCHIP
	select UBOOT_CONFIG_PCIE_DW_COMMON
	select UBOOT_CONFIG_PHY_ROCKCHIP_SNPS_PCIE3
	help
	  Say Y here if you want to enable DW PCIe controller support on
	  Rockchip SoCs.

config UBOOT_CONFIG_PCI_BRCMSTB
	bool "Broadcom STB PCIe controller"
	depends on UBOOT_CONFIG_ARCH_BCM283X
	help
	  Say Y here if you want to enable support for PCIe controller
	  on Broadcom set-top-box (STB) SoCs.
	  This driver currently supports only BCM2711 SoC and RC mode
	  of the controller.

config UBOOT_CONFIG_PCIE_UNIPHIER
	bool "Socionext UniPhier PCIe driver"
	depends on UBOOT_CONFIG_ARCH_UNIPHIER
	select UBOOT_CONFIG_PHY_UNIPHIER_PCIE
	help
	  Say Y here if you want to enable PCIe controller support on
	  UniPhier SoCs.

endif
```

## maxlinear/feed_uboot/open_uboot/config/drivers/phy/allwinner/Kconfig
```kconfig
#
# Phy drivers for Allwinner platforms
#
config UBOOT_CONFIG_PHY_SUN4I_USB
	bool "Allwinner Sun4I USB PHY driver"
	depends on UBOOT_CONFIG_ARCH_SUNXI
	select UBOOT_CONFIG_DM_REGULATOR
	select UBOOT_CONFIG_PHY
	help
	  Enable this to support the transceiver that is part of Allwinner
	  sunxi SoCs.

	  This driver controls the entire USB PHY block, both the USB OTG
	  parts, as well as the 2 regular USB 2 host PHYs.

config UBOOT_CONFIG_PHY_SUN50I_USB3
	bool "Allwinner sun50i USB3 PHY driver"
	depends on UBOOT_CONFIG_ARCH_SUNXI
	select UBOOT_CONFIG_PHY
	help
	  Enable this to support the USB3 transceiver that is part of
	  Allwinner sun50i SoCs.
```

## maxlinear/feed_uboot/open_uboot/config/drivers/phy/cadence/Kconfig
```kconfig
config UBOOT_CONFIG_PHY_CADENCE_SIERRA
	tristate "Cadence Sierra PHY Driver"
	depends on UBOOT_CONFIG_DM_RESET
	help
	  Enable this to support the Cadence Sierra PHY driver

config UBOOT_CONFIG_PHY_CADENCE_TORRENT
	tristate "Cadence Torrent PHY Driver"
	depends on UBOOT_CONFIG_DM_RESET
	help
	  Enable this to support the Cadence Torrent PHY driver
```

## maxlinear/feed_uboot/open_uboot/config/drivers/phy/rockchip/Kconfig
```kconfig
#
# Phy drivers for Rockchip platforms
#

menu "Rockchip PHY driver"

config UBOOT_CONFIG_PHY_ROCKCHIP_INNO_USB2
	bool "Rockchip INNO USB2PHY Driver"
	depends on UBOOT_CONFIG_ARCH_ROCKCHIP
	select UBOOT_CONFIG_PHY
	help
	  Support for Rockchip USB2.0 PHY with Innosilicon IP block.

config UBOOT_CONFIG_PHY_ROCKCHIP_PCIE
	bool "Rockchip PCIe PHY Driver"
	depends on UBOOT_CONFIG_ARCH_ROCKCHIP
	select UBOOT_CONFIG_PHY
	help
	  Enable this to support the Rockchip PCIe PHY.

config UBOOT_CONFIG_PHY_ROCKCHIP_SNPS_PCIE3
	bool "Rockchip Snps PCIe3 PHY Driver"
	depends on UBOOT_CONFIG_PHY && UBOOT_CONFIG_ARCH_ROCKCHIP
	help
	  Support for Rockchip PCIe3 PHY with Synopsys IP block.
	  It could support PCIe Gen3 single root complex, and could
	  also be able splited into multiple combinations of lanes.


config UBOOT_CONFIG_PHY_ROCKCHIP_TYPEC
	bool "Rockchip TYPEC PHY Driver"
	depends on UBOOT_CONFIG_ARCH_ROCKCHIP
	select UBOOT_CONFIG_PHY
	help
	  Enable this to support the Rockchip USB TYPEC PHY.

endmenu
```

## maxlinear/feed_uboot/open_uboot/config/drivers/phy/socionext/Kconfig
```kconfig
# SPDX-License-Identifier: GPL-2.0-only
#
# PHY drivers for Socionext platforms.
#

config UBOOT_CONFIG_PHY_UNIPHIER_PCIE
	bool "UniPhier PCIe PHY driver"
	depends on UBOOT_CONFIG_PHY && UBOOT_CONFIG_ARCH_UNIPHIER
	imply REGMAP
	help
	  Enable this to support PHY implemented in PCIe controller
	  on UniPhier SoCs.
```
