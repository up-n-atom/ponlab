## maxlinear/feed_uboot/open_uboot/config/drivers/usb/host/Kconfig
```kconfig
#
# USB Host Controller Drivers
#
comment "USB Host Controller Drivers"

config UBOOT_CONFIG_USB_HOST
	bool
	select UBOOT_CONFIG_DM_USB

config UBOOT_CONFIG_USB_XHCI_HCD
	bool "xHCI HCD (USB 3.0) support"
	depends on UBOOT_CONFIG_DM && UBOOT_CONFIG_OF_CONTROL
	select UBOOT_CONFIG_USB_HOST
	---help---
	  The eXtensible Host Controller Interface (xHCI) is standard for USB 3.0
	  "SuperSpeed" host controller hardware.

if UBOOT_CONFIG_USB_XHCI_HCD

config UBOOT_CONFIG_USB_XHCI_DWC3
	bool "DesignWare USB3 DRD Core Support"
	help
	  Say Y or if your system has a Dual Role SuperSpeed
	  USB controller based on the DesignWare USB3 IP Core.

config UBOOT_CONFIG_USB_XHCI_DWC3_OF_SIMPLE
	bool "DesignWare USB3 DRD Generic OF Simple Glue Layer"
	depends on UBOOT_CONFIG_DM_USB
	default y if UBOOT_CONFIG_ARCH_ROCKCHIP
	default y if UBOOT_CONFIG_DRA7XX
	help
	  Support USB2/3 functionality in simple SoC integrations with
	  USB controller based on the DesignWare USB3 IP Core.

config UBOOT_CONFIG_USB_XHCI_MTK
	bool "Support for MediaTek on-chip xHCI USB controller"
	depends on UBOOT_CONFIG_ARCH_MEDIATEK
	help
	  Enables support for the on-chip xHCI controller on MediaTek SoCs.

config UBOOT_CONFIG_USB_XHCI_MVEBU
	bool "MVEBU USB 3.0 support"
	default y
	depends on UBOOT_CONFIG_ARCH_MVEBU
	select UBOOT_CONFIG_DM_REGULATOR
	help
	  Choose this option to add support for USB 3.0 driver on mvebu
	  SoCs, which includes Armada8K, Armada3700 and other Armada
	  family SoCs.

config UBOOT_CONFIG_USB_XHCI_OCTEON
	bool "Support for Marvell Octeon family on-chip xHCI USB controller"
	depends on UBOOT_CONFIG_ARCH_OCTEON
	default y
	help
	  Enables support for the on-chip xHCI controller on Marvell Octeon
	  family SoCs. This is a driver for the dwc3 to provide the glue logic
	  to configure the controller.

config UBOOT_CONFIG_USB_XHCI_OMAP
	bool "Support for TI OMAP family xHCI USB controller"
	depends on UBOOT_CONFIG_ARCH_OMAP2PLUS
	help
	  Enables support for the on-chip xHCI controller found on some TI SoC
	  families.  Note that some families have multiple contollers while
	  others only have something such as DesignWare-based controllers.
	  Consult the SoC documentation to determine if this option applies
	  to your hardware.

config UBOOT_CONFIG_USB_XHCI_PCI
	bool "Support for PCI-based xHCI USB controller"
	depends on UBOOT_CONFIG_DM_USB
	default y if UBOOT_CONFIG_X86
	help
	  Enables support for the PCI-based xHCI controller.

config UBOOT_CONFIG_USB_XHCI_RCAR
	bool "Renesas RCar USB 3.0 support"
	default y
	depends on UBOOT_CONFIG_ARCH_RMOBILE
	help
	  Choose this option to add support for USB 3.0 driver on Renesas
	  RCar Gen3 SoCs.

config UBOOT_CONFIG_USB_XHCI_STI
	bool "Support for STMicroelectronics STiH407 family on-chip xHCI USB controller"
	depends on UBOOT_CONFIG_ARCH_STI
	default y
	help
	  Enables support for the on-chip xHCI controller on STMicroelectronics
	  STiH407 family SoCs. This is a driver for the dwc3 to provide the glue logic
	  to configure the controller.

config UBOOT_CONFIG_USB_XHCI_DRA7XX_INDEX
	int "DRA7XX xHCI USB index"
	range 0 1
	default 0
	depends on UBOOT_CONFIG_DRA7XX
	help
	  Select the DRA7XX xHCI USB index.
	  Current supported values: 0, 1.

config UBOOT_CONFIG_USB_XHCI_FSL
	bool "Support for NXP Layerscape on-chip xHCI USB controller"
	default y if UBOOT_CONFIG_ARCH_LS1021A || UBOOT_CONFIG_FSL_LSCH3 || UBOOT_CONFIG_FSL_LSCH2
	depends on !UBOOT_CONFIG_SPL_NO_USB
	help
	  Enables support for the on-chip xHCI controller on NXP Layerscape SoCs.

config UBOOT_CONFIG_USB_XHCI_BRCM
	bool "Broadcom USB3 Host XHCI controller"
	depends on UBOOT_CONFIG_DM_USB
	help
	  USB controller based on the Broadcom USB3 IP Core.
	  Supports USB2/3 functionality.

config UBOOT_CONFIG_USB_XHCI_MXL
	bool "Maxlinear USB3 Host XHCI controller"
	depends on UBOOT_CONFIG_DM_USB
	help
	  USB controller based on the Maxlinear USB3 IP Core.
	  Supports USB2/3 functionality.

endif # USB_XHCI_HCD

config UBOOT_CONFIG_USB_EHCI_HCD
	bool "EHCI HCD (USB 2.0) support"
	default y if UBOOT_CONFIG_ARCH_MX5 || UBOOT_CONFIG_ARCH_MX6
	depends on UBOOT_CONFIG_DM && UBOOT_CONFIG_OF_CONTROL
	select UBOOT_CONFIG_USB_HOST
	---help---
	  The Enhanced Host Controller Interface (EHCI) is standard for USB 2.0
	  "high speed" (480 Mbit/sec, 60 Mbyte/sec) host controller hardware.
	  If your USB host controller supports USB 2.0, you will likely want to
	  configure this Host Controller Driver.

	  EHCI controllers are packaged with "companion" host controllers (OHCI
	  or UHCI) to handle USB 1.1 devices connected to root hub ports.  Ports
	  will connect to EHCI if the device is high speed, otherwise they
	  connect to a companion controller.  If you configure EHCI, you should
	  probably configure the OHCI (for NEC and some other vendors) USB Host
	  Controller Driver or UHCI (for Via motherboards) Host Controller
	  Driver too.

	  You may want to read <file:Documentation/usb/ehci.txt>.

if UBOOT_CONFIG_USB_EHCI_HCD

config UBOOT_CONFIG_USB_EHCI_IS_TDI
	bool

config UBOOT_CONFIG_USB_EHCI_ATMEL
	bool  "Support for Atmel on-chip EHCI USB controller"
	depends on UBOOT_CONFIG_ARCH_AT91
	default y
	---help---
	  Enables support for the on-chip EHCI controller on Atmel chips.

config UBOOT_CONFIG_USB_EHCI_MARVELL
	bool "Support for Marvell on-chip EHCI USB controller"
	depends on UBOOT_CONFIG_ARCH_MVEBU || UBOOT_CONFIG_ARCH_KIRKWOOD || UBOOT_CONFIG_ARCH_ORION5X
	default y
	select UBOOT_CONFIG_USB_EHCI_IS_TDI if !ARM64
	---help---
	  Enables support for the on-chip EHCI controller on MVEBU SoCs.

config UBOOT_CONFIG_USB_EHCI_MX5
	bool "Support for i.MX5 on-chip EHCI USB controller"
	depends on UBOOT_CONFIG_ARCH_MX5
	help
	  Enables support for the on-chip EHCI controller on i.MX5 SoCs.

config UBOOT_CONFIG_USB_EHCI_MX6
	bool "Support for i.MX6/i.MX7ULP on-chip EHCI USB controller"
	depends on UBOOT_CONFIG_ARCH_MX6 || UBOOT_CONFIG_ARCH_MX7ULP || UBOOT_CONFIG_ARCH_IMXRT
	default y
	---help---
	  Enables support for the on-chip EHCI controller on i.MX6 SoCs.

config UBOOT_CONFIG_USB_EHCI_MX7
	bool "Support for i.MX7 on-chip EHCI USB controller"
	depends on UBOOT_CONFIG_ARCH_MX7 || UBOOT_CONFIG_IMX8M
	select UBOOT_CONFIG_PHY if IMX8M
	select UBOOT_CONFIG_NOP_PHY if IMX8M
	default y
	---help---
	  Enables support for the on-chip EHCI controller on i.MX7 SoCs.

config UBOOT_CONFIG_USB_EHCI_MXS
	bool "Support for i.MX23 EHCI USB controller"
	depends on UBOOT_CONFIG_ARCH_MX23
	default y
	select UBOOT_CONFIG_USB_EHCI_IS_TDI
	help
	  Enables support for the on-chip EHCI controller on i.MX23 SoCs.

config UBOOT_CONFIG_USB_EHCI_OMAP
	bool "Support for OMAP3+ on-chip EHCI USB controller"
	depends on UBOOT_CONFIG_ARCH_OMAP2PLUS
	default y
	---help---
	  Enables support for the on-chip EHCI controller on OMAP3 and later
	  SoCs.

if UBOOT_CONFIG_USB_EHCI_OMAP

config UBOOT_CONFIG_HAS_OMAP_EHCI_PHY1_RESET_GPIO
	bool "PHY #1 requires a GPIO hold to it in RESET while PHY settles"
	help
	  Enable this to be able to configure the GPIO number used to hold the
	  PHY in RESET for enough time until the PHY is settled and ready.

config UBOOT_CONFIG_OMAP_EHCI_PHY1_RESET_GPIO
	int "GPIO number to hold PHY #1 in RESET"
	depends on UBOOT_CONFIG_HAS_OMAP_EHCI_PHY1_RESET_GPIO

config UBOOT_CONFIG_HAS_OMAP_EHCI_PHY2_RESET_GPIO
	bool "PHY #2 requires a GPIO hold to it in RESET while PHY settles"
	help
	  Enable this to be able to configure the GPIO number used to hold the
	  PHY in RESET for enough time until the PHY is settled and ready.

config UBOOT_CONFIG_OMAP_EHCI_PHY2_RESET_GPIO
	int "GPIO number to hold PHY #2 in RESET"
	depends on UBOOT_CONFIG_HAS_OMAP_EHCI_PHY2_RESET_GPIO

config UBOOT_CONFIG_HAS_OMAP_EHCI_PHY3_RESET_GPIO
	bool "PHY #3 requires a GPIO hold to it in RESET while PHY settles"
	help
	  Enable this to be able to configure the GPIO number used to hold the
	  PHY in RESET for enough time until the PHY is settled and ready.

config UBOOT_CONFIG_OMAP_EHCI_PHY3_RESET_GPIO
	int "GPIO number to hold PHY #3 in RESET"
	depends on UBOOT_CONFIG_HAS_OMAP_EHCI_PHY3_RESET_GPIO

endif

config UBOOT_CONFIG_USB_EHCI_VF
	bool "Support for Vybrid on-chip EHCI USB controller"
	depends on UBOOT_CONFIG_ARCH_VF610
	default y
	help
	  Enables support for the on-chip EHCI controller on Vybrid SoCs.

if UBOOT_CONFIG_USB_EHCI_MX6 || UBOOT_CONFIG_USB_EHCI_MX7

config UBOOT_CONFIG_MXC_USB_OTG_HACTIVE
	bool "USB Power pin high active"
	---help---
	  Set the USB Power pin polarity to be high active (PWR_POL)

endif

config UBOOT_CONFIG_USB_EHCI_MSM
	bool "Support for Qualcomm on-chip EHCI USB controller"
	depends on UBOOT_CONFIG_DM_USB
	select UBOOT_CONFIG_USB_ULPI_VIEWPORT
	select UBOOT_CONFIG_MSM8916_USB_PHY
	---help---
	  Enables support for the on-chip EHCI controller on Qualcomm
	  Snapdragon SoCs.

config UBOOT_CONFIG_USB_EHCI_PCI
	bool "Support for PCI-based EHCI USB controller"
	default y if UBOOT_CONFIG_X86
	help
	  Enables support for the PCI-based EHCI controller.

config UBOOT_CONFIG_USB_EHCI_TEGRA
	bool "Support for NVIDIA Tegra on-chip EHCI USB controller"
	depends on UBOOT_CONFIG_ARCH_TEGRA
	select UBOOT_CONFIG_USB_EHCI_IS_TDI
	---help---
	  Enable support for Tegra on-chip EHCI USB controller

config UBOOT_CONFIG_USB_EHCI_ZYNQ
	bool "Support for Xilinx Zynq on-chip EHCI USB controller"
	default y if UBOOT_CONFIG_ARCH_ZYNQ
	select UBOOT_CONFIG_USB_EHCI_IS_TDI
	---help---
	  Enable support for Zynq on-chip EHCI USB controller

config UBOOT_CONFIG_USB_EHCI_GENERIC
	bool "Support for generic EHCI USB controller"
	depends on UBOOT_CONFIG_DM_USB
	default UBOOT_CONFIG_ARCH_SUNXI
	---help---
	  Enables support for generic EHCI controller.

config UBOOT_CONFIG_USB_EHCI_FSL
	bool  "Support for FSL on-chip EHCI USB controller"
	select  UBOOT_CONFIG_CONFIG_EHCI_HCD_INIT_AFTER_RESET
	---help---
	  Enables support for the on-chip EHCI controller on FSL chips.
endif # USB_EHCI_HCD

config UBOOT_CONFIG_USB_OHCI_HCD
	bool "OHCI HCD (USB 1.1) support"
	depends on UBOOT_CONFIG_DM && UBOOT_CONFIG_OF_CONTROL
	select UBOOT_CONFIG_USB_HOST
	---help---
	  The Open Host Controller Interface (OHCI) is a standard for accessing
	  USB 1.1 host controller hardware.  It does more in hardware than Intel's
	  UHCI specification.  If your USB host controller follows the OHCI spec,
	  say Y.  On most non-x86 systems, and on x86 hardware that's not using a
	  USB controller from Intel or VIA, this is appropriate.  If your host
	  controller doesn't use PCI, this is probably appropriate.  For a PCI
	  based system where you're not sure, the "lspci -v" entry will list the
	  right "prog-if" for your USB controller(s):  EHCI, OHCI, or UHCI.

if UBOOT_CONFIG_USB_OHCI_HCD

config UBOOT_CONFIG_USB_OHCI_PCI
	bool "Support for PCI-based OHCI USB controller"
	depends on UBOOT_CONFIG_PCI
	help
	  Enables support for the PCI-based OHCI controller.

config UBOOT_CONFIG_USB_OHCI_GENERIC
	bool "Support for generic OHCI USB controller"
	default UBOOT_CONFIG_ARCH_SUNXI
	---help---
	  Enables support for generic OHCI controller.

config UBOOT_CONFIG_USB_OHCI_DA8XX
	bool "Support for da850 OHCI USB controller"
	help
	  Enable support for the da850 USB controller.

endif # USB_OHCI_HCD

config UBOOT_CONFIG_USB_UHCI_HCD
	bool "UHCI HCD (most Intel and VIA) support"
	select UBOOT_CONFIG_USB_HOST
	---help---
	  The Universal Host Controller Interface is a standard by Intel for
	  accessing the USB hardware in the PC (which is also called the USB
	  host controller). If your USB host controller conforms to this
	  standard, you may want to say Y, but see below. All recent boards
	  with Intel PCI chipsets (like intel 430TX, 440FX, 440LX, 440BX,
	  i810, i820) conform to this standard. Also all VIA PCI chipsets
	  (like VIA VP2, VP3, MVP3, Apollo Pro, Apollo Pro II or Apollo Pro
	  133) and LEON/GRLIB SoCs with the GRUSBHC controller.
	  If unsure, say Y.

if UBOOT_CONFIG_USB_UHCI_HCD

endif # USB_UHCI_HCD

config UBOOT_CONFIG_USB_DWC2
	bool "DesignWare USB2 Core support"
	depends on UBOOT_CONFIG_DM && UBOOT_CONFIG_OF_CONTROL
	select UBOOT_CONFIG_USB_HOST
	---help---
	  The DesignWare USB 2.0 controller is compliant with the
	  USB-Implementers Forum (USB-IF) USB 2.0 specifications.
	  Hi-Speed (480 Mbps), Full-Speed (12 Mbps), and Low-Speed (1.5 Mbps)
	  operation is compliant to the controller Supplement. If you want to
	  enable this controller in host mode, say Y.

if UBOOT_CONFIG_USB_DWC2
config UBOOT_CONFIG_USB_DWC2_BUFFER_SIZE
	int "Data buffer size in kB"
	default 64
	---help---
	  By default 64 kB buffer is used but if amount of RAM avaialble on
	  the target is not enough to accommodate allocation of buffer of
	  that size it is possible to shrink it. Smaller sizes should be fine
	  because larger transactions could be split in smaller ones.

endif # USB_DWC2

config UBOOT_CONFIG_USB_R8A66597_HCD
	bool "Renesas R8A66597 USB Core support"
	depends on UBOOT_CONFIG_DM && UBOOT_CONFIG_OF_CONTROL
	select UBOOT_CONFIG_USB_HOST
	---help---
	  This enables support for the on-chip Renesas R8A66597 USB 2.0
	  controller, present in various RZ and SH SoCs.
```

## maxlinear/feed_uboot/open_uboot/config/drivers/usb/mtu3/Kconfig
```kconfig
# SPDX-License-Identifier: GPL-2.0
#
# For MTK USB3.0 IP

config UBOOT_CONFIG_USB_MTU3
	bool "MediaTek USB3 Dual Role controller"
	depends on UBOOT_CONFIG_USB_XHCI_HCD || UBOOT_CONFIG_USB_GADGET
	depends on UBOOT_CONFIG_ARCH_MEDIATEK
	help
	  Say Y here if your system runs on MediaTek SoCs with
	  Dual Role SuperSpeed USB controller. You can select usb
	  mode as peripheral role or host role.

	  If you don't know what this is, please say N.

if UBOOT_CONFIG_USB_MTU3
choice
	bool "MTU3 Mode Selection"
	default UBOOT_CONFIG_USB_MTU3_GADGET if UBOOT_CONFIG_USB_GADGET
	default UBOOT_CONFIG_USB_MTU3_HOST if (UBOOT_CONFIG_USB_HOST && !UBOOT_CONFIG_USB_GADGET)

config UBOOT_CONFIG_USB_MTU3_HOST
	bool "Host only mode"
	depends on UBOOT_CONFIG_USB_XHCI_HCD
	help
	  Select this when you want to use MTU3 in host mode only,
	  thereby the gadget feature will be regressed.

config UBOOT_CONFIG_USB_MTU3_GADGET
	bool "Gadget only mode"
	depends on UBOOT_CONFIG_USB_GADGET
	select UBOOT_CONFIG_USB_GADGET_DUALSPEED
	help
	  Select this when you want to use MTU3 in gadget mode only,
	  thereby the host feature will be regressed.

endchoice

config UBOOT_CONFIG_USB_MTU3_DEBUG
	bool "Enable Debugging Messages"
	help
	  Say Y here to enable debugging messages in the MTU3 Driver.

endif
```
