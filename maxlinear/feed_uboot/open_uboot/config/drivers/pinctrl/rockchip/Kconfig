## maxlinear/feed_uboot/open_uboot/config/drivers/sysinfo/Kconfig
```kconfig
menuconfig UBOOT_CONFIG_SYSINFO
	bool "Device System Information"
	help
	  Support methods to query hardware configurations from internal
	  mechanisms (e.g. reading GPIO values, determining the presence of
	  devices on busses, etc.). This enables the usage of U-Boot with
	  modular board architectures.

if UBOOT_CONFIG_SYSINFO

config UBOOT_CONFIG_SPL_SYSINFO
	depends on UBOOT_CONFIG_SPL_DM
	bool "Enable board driver support in SPL"

config UBOOT_CONFIG_SYSINFO_GAZERBEAM
	bool "Enable sysinfo driver for the Gazerbeam board"
	help
	  Support querying device information for the gdsys Gazerbeam board.

config UBOOT_CONFIG_SYSINFO_RCAR3
	bool "Enable sysinfo driver for the Renesas R-Car Gen3"
	depends on UBOOT_CONFIG_RCAR_GEN3 && UBOOT_CONFIG_I2C_EEPROM
	default y if UBOOT_CONFIG_RCAR_GEN3
	help
	  Support querying SoC version information for Renesas R-Car Gen3.

config UBOOT_CONFIG_SYSINFO_SANDBOX
	bool "Enable sysinfo driver for the Sandbox board"
	help
	  Support querying device information for the Sandbox boards.

config UBOOT_CONFIG_SYSINFO_SMBIOS
	bool "Provide a default sysinfo driver for SMBIOS information"
	help
	  Some boards want to specify the manufacturer or product name but do
	  not need to have their own sysinfo driver. This includes a default
	  one which provides a way to specify this SMBIOS information in the
	  devicetree, without needing any board-specific functionality.

config UBOOT_CONFIG_SYSINFO_GPIO
	bool "Enable gpio sysinfo driver"
	help
	  Support querying gpios to determine board revision. This uses gpios to
	  form a ternary number (when they are pulled-up, -down, or floating).
	  This ternary number is then mapped to a board revision name using
	  device tree properties.

endif
```

## maxlinear/feed_uboot/open_uboot/config/drivers/sysreset/Kconfig
```kconfig
#
# System reset devices
#

menu "System reset device drivers"

config UBOOT_CONFIG_SYSRESET
	bool "Enable support for system reset drivers"
	depends on UBOOT_CONFIG_DM
	help
	  Enable system reset drivers which can be used to reset the CPU or
	  board. Each driver can provide a reset method which will be called
	  to effect a reset. The uclass will try all available drivers when
	  reset_walk() is called.

config UBOOT_CONFIG_SPL_SYSRESET
	bool "Enable support for system reset drivers in SPL mode"
	depends on UBOOT_CONFIG_SYSRESET && UBOOT_CONFIG_SPL_DM
	help
	  Enable system reset drivers which can be used to reset the CPU or
	  board. Each driver can provide a reset method which will be called
	  to effect a reset. The uclass will try all available drivers when
	  reset_walk() is called.

config UBOOT_CONFIG_TPL_SYSRESET
	bool "Enable support for system reset drivers in TPL mode"
	depends on UBOOT_CONFIG_SYSRESET && UBOOT_CONFIG_TPL_DM
	help
	  Enable system reset drivers which can be used to reset the CPU or
	  board. Each driver can provide a reset method which will be called
	  to effect a reset. The uclass will try all available drivers when
	  reset_walk() is called.

if UBOOT_CONFIG_SYSRESET

config UBOOT_CONFIG_SYSRESET_CMD_RESET
	bool "sysreset implementation of the reset command"
	default y
	help
	  Enable sysreset implementation of the reset command.

if UBOOT_CONFIG_CMD_POWEROFF

config UBOOT_CONFIG_SYSRESET_CMD_POWEROFF
	bool "sysreset implementation of the poweroff command"
	help
	  This should be selected by the appropriate PMIC driver if
	  the poweroff command is enabled.

endif

config UBOOT_CONFIG_POWEROFF_GPIO
	bool "Enable support for GPIO poweroff driver"
	select UBOOT_CONFIG_DM_GPIO
	help
	  Support for system poweroff using a GPIO pin. This can be used
	  for systems having a single GPIO to trigger a system poweroff.

config UBOOT_CONFIG_SYSRESET_GPIO
	bool "Enable support for GPIO reset driver"
	select UBOOT_CONFIG_DM_GPIO
	help
	  Reset support via GPIO pin connected reset logic. This is used for
	  example on Microblaze where reset logic can be controlled via GPIO
	  pin which triggers cpu reset.

config UBOOT_CONFIG_SYSRESET_MICROBLAZE
	bool "Enable support for Microblaze soft reset"
	depends on UBOOT_CONFIG_MICROBLAZE
	help
	  This is soft reset on Microblaze which does jump to 0x0 address.

config UBOOT_CONFIG_SYSRESET_OCTEON
	bool "Enable support for Marvell Octeon SoC family"
	depends on UBOOT_CONFIG_ARCH_OCTEON
	help
	  This enables the system reset driver support for Marvell Octeon
	  SoCs.

config UBOOT_CONFIG_SYSRESET_PSCI
	bool "Enable support for PSCI System Reset"
	depends on UBOOT_CONFIG_ARM_PSCI_FW
	select UBOOT_CONFIG_SPL_ARM_PSCI_FW if SPL
	help
	  Enable PSCI SYSTEM_RESET function call.  To use this, PSCI firmware
	  must be running on your system.

config UBOOT_CONFIG_SYSRESET_SBI
	bool "Enable support for SBI System Reset"
	depends on UBOOT_CONFIG_RISCV_SMODE && UBOOT_CONFIG_SBI_V02
	select UBOOT_CONFIG_SYSRESET_CMD_POWEROFF if CMD_POWEROFF
	help
	  Enable system reset and poweroff via the SBI system reset extension.
	  The extension was introduced in version 0.3 of the SBI specification.

	  If the SBI implementation provides the extension, is board specific.
	  The RISC-V platform specification mandates the extension for rich
	  operating system platforms.

config UBOOT_CONFIG_SYSRESET_SOCFPGA
	bool "Enable support for Intel SOCFPGA family"
	depends on UBOOT_CONFIG_ARCH_SOCFPGA && (TARGET_SOCFPGA_GEN5 || UBOOT_CONFIG_TARGET_SOCFPGA_ARRIA10)
	help
	  This enables the system reset driver support for Intel SOCFPGA SoCs
	  (Cyclone 5, Arria 5 and Arria 10).

config UBOOT_CONFIG_SYSRESET_SOCFPGA_SOC64
	bool "Enable support for Intel SOCFPGA SoC64 family (Stratix10/Agilex)"
	depends on UBOOT_CONFIG_ARCH_SOCFPGA && UBOOT_CONFIG_TARGET_SOCFPGA_SOC64
	help
	  This enables the system reset driver support for Intel SOCFPGA
	  SoC64 SoCs.

config UBOOT_CONFIG_SYSRESET_TI_SCI
	bool "TI System Control Interface (TI SCI) system reset driver"
	depends on UBOOT_CONFIG_TI_SCI_PROTOCOL
	help
	  This enables the system reset driver support over TI System Control
	  Interface available on some new TI's SoCs.

config UBOOT_CONFIG_SYSRESET_SYSCON
	bool "Enable support for mfd syscon reboot driver"
	select UBOOT_CONFIG_REGMAP
	select UBOOT_CONFIG_SYSCON
	help
	  Reboot support for generic SYSCON mapped register reset.

config UBOOT_CONFIG_SYSRESET_WATCHDOG
	bool "Enable support for watchdog reboot driver"
	select UBOOT_CONFIG_WDT
	help
	  Reboot support for generic watchdog reset.

config UBOOT_CONFIG_SYSRESET_WATCHDOG_AUTO
	bool "Automatically register first watchdog with sysreset"
	depends on UBOOT_CONFIG_SYSRESET_WATCHDOG
	help
	  If enabled, the first watchdog (as selected by the watchdog uclass)
	  will automatically be registered with the watchdog reboot driver.

config UBOOT_CONFIG_SYSRESET_RESETCTL
	bool "Enable support for reset controller reboot driver"
	select UBOOT_CONFIG_DM_RESET
	help
	  Reboot support using generic reset controller.

config UBOOT_CONFIG_SYSRESET_X86
	bool "Enable support for x86 processor reboot driver"
	depends on UBOOT_CONFIG_X86
	help
	  Reboot support for generic x86 processor reset.

config UBOOT_CONFIG_SYSRESET_SPL_X86
	bool "Enable support for x86 processor reboot driver in SPL"
	depends on UBOOT_CONFIG_X86
	help
	  Reboot support for generic x86 processor reset in SPL.

config UBOOT_CONFIG_SYSRESET_TPL_X86
	bool "Enable support for x86 processor reboot driver in TPL"
	depends on UBOOT_CONFIG_X86
	help
	  Reboot support for generic x86 processor reset in TPL.

config UBOOT_CONFIG_SYSRESET_MPC83XX
	bool "Enable support MPC83xx SoC family reboot driver"
	help
	  Reboot support for NXP MPC83xx SoCs.

endif

endmenu
```

## maxlinear/feed_uboot/open_uboot/config/drivers/tee/Kconfig
```kconfig
# Generic Trusted Execution Environment Configuration
config UBOOT_CONFIG_TEE
	bool "Trusted Execution Environment support"
	depends on (ARM && (ARM64 || UBOOT_CONFIG_CPU_V7A)) || UBOOT_CONFIG_SANDBOX
	select UBOOT_CONFIG_ARM_SMCCC if ARM
	help
	  This implements a generic interface towards a Trusted Execution
	  Environment (TEE). A TEE is a trusted OS running in some secure
	  environment, for example, TrustZone on ARM cpus, or a separate
	  secure co-processor etc. See also:
	  https://en.wikipedia.org/wiki/Trusted_execution_environment

if UBOOT_CONFIG_TEE

menu "TEE drivers"

config UBOOT_CONFIG_SANDBOX_TEE
	bool "Sandbox TEE emulator"
	depends on UBOOT_CONFIG_SANDBOX
	default y
	help
	  This emulates a generic TEE needed for testing including the AVB
	  TA. The emulation provides all callbacks of a regular TEE and
	  supports session and shared memory management. The AVB TA is
	  emulated with rollback indexes and device lock-state, the state
	  of the TA is only kept in RAM and will be reset on each boot.
	  The emulation only supports one open session at a time.
	  Interaction from the U-Boot command line in possible via the
	  "avb" commands.

source "optee/Kconfig"
source "broadcom/Kconfig"

endmenu

endif
```

## maxlinear/feed_uboot/open_uboot/config/drivers/tee/broadcom/Kconfig
```kconfig
config UBOOT_CONFIG_CHIMP_OPTEE
	bool "Enable secure ChiMP firmware loading"
	depends on UBOOT_CONFIG_OPTEE
	default y
	help
	  This driver is used to load bnxt firmware binary using OpTEE.
	  bnxt is Broadcom NetXtreme controller Ethernet card.
```

## maxlinear/feed_uboot/open_uboot/config/drivers/thermal/Kconfig
```kconfig
config UBOOT_CONFIG_DM_THERMAL
	bool "Driver support for thermal devices"
	help
	  Enable support for temperature-sensing devices. Some SoCs have on-chip
	  temperature sensors to permit warnings, speed throttling or even
	  automatic power-off when the temperature gets too high or low. Other
	  devices may be discrete but connected on a suitable bus.

config UBOOT_CONFIG_LGM_THERMAL
	bool "Lightning Mountain thermal driver"

if UBOOT_CONFIG_DM_THERMAL

config UBOOT_CONFIG_IMX_THERMAL
	bool "Temperature sensor driver for Freescale i.MX SoCs"
	depends on UBOOT_CONFIG_MX6 || UBOOT_CONFIG_MX7
	help
	  Support for Temperature Monitor (TEMPMON) found on Freescale i.MX SoCs.
          It supports one critical trip point and one passive trip point.  The
          cpufreq is used as the cooling device to throttle CPUs when the
          passive trip is crossed.

config UBOOT_CONFIG_IMX_SCU_THERMAL
	bool "Temperature sensor driver for NXP i.MX8"
	depends on UBOOT_CONFIG_ARCH_IMX8
	help
	  Support for Temperature sensors on NXP i.MX8.
	  It supports one critical trip point and one passive trip point. The
	  boot is hold to the cool device to throttle CPUs when the passive
	  trip is crossed

config UBOOT_CONFIG_IMX_TMU
        bool "Thermal Management Unit driver for NXP i.MX8M"
        depends on UBOOT_CONFIG_ARCH_IMX8M
        help
          Support for Temperature sensors on NXP i.MX8M.
          It supports one critical trip point and one passive trip point.
	  The boot is hold to the cool device to throttle CPUs when the
	  passive trip is crossed

config UBOOT_CONFIG_TI_DRA7_THERMAL
        bool "Temperature sensor driver for TI dra7xx SOCs"
        help
	 Enable thermal support for for the Texas Instruments DRA752 SoC family.
	 The driver supports reading CPU temperature.

endif # if DM_THERMAL
```
