## maxlinear/feed_uboot/open_uboot/config/drivers/timer/Kconfig
```kconfig
menu "Timer Support"

config UBOOT_CONFIG_TIMER
	bool "Enable driver model for timer drivers"
	depends on UBOOT_CONFIG_DM
	help
	  Enable driver model for timer access. It uses the same API as
	  lib/time.c, but now implemented by the uclass. The first timer
	  will be used. The timer is usually a 32 bits free-running up
	  counter. There may be no real tick, and no timer interrupt.

config UBOOT_CONFIG_SPL_TIMER
	bool "Enable driver model for timer drivers in SPL"
	depends on UBOOT_CONFIG_TIMER && UBOOT_CONFIG_SPL
	help
	  Enable support for timer drivers in SPL. These can be used to get
	  a timer value when in SPL, or perhaps for implementing a delay
	  function. This enables the drivers in drivers/timer as part of an
	  SPL build.

config UBOOT_CONFIG_TPL_TIMER
	bool "Enable driver model for timer drivers in TPL"
	depends on UBOOT_CONFIG_TIMER && UBOOT_CONFIG_TPL
	help
	  Enable support for timer drivers in TPL. These can be used to get
	  a timer value when in TPL, or perhaps for implementing a delay
	  function. This enables the drivers in drivers/timer as part of an
	  TPL build.

config UBOOT_CONFIG_TIMER_EARLY
	bool "Allow timer to be used early in U-Boot"
	depends on UBOOT_CONFIG_TIMER
	# initr_bootstage() requires a timer and is called before initr_dm()
	# so only the early timer is available
	default y if UBOOT_CONFIG_X86 && UBOOT_CONFIG_BOOTSTAGE
	help
	  In some cases the timer must be accessible before driver model is
	  active. Examples include when using CONFIG_TRACE to trace U-Boot's
	  execution before driver model is set up. Enable this option to
	  use an early timer. These functions must be supported by your timer
	  driver: timer_early_get_count() and timer_early_get_rate().

config UBOOT_CONFIG_AG101P_TIMER
	bool "AG101P timer support"
	depends on UBOOT_CONFIG_TIMER && UBOOT_CONFIG_NDS32
	help
	  Select this to enable a timer for AG01P devices.

config UBOOT_CONFIG_ALTERA_TIMER
	bool "Altera timer support"
	depends on UBOOT_CONFIG_TIMER
	help
	  Select this to enable a timer for Altera devices. Please find
	  details on the "Embedded Peripherals IP User Guide" of Altera.

config UBOOT_CONFIG_ANDES_PLMT_TIMER
	bool
	depends on UBOOT_CONFIG_RISCV_MMODE || UBOOT_CONFIG_SPL_RISCV_MMODE
	help
	  The Andes PLMT block holds memory-mapped mtime register
	  associated with timer tick.

config UBOOT_CONFIG_ARC_TIMER
	bool "ARC timer support"
	depends on UBOOT_CONFIG_TIMER && UBOOT_CONFIG_ARC && UBOOT_CONFIG_CLK
	help
	  Select this to enable built-in ARC timers.
	  ARC cores may have up to 2 built-in timers: timer0 and timer1,
	  usually at least one of them exists. Either of them is supported
	  in U-Boot.

config UBOOT_CONFIG_AST_TIMER
	bool "Aspeed ast2400/ast2500 timer support"
	depends on UBOOT_CONFIG_TIMER
	default y if UBOOT_CONFIG_ARCH_ASPEED
	help
	  Select this to enable timer for Aspeed ast2400/ast2500 devices.
	  This is a simple sys timer driver, it is compatible with lib/time.c,
	  but does not support any interrupts. Even though SoC has 8 hardware
	  counters, they are all treated as a single device by this driver.
	  This is mostly because they all share several registers which
	  makes it difficult to completely separate them.

config UBOOT_CONFIG_ATCPIT100_TIMER
	bool "ATCPIT100 timer support"
	depends on UBOOT_CONFIG_TIMER
	help
	  Select this to enable a ATCPIT100 timer which will be embedded
	  in AE3XX, AE250 boards.

config UBOOT_CONFIG_ATMEL_PIT_TIMER
	bool "Atmel periodic interval timer support"
	depends on UBOOT_CONFIG_TIMER
	help
	  Select this to enable a periodic interval timer for Atmel devices,
	  it is designed to offer maximum accuracy and efficient management,
	  even for systems with long response time.

config UBOOT_CONFIG_CADENCE_TTC_TIMER
	bool "Cadence TTC (Triple Timer Counter)"
	depends on UBOOT_CONFIG_TIMER
	help
	  Enables support for the cadence ttc driver. This driver is present
	  on Xilinx Zynq and ZynqMP SoCs.

config UBOOT_CONFIG_DESIGNWARE_APB_TIMER
	bool "Designware APB Timer"
	depends on UBOOT_CONFIG_TIMER
	help
	  Enables support for the Designware APB Timer driver. This timer is
	  present on Altera SoCFPGA SoCs.

config UBOOT_CONFIG_MPC83XX_TIMER
	bool "MPC83xx timer support"
	depends on UBOOT_CONFIG_TIMER
	help
	  Select this to enable support for the timer found on
	  devices based on the MPC83xx family of SoCs.

config UBOOT_CONFIG_RENESAS_OSTM_TIMER
	bool "Renesas RZ/A1 R7S72100 OSTM Timer"
	depends on UBOOT_CONFIG_TIMER
	help
	  Enables support for the Renesas OSTM Timer driver.
	  This timer is present on Renesas RZ/A1 R7S72100 SoCs.

config UBOOT_CONFIG_X86_TSC_TIMER_FREQ
	int "x86 TSC timer frequency in Hz"
	depends on UBOOT_CONFIG_X86_TSC_TIMER
	default 1000000000
	help
	  Sets the estimated CPU frequency in Hz when TSC is used as the
	  early timer and the frequency can neither be calibrated via some
	  hardware ways, nor got from device tree at the time when device
	  tree is not available yet.

config UBOOT_CONFIG_NOMADIK_MTU_TIMER
	bool "Nomadik MTU Timer"
	depends on UBOOT_CONFIG_TIMER
	help
	  Enables support for the Nomadik Multi Timer Unit (MTU),
	  used in ST-Ericsson Ux500 SoCs.
	  The MTU provides 4 decrementing free-running timers.
	  At the moment, only the first timer is used by the driver.

config UBOOT_CONFIG_OMAP_TIMER
	bool "Omap timer support"
	depends on UBOOT_CONFIG_TIMER
	help
	  Select this to enable an timer for Omap devices.

config UBOOT_CONFIG_RISCV_TIMER
	bool "RISC-V timer support"
	depends on UBOOT_CONFIG_TIMER && UBOOT_CONFIG_RISCV
	help
	  Select this to enable support for a generic RISC-V S-Mode timer
	  driver.

config UBOOT_CONFIG_ROCKCHIP_TIMER
	bool "Rockchip timer support"
	depends on UBOOT_CONFIG_TIMER
	help
	  Select this to enable support for the timer found on
	  Rockchip devices.

config UBOOT_CONFIG_SANDBOX_TIMER
	bool "Sandbox timer support"
	depends on UBOOT_CONFIG_SANDBOX && UBOOT_CONFIG_TIMER
	help
	  Select this to enable an emulated timer for sandbox. It gets
	  time from host os.

config UBOOT_CONFIG_STI_TIMER
	bool "STi timer support"
	depends on UBOOT_CONFIG_TIMER
	default y if UBOOT_CONFIG_ARCH_STI
	help
	  Select this to enable a timer for STi devices.

config UBOOT_CONFIG_STM32_TIMER
	bool "STM32 timer support"
	depends on UBOOT_CONFIG_TIMER
	help
	  Select this to enable support for the timer found on
	  STM32 devices.

config UBOOT_CONFIG_X86_TSC_TIMER
	bool "x86 Time-Stamp Counter (TSC) timer support"
	depends on UBOOT_CONFIG_TIMER && UBOOT_CONFIG_X86
	help
	  Select this to enable Time-Stamp Counter (TSC) timer for x86.

config UBOOT_CONFIG_X86_TSC_READ_BASE
	bool "Read the TSC timer base on start-up"
	depends on UBOOT_CONFIG_X86_TSC_TIMER
	help
	  On x86 platforms the TSC timer tick starts at the value 0 on reset.
	  This it makes no sense to read the timer on boot and use that as the
	  base, since we will miss some time taken to load U-Boot, etc. This
	  delay is controlled by the SoC and we cannot reduce it, but for
	  bootstage we want to record the time since reset as accurately as
	  possible.

	  The only exception is when U-Boot is used as a secondary bootloader,
	  where this option should be enabled.

config UBOOT_CONFIG_TPL_X86_TSC_TIMER_NATIVE
	bool "x86 TSC timer uses native calibration"
	depends on UBOOT_CONFIG_TPL && UBOOT_CONFIG_X86_TSC_TIMER
	help
	  Selects native timer calibration for TPL and don't include the other
	  methods in the code. This helps to reduce code size in TPL and works
	  on fairly modern Intel chips. Code-size reductions is about 700
	  bytes.

config UBOOT_CONFIG_MTK_TIMER
	bool "MediaTek timer support"
	depends on UBOOT_CONFIG_TIMER
	help
	  Select this to enable support for the timer found on
	  MediaTek devices.

config UBOOT_CONFIG_MCHP_PIT64B_TIMER
	bool "Microchip 64-bit periodic interval timer support"
	depends on UBOOT_CONFIG_TIMER
	help
	  Select this to enable support for Microchip 64-bit periodic
	  interval timer.

config UBOOT_CONFIG_IMX_GPT_TIMER
	bool "NXP i.MX GPT timer support"
	depends on UBOOT_CONFIG_TIMER
	help
	  Select this to enable support for the timer found on
	  NXP i.MX devices.

endmenu
```

## maxlinear/feed_uboot/open_uboot/config/drivers/usb/cdns3/Kconfig
```kconfig
config UBOOT_CONFIG_USB_CDNS3
	tristate "Cadence USB3 Dual-Role Controller"
	depends on UBOOT_CONFIG_USB_XHCI_HCD || UBOOT_CONFIG_USB_GADGET
	help
	  Say Y here if your system has a Cadence USB3 dual-role controller.
	  It supports: Host-only, and Peripheral-only.

if UBOOT_CONFIG_USB_CDNS3

config UBOOT_CONFIG_USB_CDNS3_GADGET
	bool "Cadence USB3 device controller"
	depends on UBOOT_CONFIG_USB_GADGET
	select UBOOT_CONFIG_USB_GADGET_DUALSPEED
	help
	  Say Y here to enable device controller functionality of the
	  Cadence USBSS-DEV driver.

	  This controller supports FF and HS mode. It doesn't support
	  LS and SSP mode.

config UBOOT_CONFIG_USB_CDNS3_HOST
	bool "Cadence USB3 host controller"
	depends on UBOOT_CONFIG_USB_XHCI_HCD
	help
	  Say Y here to enable host controller functionality of the
	  Cadence driver.

	  Host controller is compliant with XHCI so it will use
	  standard XHCI driver.

config UBOOT_CONFIG_SPL_USB_CDNS3_GADGET
	bool "SPL support for Cadence USB3 device controller"
	depends on UBOOT_CONFIG_SPL_USB_GADGET
	select UBOOT_CONFIG_USB_GADGET_DUALSPEED
	help
	  Say Y here to enable device controller functionality of the
	  Cadence USBSS-DEV driver in SPL.

	  This controller supports FF and HS mode. It doesn't support
	  LS and SSP mode.

config UBOOT_CONFIG_SPL_USB_CDNS3_HOST
	bool "Cadence USB3 host controller"
	depends on UBOOT_CONFIG_USB_XHCI_HCD && UBOOT_CONFIG_SPL_USB_HOST
	help
	  Say Y here to enable host controller functionality of the
	  Cadence driver.

	  Host controller is compliant with XHCI so it will use
	  standard XHCI driver.

config UBOOT_CONFIG_USB_CDNS3_TI
	tristate "Cadence USB3 support on TI platforms"
	default UBOOT_CONFIG_USB_CDNS3
	help
	  Say 'Y' here if you are building for Texas Instruments
	  platforms that contain Cadence USB3 controller core. E.g.: J721e.
endif
```

## maxlinear/feed_uboot/open_uboot/config/drivers/usb/emul/Kconfig
```kconfig
config UBOOT_CONFIG_USB_EMUL
	bool "Support for USB device emulation"
	depends on UBOOT_CONFIG_SANDBOX
	select UBOOT_CONFIG_DM_USB
	select UBOOT_CONFIG_USB_HOST
	help
	  Since sandbox does not have access to a real USB bus, it is possible
	  to use device emulators instead. This allows testing of the USB
	  stack on sandbox without needing a real device, or any host machine
	  USB resources.
```
