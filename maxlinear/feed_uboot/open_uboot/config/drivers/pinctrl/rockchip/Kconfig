## maxlinear/feed_uboot/open_uboot/config/drivers/pinctrl/rockchip/Kconfig
```kconfig
if UBOOT_CONFIG_ARCH_ROCKCHIP

config UBOOT_CONFIG_PINCTRL_ROCKCHIP
	bool "Rockchip pin control drivers"
	depends on UBOOT_CONFIG_ARCH_ROCKCHIP && UBOOT_CONFIG_PINCTRL_GENERIC
	default y
	help
	  Enable support pin control functions for Rockchip SoCs.

config UBOOT_CONFIG_SPL_PINCTRL_ROCKCHIP
	bool "Support Rockchip pin controllers in SPL"
	depends on UBOOT_CONFIG_ARCH_ROCKCHIP && UBOOT_CONFIG_SPL_PINCTRL_GENERIC
	default y
	help
	  This option is an SPL-variant of the PINCTRL_ROCKCHIP option.

endif
```

## maxlinear/feed_uboot/open_uboot/config/drivers/pinctrl/uniphier/Kconfig
```kconfig
if UBOOT_CONFIG_ARCH_UNIPHIER

config UBOOT_CONFIG_PINCTRL_UNIPHIER
	bool

config UBOOT_CONFIG_PINCTRL_UNIPHIER_LD4
	bool "UniPhier LD4 SoC pinctrl driver"
	depends on UBOOT_CONFIG_ARCH_UNIPHIER_LD4
	default y
	select UBOOT_CONFIG_PINCTRL_UNIPHIER

config UBOOT_CONFIG_PINCTRL_UNIPHIER_PRO4
	bool "UniPhier Pro4 SoC pinctrl driver"
	depends on UBOOT_CONFIG_ARCH_UNIPHIER_PRO4
	default y
	select UBOOT_CONFIG_PINCTRL_UNIPHIER

config UBOOT_CONFIG_PINCTRL_UNIPHIER_SLD8
	bool "UniPhier sLD8 SoC pinctrl driver"
	depends on UBOOT_CONFIG_ARCH_UNIPHIER_SLD8
	default y
	select UBOOT_CONFIG_PINCTRL_UNIPHIER

config UBOOT_CONFIG_PINCTRL_UNIPHIER_PRO5
	bool "UniPhier Pro5 SoC pinctrl driver"
	depends on UBOOT_CONFIG_ARCH_UNIPHIER_PRO5
	default y
	select UBOOT_CONFIG_PINCTRL_UNIPHIER

config UBOOT_CONFIG_PINCTRL_UNIPHIER_PXS2
	bool "UniPhier PXs2 SoC pinctrl driver"
	depends on UBOOT_CONFIG_ARCH_UNIPHIER_PXS2
	default y
	select UBOOT_CONFIG_PINCTRL_UNIPHIER

config UBOOT_CONFIG_PINCTRL_UNIPHIER_LD6B
	bool "UniPhier LD6b SoC pinctrl driver"
	depends on UBOOT_CONFIG_ARCH_UNIPHIER_LD6B
	default y
	select UBOOT_CONFIG_PINCTRL_UNIPHIER

config UBOOT_CONFIG_PINCTRL_UNIPHIER_LD11
	bool "UniPhier LD11 SoC pinctrl driver"
	depends on UBOOT_CONFIG_ARCH_UNIPHIER_LD11
	default y
	select UBOOT_CONFIG_PINCTRL_UNIPHIER

config UBOOT_CONFIG_PINCTRL_UNIPHIER_LD20
	bool "UniPhier LD20 SoC pinctrl driver"
	depends on UBOOT_CONFIG_ARCH_UNIPHIER_LD20
	default y
	select UBOOT_CONFIG_PINCTRL_UNIPHIER

config UBOOT_CONFIG_PINCTRL_UNIPHIER_PXS3
	bool "UniPhier PXs3 SoC pinctrl driver"
	depends on UBOOT_CONFIG_ARCH_UNIPHIER_PXS3
	default y
	select UBOOT_CONFIG_PINCTRL_UNIPHIER

endif
```

## maxlinear/feed_uboot/open_uboot/config/drivers/power/acpi_pmc/Kconfig
```kconfig
config UBOOT_CONFIG_ACPI_PMC
	bool "Power Manager (x86 PMC) support"
	help
	  Enable support for an x86-style power-management controller which
	  provides features including checking whether the system started from
	  resume, powering off the system and enabling/disabling the reset
	  mechanism.

config UBOOT_CONFIG_SPL_ACPI_PMC
	bool "Power Manager (x86 PMC) support in SPL"
	default y if UBOOT_CONFIG_ACPI_PMC
	help
	  Enable support for an x86-style power-management controller which
	  provides features including checking whether the system started from
	  resume, powering off the system and enabling/disabling the reset
	  mechanism.

config UBOOT_CONFIG_TPL_ACPI_PMC
	bool "Power Manager (x86 PMC) support in TPL"
	default y if UBOOT_CONFIG_ACPI_PMC
	help
	  Enable support for an x86-style power-management controller which
	  provides features including checking whether the system started from
	  resume, powering off the system and enabling/disabling the reset
	  mechanism.

config UBOOT_CONFIG_ACPI_PMC_SANDBOX
	bool "Test power manager (PMC) for sandbox"
	depends on UBOOT_CONFIG_ACPI_PMC && UBOOT_CONFIG_SANDBOX
	help
	  This driver emulates a PMC (Power-Management Controller) so that
	  the uclass logic can be tested. You can use the 'pmc' command to
	  access information from the driver. It uses I/O access to read
	  from the PMC.
```

## maxlinear/feed_uboot/open_uboot/config/drivers/ram/Kconfig
```kconfig
config UBOOT_CONFIG_RAM
	bool "Enable RAM drivers using Driver Model"
	depends on UBOOT_CONFIG_DM
	help
	  This allows drivers to be provided for SDRAM and other RAM
	  controllers and their type to be specified in the board's device
	  tree. Generally some parameters are required to set up the RAM and
	  the RAM size can either be statically defined or dynamically
	  detected.

config UBOOT_CONFIG_SPL_RAM
	bool "Enable RAM support in SPL"
	depends on UBOOT_CONFIG_RAM && UBOOT_CONFIG_SPL_DM
	help
	  The RAM subsystem adds a small amount of overhead to the image.
	  If this is acceptable and you have a need to use RAM drivers in
	  SPL, enable this option. It might provide a cleaner interface to
	  setting up RAM (e.g. SDRAM / DDR) within SPL.

config UBOOT_CONFIG_TPL_RAM
	bool "Enable RAM support in TPL"
	depends on UBOOT_CONFIG_RAM
	help
	  The RAM subsystem adds a small amount of overhead to the image.
	  If this is acceptable and you have a need to use RAM drivers in
	  TPL, enable this option. It might provide a cleaner interface to
	  setting up RAM (e.g. SDRAM / DDR) within TPL.

config UBOOT_CONFIG_STM32_SDRAM
	bool "Enable STM32 SDRAM support"
	depends on UBOOT_CONFIG_RAM
	help
	  STM32F7 family devices support flexible memory controller(FMC) to
	  support external memories like sdram, psram & nand.
	  This driver is for the sdram memory interface with the FMC.

config UBOOT_CONFIG_MPC83XX_SDRAM
	bool "Enable MPC83XX SDRAM support"
	depends on UBOOT_CONFIG_RAM
	help
	  Enable support for the internal DDR Memory Controller of the MPC83xx
	  family of SoCs. Both static configurations, as well as configuring
	  the RAM through the use of SPD (Serial Presence Detect) is supported
	  via device tree settings.

config UBOOT_CONFIG_K3_AM654_DDRSS
	bool "Enable AM654 DDRSS support"
	depends on UBOOT_CONFIG_RAM && UBOOT_CONFIG_SOC_K3_AM6
	help
	  K3 based AM654 devices has DDR memory subsystem that comprises
	  Synopys DDR controller, Synopsis DDR phy and wrapper logic to
	  intergrate these blocks into the device. This DDR subsystem
	  provides an interface to external SDRAM devices. Enabling this
	  config add support for the initialization of the external
	  SDRAM devices connected to DDR subsystem.

config UBOOT_CONFIG_K3_DDRSS
	bool "Enable K3 DDRSS support"
	depends on UBOOT_CONFIG_RAM

choice
	depends on UBOOT_CONFIG_K3_DDRSS
	prompt "K3 DDRSS Arch Support"

	default UBOOT_CONFIG_K3_J721E_DDRSS if UBOOT_CONFIG_SOC_K3_J721E
	default UBOOT_CONFIG_K3_AM64_DDRSS if UBOOT_CONFIG_SOC_K3_AM642

config UBOOT_CONFIG_K3_J721E_DDRSS
	bool "Enable J721E DDRSS support"
	help
	  The J721E DDR subsystem comprises DDR controller, DDR PHY and
	  wrapper logic to integrate these blocks in the device. The DDR
	  subsystem is used to provide an interface to external SDRAM
	  devices which can be utilized for storing program or data.
	  Enabling this config adds support for the DDR memory controller
	  on J721E family of SoCs.

config UBOOT_CONFIG_K3_AM64_DDRSS
	bool "Enable AM64 DDRSS support"
	help
	  The AM64 DDR subsystem comprises DDR controller, DDR PHY and
	  wrapper logic to integrate these blocks in the device. The DDR
	  subsystem is used to provide an interface to external SDRAM
	  devices which can be utilized for storing program or data.
	  Enabling this config adds support for the DDR memory controller
	  on AM642 family of SoCs.

endchoice

config UBOOT_CONFIG_IMXRT_SDRAM
	bool "Enable i.MXRT SDRAM support"
	depends on UBOOT_CONFIG_RAM
	help
	  i.MXRT family devices support smart external memory controller(SEMC)
	  to support external memories like sdram, psram & nand.
	  This driver is for the sdram memory interface with the SEMC.

source "aspeed/Kconfig"
source "rockchip/Kconfig"
source "sifive/Kconfig"
source "stm32mp1/Kconfig"
source "octeon/Kconfig"
```

## maxlinear/feed_uboot/open_uboot/config/drivers/ram/octeon/Kconfig
```kconfig
config UBOOT_CONFIG_RAM_OCTEON
	bool "Ram drivers for Octeon SoCs"
	depends on UBOOT_CONFIG_RAM && UBOOT_CONFIG_ARCH_OCTEON
	help
	 This enables support for RAM drivers for Octeon SoCs.

if UBOOT_CONFIG_RAM_OCTEON

config UBOOT_CONFIG_RAM_OCTEON_DDR4
	bool "Octeon III DDR4 RAM support"
	help
	 This enables support for DDR4 RAM suppoort for Octeon III.  This does
	 not include support for Octeon CN70XX.

endif # RAM_OCTEON
```

## maxlinear/feed_uboot/open_uboot/config/drivers/ram/rockchip/Kconfig
```kconfig
config UBOOT_CONFIG_RAM_ROCKCHIP
	bool "Ram drivers support for Rockchip SoCs"
	depends on UBOOT_CONFIG_RAM && UBOOT_CONFIG_ARCH_ROCKCHIP
	default y
	help
	  This enables support for ram drivers Rockchip SoCs.

config UBOOT_CONFIG_ROCKCHIP_SDRAM_COMMON
	bool "Enable rockchip sdram common driver"
	depends on UBOOT_CONFIG_TPL_RAM || UBOOT_CONFIG_SPL_RAM
	help
	  This enable sdram common driver

config UBOOT_CONFIG_RAM_ROCKCHIP_DEBUG
	bool "Rockchip ram drivers debugging"
	depends on UBOOT_CONFIG_RAM_ROCKCHIP
	default y
	help
	  This enables debugging ram driver API's for the platforms
	  based on Rockchip SoCs.

	  This is an option for developers to understand the ram drivers
	  initialization, configurations and etc.

config UBOOT_CONFIG_RAM_PX30_DDR4
	bool "DDR3 support for Rockchip PX30"
	depends on UBOOT_CONFIG_RAM_ROCKCHIP && UBOOT_CONFIG_ROCKCHIP_PX30
	help
	  This enables DDR4 sdram support instead of the default DDR3 support
	  on Rockchip PC30 SoCs.

config UBOOT_CONFIG_RAM_PX30_LPDDR2
	bool "LPDDR2 support for Rockchip PX30"
	depends on UBOOT_CONFIG_RAM_ROCKCHIP && UBOOT_CONFIG_ROCKCHIP_PX30
	help
	  This enables LPDDR2 sdram support instead of the default DDR3 support
	  on Rockchip PC30 SoCs.

config UBOOT_CONFIG_RAM_PX30_LPDDR3
	bool "LPDDR3 support for Rockchip PX30"
	depends on UBOOT_CONFIG_RAM_ROCKCHIP && UBOOT_CONFIG_ROCKCHIP_PX30
	help
	  This enables LPDDR3 sdram support instead of the default DDR3 support
	  on Rockchip PC30 SoCs.

config UBOOT_CONFIG_RAM_RK3399_LPDDR4
	bool "LPDDR4 support for Rockchip RK3399"
	depends on UBOOT_CONFIG_RAM_ROCKCHIP && UBOOT_CONFIG_ROCKCHIP_RK3399
	help
	  This enables LPDDR4 sdram code support for the platforms based
	  on Rockchip RK3399 SoC.
```

## maxlinear/feed_uboot/open_uboot/config/drivers/ram/sifive/Kconfig
```kconfig
config UBOOT_CONFIG_RAM_SIFIVE
	bool "Ram drivers support for SiFive SoCs"
	depends on UBOOT_CONFIG_RAM && UBOOT_CONFIG_RISCV
	default y
	help
	  This enables support for ram drivers of SiFive SoCs.

config UBOOT_CONFIG_SIFIVE_DDR
	bool "SiFive DDR driver"
	depends on UBOOT_CONFIG_RAM_SIFIVE
	default y if UBOOT_CONFIG_TARGET_SIFIVE_UNLEASHED || UBOOT_CONFIG_TARGET_SIFIVE_UNMATCHED
	help
	  This enables DDR support for the platforms based on SiFive SoC.
```
