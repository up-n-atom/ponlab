## maxlinear/feed_uboot/open_uboot/config/fs/Kconfig
```kconfig
#
# File system configuration
#

menu "File systems"

source "btrfs/Kconfig"

source "cbfs/Kconfig"

source "ext4/Kconfig"

source "reiserfs/Kconfig"

source "fat/Kconfig"

source "jffs2/Kconfig"

source "ubifs/Kconfig"

source "cramfs/Kconfig"

source "yaffs2/Kconfig"

source "squashfs/Kconfig"

endmenu
```
