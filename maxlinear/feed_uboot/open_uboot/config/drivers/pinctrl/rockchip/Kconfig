## maxlinear/feed_uboot/open_uboot/config/drivers/reset/Kconfig
```kconfig
menu "Reset Controller Support"

config UBOOT_CONFIG_DM_RESET
	bool "Enable reset controllers using Driver Model"
	depends on UBOOT_CONFIG_DM && UBOOT_CONFIG_OF_CONTROL
	help
	  Enable support for the reset controller driver class. Many hardware
	  modules are equipped with a reset signal, typically driven by some
	  reset controller hardware module within the chip. In U-Boot, reset
	  controller drivers allow control over these reset signals. In some
	  cases this API is applicable to chips outside the CPU as well,
	  although driving such reset isgnals using GPIOs may be more
	  appropriate in this case.

config UBOOT_CONFIG_SANDBOX_RESET
	bool "Enable the sandbox reset test driver"
	depends on UBOOT_CONFIG_DM_MAILBOX && UBOOT_CONFIG_SANDBOX
	help
	  Enable support for a test reset controller implementation, which
	  simply accepts requests to reset various HW modules without actually
	  doing anything beyond a little error checking.

config UBOOT_CONFIG_STI_RESET
	bool "Enable the STi reset"
	depends on UBOOT_CONFIG_ARCH_STI
	help
	  Support for reset controllers on STMicroelectronics STiH407 family SoCs.
	  Say Y if you want to control reset signals provided by system config
	  block.

config UBOOT_CONFIG_STM32_RESET
	bool "Enable the STM32 reset"
	depends on UBOOT_CONFIG_ARCH_STM32 || UBOOT_CONFIG_ARCH_STM32MP
	help
	  Support for reset controllers on STMicroelectronics STM32 family SoCs.
	  This reset driver is compatible with STM32 F4/F7 and H7 SoCs.

config UBOOT_CONFIG_TEGRA_CAR_RESET
	bool "Enable Tegra CAR-based reset driver"
	depends on UBOOT_CONFIG_TEGRA_CAR
	help
	  Enable support for manipulating Tegra's on-SoC reset signals via
	  direct register access to the Tegra CAR (Clock And Reset controller).

config UBOOT_CONFIG_TEGRA186_RESET
	bool "Enable Tegra186 BPMP-based reset driver"
	depends on UBOOT_CONFIG_TEGRA186_BPMP
	help
	  Enable support for manipulating Tegra's on-SoC reset signals via IPC
	  requests to the BPMP (Boot and Power Management Processor).

config UBOOT_CONFIG_RESET_TI_SCI
	bool "TI System Control Interface (TI SCI) reset driver"
	depends on UBOOT_CONFIG_DM_RESET && UBOOT_CONFIG_TI_SCI_PROTOCOL
	help
	  This enables the reset driver support over TI System Control Interface
	  available on some new TI's SoCs. If you wish to use reset resources
	  managed by the TI System Controller, say Y here. Otherwise, say N.

config UBOOT_CONFIG_RESET_BCM6345
	bool "Reset controller driver for BCM6345"
	depends on UBOOT_CONFIG_DM_RESET && UBOOT_CONFIG_ARCH_BMIPS
	help
	  Support reset controller on BCM6345.

config UBOOT_CONFIG_RESET_UNIPHIER
	bool "Reset controller driver for UniPhier SoCs"
	depends on UBOOT_CONFIG_ARCH_UNIPHIER
	default y
	help
	  Support for reset controllers on UniPhier SoCs.
	  Say Y if you want to control reset signals provided by System Control
	  block, Media I/O block, Peripheral Block.

config UBOOT_CONFIG_RESET_AST2500
	bool "Reset controller driver for AST2500 SoCs"
	depends on UBOOT_CONFIG_DM_RESET
	default y if UBOOT_CONFIG_ASPEED_AST2500
	help
	  Support for reset controller on AST2500 SoC.
	  Say Y if you want to control reset signals of different peripherals
	  through System Control Unit (SCU).

config UBOOT_CONFIG_RESET_AST2600
	bool "Reset controller driver for AST2600 SoCs"
	depends on UBOOT_CONFIG_DM_RESET
	default y if UBOOT_CONFIG_ASPEED_AST2600
	help
	  Support for reset controller on AST2600 SoC.
	  Say Y if you want to control reset signals of different peripherals
	  through System Control Unit (SCU).

config UBOOT_CONFIG_RESET_ROCKCHIP
	bool "Reset controller driver for Rockchip SoCs"
	depends on UBOOT_CONFIG_DM_RESET && UBOOT_CONFIG_ARCH_ROCKCHIP && UBOOT_CONFIG_CLK
	default y
	help
	  Support for reset controller on rockchip SoC. The main limitation
	  though is that some reset signals, like I2C or MISC reset multiple
	  devices.

config UBOOT_CONFIG_RESET_HSDK
	bool "Synopsys HSDK Reset Driver"
	depends on UBOOT_CONFIG_DM_RESET && UBOOT_CONFIG_TARGET_HSDK
	default y
	help
	  This enables the reset controller driver for HSDK board.

config UBOOT_CONFIG_RESET_MESON
	bool "Reset controller driver for Amlogic Meson SoCs"
	depends on UBOOT_CONFIG_DM_RESET && UBOOT_CONFIG_ARCH_MESON
	imply REGMAP
	default y
	help
	  Support for reset controller on Amlogic Meson SoC.

config UBOOT_CONFIG_RESET_SOCFPGA
	bool "Reset controller driver for SoCFPGA"
	depends on UBOOT_CONFIG_DM_RESET && UBOOT_CONFIG_ARCH_SOCFPGA
	default y
	help
	  Support for reset controller on SoCFPGA platform.

config UBOOT_CONFIG_RESET_MEDIATEK
	bool "Reset controller driver for MediaTek SoCs"
	depends on UBOOT_CONFIG_DM_RESET && UBOOT_CONFIG_ARCH_MEDIATEK && UBOOT_CONFIG_CLK
	default y
	help
	  Support for reset controller on MediaTek SoCs.

config UBOOT_CONFIG_RESET_MTMIPS
	bool "Reset controller driver for MediaTek MIPS platform"
	depends on UBOOT_CONFIG_DM_RESET && UBOOT_CONFIG_ARCH_MTMIPS
	default y
	help
	  Support for reset controller on MediaTek MIPS platform.

config UBOOT_CONFIG_RESET_SUNXI
	bool "RESET support for Allwinner SoCs"
	depends on UBOOT_CONFIG_DM_RESET && UBOOT_CONFIG_ARCH_SUNXI
	default y
	help
	  This enables support for common reset driver for
	  Allwinner SoCs.

config UBOOT_CONFIG_RESET_HISILICON
	bool "Reset controller driver for HiSilicon SoCs"
	depends on UBOOT_CONFIG_DM_RESET
	help
	  Support for reset controller on HiSilicon SoCs.

config UBOOT_CONFIG_RESET_IMX7
	bool "i.MX7/8 Reset Driver"
	depends on UBOOT_CONFIG_DM_RESET && (ARCH_MX7 || UBOOT_CONFIG_ARCH_IMX8M)
	default y
	help
	  Support for reset controller on i.MX7/8 SoCs.

config UBOOT_CONFIG_RESET_IPQ419
	bool "Reset driver for Qualcomm IPQ40xx SoCs"
	depends on UBOOT_CONFIG_DM_RESET && UBOOT_CONFIG_ARCH_IPQ40XX
	default y
	help
	  Support for reset controller on Qualcomm
	  IPQ40xx SoCs.

config UBOOT_CONFIG_RESET_SIFIVE
	bool "Reset Driver for SiFive SoC's"
	depends on UBOOT_CONFIG_DM_RESET && UBOOT_CONFIG_CLK_SIFIVE_PRCI && (TARGET_SIFIVE_UNLEASHED || UBOOT_CONFIG_TARGET_SIFIVE_UNMATCHED)
	default y
	help
	  PRCI module within SiFive SoC's provides mechanism to reset
	  different hw blocks like DDR, gemgxl. With this driver we leverage
	  U-Boot's reset framework to reset these hardware blocks.

config UBOOT_CONFIG_RESET_SYSCON
	bool "Enable generic syscon reset driver support"
	depends on UBOOT_CONFIG_DM_RESET
	help
	  Support generic syscon mapped register reset devices.

config UBOOT_CONFIG_RESET_RASPBERRYPI
	bool "Raspberry Pi 4 Firmware Reset Controller Driver"
	depends on UBOOT_CONFIG_DM_RESET && UBOOT_CONFIG_ARCH_BCM283X
	default UBOOT_CONFIG_USB_XHCI_PCI
	help
	  Raspberry Pi 4's co-processor controls some of the board's HW
	  initialization process, but it's up to Linux to trigger it when
	  relevant. This driver provides a reset controller capable of
	  interfacing with RPi4's co-processor and model these firmware
	  initialization routines as reset lines.

config UBOOT_CONFIG_RESET_SCMI
	bool "Enable SCMI reset domain driver"
	select UBOOT_CONFIG_SCMI_FIRMWARE
	help
	  Enable this option if you want to support reset controller
	  devices exposed by a SCMI agent based on SCMI reset domain
	  protocol communication with a SCMI server.

config UBOOT_CONFIG_RESET_ZYNQMP
	bool "Reset Driver for Xilinx ZynqMP SoC's"
	depends on UBOOT_CONFIG_DM_RESET && UBOOT_CONFIG_ZYNQMP_FIRMWARE
	help
	  Support for reset controller on Xilinx ZynqMP SoC. Driver is only
	  passing request via Xilinx firmware interface to TF-A and PMU
	  firmware.

endmenu
```

## maxlinear/feed_uboot/open_uboot/config/drivers/scsi/Kconfig
```kconfig
config UBOOT_CONFIG_SCSI
	bool "Support SCSI controllers"
	select UBOOT_CONFIG_HAVE_BLOCK_DEVICE
	help
	  This enables support for SCSI (Small Computer System Interface),
	  a parallel interface widely used with storage peripherals such as
	  hard drives and optical drives. The SCSI standards define physical
	  interfaces as well as protocols for controlling devices and
	  tranferring data.

config UBOOT_CONFIG_DM_SCSI
	bool "Support SCSI controllers with driver model"
	depends on UBOOT_CONFIG_BLK
	help
	  This option enables the SCSI (Small Computer System Interface) uclass
	  which supports SCSI and SATA HDDs. For every device configuration
	  (IDs/LUNs) a block device is created with RAW read/write and
	  filesystem support.
```

## maxlinear/feed_uboot/open_uboot/config/drivers/soc/Kconfig
```kconfig
menu "SOC (System On Chip) specific Drivers"

config UBOOT_CONFIG_SOC_DEVICE
	bool "Enable SoC Device ID drivers using Driver Model"
	help
	  This allows drivers to be provided for SoCs to help in identifying
	  the SoC in use and matching SoC attributes for selecting SoC
	  specific data. This is useful for other device drivers that may
	  need different parameters or quirks enabled depending on the
	  specific device variant in use.

config UBOOT_CONFIG_SOC_DEVICE_TI_K3
	depends on UBOOT_CONFIG_SOC_DEVICE
	bool "Enable SoC Device ID driver for TI K3 SoCs"
	help
	  This allows Texas Instruments Keystone 3 SoCs to identify
	  specifics about the SoC in use.

config UBOOT_CONFIG_SOC_XILINX_ZYNQMP
	bool "Enable SoC Device ID driver for Xilinx ZynqMP"
	depends on UBOOT_CONFIG_SOC_DEVICE && UBOOT_CONFIG_ARCH_ZYNQMP
	help
	  Enable this option to select SoC device id driver for Xilinx ZynqMP.
	  This allows other drivers to verify the SoC familiy & revision
	  using matching SoC attributes.

config UBOOT_CONFIG_SOC_XILINX_VERSAL
	bool "Enable SoC Device ID driver for Xilinx Versal"
	depends on UBOOT_CONFIG_SOC_DEVICE && UBOOT_CONFIG_ARCH_VERSAL
	help
	  Enable this option to select SoC device id driver for Xilinx Versal.
	  This allows other drivers to verify the SoC familiy & revision using
	  matching SoC attributes.

source "ti/Kconfig"

endmenu
```

## maxlinear/feed_uboot/open_uboot/config/drivers/sound/Kconfig
```kconfig
menu "Sound support"

config UBOOT_CONFIG_SOUND
	bool "Enable sound support"
	help
	  Support making sounds through an audio codec. This is normally a
	  beep at a chosen frequency for a selected length of time. However
	  the drivers support playing arbitrary sound samples using a
	  PCM interface.

	  Note: At present the sound setup is somewhat tangled up in that the
	  audio codecs are called from the sound-i2s code. This could be
	  converted to driver model.

config UBOOT_CONFIG_I2S
	bool "Enable I2S support"
	depends on UBOOT_CONFIG_SOUND
	help
	  I2S is a serial bus often used to transmit audio data from the
	  SoC to the audio codec. This option enables sound support using
	  I2S. It calls either of the two supported codecs (no use is made
	  of driver model at present).

config UBOOT_CONFIG_I2S_ROCKCHIP
	bool "Enable I2S support for Rockchip SoCs"
	depends on UBOOT_CONFIG_I2S
	help
	  Rockchip SoCs support an I2S interface for sending audio data to an
	  audio codec. This option enables support for this, using one of the
	  available audio codec drivers. This driver does not make use of
	  DMA, but writes each word directly to the hardware.

config UBOOT_CONFIG_I2S_SAMSUNG
	bool "Enable I2C support for Samsung SoCs"
	depends on UBOOT_CONFIG_I2S
	help
	  Samsung Exynos SoCs support an I2S interface for sending audio
	  data to an audio codec. This option enables support for this,
	  using one of the available audio codec drivers. Enabling this
	  option provides an implementation for sound_init() and
	  sound_play().

config UBOOT_CONFIG_SOUND_DA7219
	bool "Dialog Semiconductor audio codec"
	depends on UBOOT_CONFIG_SOUND
	help
	  The DA7219 is an ultra-low-power audio codec with Advanced Accessory
	  Detection (AAD). This driver only supports generation of ACPI tables.
	  It does not support sound output or any of the other codec
	  features.

config UBOOT_CONFIG_SOUND_I8254
	bool "Intel i8254 timer / beeper"
	depends on UBOOT_CONFIG_SOUND
	help
	  This enables support for a beeper that uses the i8254 timer chip.
	  This can emit beeps at a fixed frequency. It is possible to control
	  the length of the beeps, by turning a beep on, waiting for a period
	  of time, then turning it off.

	  This is quite an old feature, called PIT (Programmable Interval
	  Timer), but is nonetheless still available on modern x86 machines.

config UBOOT_CONFIG_SOUND_INTEL_HDA
	bool "Intel HDA audio codec"
	depends on UBOOT_CONFIG_SOUND
	help
	  Most Intel chips have an HDA (High-definition audio) codec which can
	  be used by U-Boot to play simple beeps. This is also sometimes called
	  Azalia which was the development code-name. It requires setup
	  information in the device tree (see intel-hda.txt).

config UBOOT_CONFIG_SOUND_IVYBRIDGE
	bool "Intel Ivybridge sound support"
	depends on UBOOT_CONFIG_SOUND
	select UBOOT_CONFIG_SOUND_INTEL_HDA
	help
	  Enable sound output on supported Intel Ivybridge-based boards. This
	  driver uses Intel's High-definition Audio (HDA) architecture,
	  sometimes called Azalia. The audio codec is detected using a
	  semi-automatic mechanism.

config UBOOT_CONFIG_I2S_TEGRA
	bool "Enable I2S support for Nvidia Tegra SoCs"
	depends on UBOOT_CONFIG_I2S
	select UBOOT_CONFIG_TEGRA124_DMA
	help
	  Nvidia Tegra SoCs support several I2S interfaces for sending audio
	  data to an audio codec. This option enables support for this,
	  using one of the available audio codec drivers.

config UBOOT_CONFIG_SOUND_MAX98088
	bool "Support Maxim max98088 audio codec"
	depends on UBOOT_CONFIG_I2S
	help
	  Enable the max98088 audio codec. This is connected via I2S for
	  audio data and I2C for codec control. At present it only works
	  with the Samsung I2S driver.

config UBOOT_CONFIG_SOUND_MAX98090
	bool "Support Maxim max98090 audio codec"
	depends on UBOOT_CONFIG_I2S
	help
	  Enable the max98090 audio codec. This is connected via I2S for
	  audio data and I2C for codec control. At present it only works
	  with the Samsung I2S driver.

config UBOOT_CONFIG_SOUND_MAX98095
	bool "Support Maxim max98095 audio codec"
	depends on UBOOT_CONFIG_I2S
	help
	  Enable the max98095 audio codec. This is connected via I2S for
	  audio data and I2C for codec control. At present it only works
	  with the Samsung I2S driver.

config UBOOT_CONFIG_SOUND_MAX98357A
	bool "Support Maxim max98357a audio codec"
	depends on UBOOT_CONFIG_PCI
	help
	  Enable the max98357a audio codec. This is connected on PCI for
	  audio data codec control. This is currently only capable of providing
	  ACPI information. A full driver (with sound in U-Boot) is currently
	  not available.

config UBOOT_CONFIG_SOUND_RT5677
	bool "Support Realtek RT5677 audio codec"
	depends on UBOOT_CONFIG_SOUND
	help
	  Enable the Realtek RT5677 audio codec. This is an I2S device used on
	  some Chromebooks from around 2015 ('auron'). It is configured using
	  an I2C interface and supports multiple sound inputs and outputs,
	  including digital microphones.

config UBOOT_CONFIG_SOUND_SANDBOX
	bool "Support sandbox emulated audio codec"
	depends on UBOOT_CONFIG_SANDBOX && UBOOT_CONFIG_SOUND
	help
	  U-Boot sandbox can emulate a sound device using SDL, playing the
	  sound on the host machine. This option implements the sound_init()
	  and sound_play() functions for sandbox. Note that you must install
	  the SDL libraries for this to work.

config UBOOT_CONFIG_SOUND_WM8994
	bool "Support Wolfson Micro wm8994 audio codec"
	depends on UBOOT_CONFIG_I2S_SAMSUNG
	help
	  Enable the wm8994 audio codec. This is connected via I2S for
	  audio data and I2C for codec control. At present it only works
	  with the Samsung I2S driver.

endmenu
```
