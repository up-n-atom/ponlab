## maxlinear/feed_uboot/open_uboot/config/drivers/usb/musb-new/Kconfig
```kconfig
#
# MUSB Controller Driver
#
comment "MUSB Controller Driver"

config UBOOT_CONFIG_USB_MUSB_HOST
	bool "MUSB host mode support"
	depends on UBOOT_CONFIG_DM && UBOOT_CONFIG_OF_CONTROL
	select UBOOT_CONFIG_SPL_SPRINTF if SPL
	select UBOOT_CONFIG_TPL_SPRINTF if TPL
	select UBOOT_CONFIG_USB_HOST
	help
	  Enables the MUSB USB dual-role controller in host mode.

config UBOOT_CONFIG_USB_MUSB_GADGET
	bool "MUSB gadget mode support"
	depends on UBOOT_CONFIG_USB_GADGET
	select UBOOT_CONFIG_USB_GADGET_DUALSPEED
	select UBOOT_CONFIG_SPL_SPRINTF if SPL
	select UBOOT_CONFIG_TPL_SPRINTF if TPL
	help
	  Enables the MUSB USB dual-role controller in gadget mode.

if UBOOT_CONFIG_USB_MUSB_HOST || UBOOT_CONFIG_USB_MUSB_GADGET
config UBOOT_CONFIG_USB_MUSB_DA8XX
	bool "Enable DA8xx MUSB Controller"
	depends on UBOOT_CONFIG_ARCH_DAVINCI
	help
	  Say y here to enable support for the dual role high
	  speed USB controller based on the Mentor Graphics
	  silicon IP.

config UBOOT_CONFIG_USB_MUSB_TI
	bool "Enable TI OTG USB controller"
	depends on UBOOT_CONFIG_AM33XX
	select UBOOT_CONFIG_USB_MUSB_DSPS
	help
	  Say y here to enable support for the dual role high
	  speed USB controller based on the Mentor Graphics
	  silicon IP.

config UBOOT_CONFIG_USB_MUSB_OMAP2PLUS
	tristate "OMAP2430 and onwards"
	depends on UBOOT_CONFIG_ARCH_OMAP2PLUS

config UBOOT_CONFIG_USB_MUSB_AM35X
	bool "AM35x"

config UBOOT_CONFIG_USB_MUSB_DSPS
	bool "TI DSPS platforms"

config UBOOT_CONFIG_USB_MUSB_MT85XX
	bool "Enable Mediatek MT85XX DRC USB controller"
	depends on UBOOT_CONFIG_ARCH_MEDIATEK
	help
	  Say y to enable Mediatek MT85XX USB DRC controller support
	  if it is available on your Mediatek MUSB IP based platform.
	  DMA controllers are ignored. This driver follow musb-new
	  driver and usb gadget framework.

config UBOOT_CONFIG_USB_MUSB_PIC32
	bool "Enable Microchip PIC32 DRC USB controller"
	depends on UBOOT_CONFIG_MACH_PIC32
	help
	  Say y to enable PIC32 USB DRC controller support
	  if it is available on your Microchip PIC32 platform.

config UBOOT_CONFIG_USB_MUSB_SUNXI
	bool "Enable sunxi OTG / DRC USB controller"
	depends on UBOOT_CONFIG_ARCH_SUNXI
	select UBOOT_CONFIG_USB_MUSB_PIO_ONLY
	default y
	---help---
	Say y here to enable support for the sunxi OTG / DRC USB controller
	used on almost all sunxi boards.

config UBOOT_CONFIG_USB_MUSB_UX500
	bool "Enable ST-Ericsson Ux500 USB controller"
	depends on UBOOT_CONFIG_DM_USB && UBOOT_CONFIG_DM_USB_GADGET && UBOOT_CONFIG_ARCH_U8500
	default y
	help
	  Say y to enable support for the MUSB OTG USB controller used in
	  ST-Ericsson Ux500. The driver supports either gadget or host mode
	  based on the selection of CONFIG_USB_MUSB_HOST.

config UBOOT_CONFIG_USB_MUSB_DISABLE_BULK_COMBINE_SPLIT
	bool "Disable MUSB bulk split/combine"
	default y
	help
	  On TI AM335x devices, MUSB has bulk split/combine feature enabled
	  in the ConfigData register, but the current MUSB driver does not
	  support it yet. Select this option to disable the feature until the
	  driver adds the support.

endif

config UBOOT_CONFIG_USB_MUSB_PIO_ONLY
	bool "Disable DMA (always use PIO)"
	default y if UBOOT_CONFIG_USB_MUSB_AM35X || UBOOT_CONFIG_USB_MUSB_PIC32 || UBOOT_CONFIG_USB_MUSB_OMAP2PLUS || UBOOT_CONFIG_USB_MUSB_DSPS || UBOOT_CONFIG_USB_MUSB_SUNXI || UBOOT_CONFIG_USB_MUSB_MT85XX || UBOOT_CONFIG_USB_MUSB_UX500
	help
	  All data is copied between memory and FIFO by the CPU.
	  DMA controllers are ignored.

config UBOOT_CONFIG_USB_MUSB_FIXED_CONFIGDATA
	bool "Hardcode MUSB CONFIGDATA register"
	depends on UBOOT_CONFIG_USB_MUSB_SUNXI
	default n if UBOOT_CONFIG_MACH_SUN4I || UBOOT_CONFIG_MACH_SUN5I || UBOOT_CONFIG_MACH_SUN6I || UBOOT_CONFIG_MACH_SUN7I || UBOOT_CONFIG_MACH_SUN8I_A23
	default y
	help
	  Newer Allwinner SoCs do not implement the MUSB_CONFIGDATA register,
	  so it always reads 0. Select this option to override this and
	  return a hardcoded value instead.
```

## maxlinear/feed_uboot/open_uboot/config/drivers/virtio/Kconfig
```kconfig
# SPDX-License-Identifier: GPL-2.0+
#
# Copyright (C) 2018, Tuomas Tynkkynen <tuomas.tynkkynen@iki.fi>
# Copyright (C) 2018, Bin Meng <bmeng.cn@gmail.com>
#
# VirtIO is a virtualization standard for network and disk device drivers
# where just the guest's device driver "knows" it is running in a virtual
# environment, and cooperates with the hypervisor. This enables guests to
# get high performance network and disk operations, and gives most of the
# performance benefits of paravirtualization. In the U-Boot case, the guest
# is U-Boot itself, while the virtual environment are normally QEMU targets
# like ARM, RISC-V and x86.
#
# See http://docs.oasis-open.org/virtio/virtio/v1.0/virtio-v1.0.pdf for
# the VirtIO specification v1.0.

menu "VirtIO Drivers"

config UBOOT_CONFIG_VIRTIO
	bool
	help
	  This option is selected by any driver which implements the virtio
	  transport, such as CONFIG_VIRTIO_MMIO or CONFIG_VIRTIO_PCI.

config UBOOT_CONFIG_VIRTIO_MMIO
	bool "Platform bus driver for memory mapped virtio devices"
	select UBOOT_CONFIG_VIRTIO
	help
	  This driver provides support for memory mapped virtio
	  platform device driver.

config UBOOT_CONFIG_VIRTIO_PCI
	bool "PCI driver for virtio devices"
	depends on UBOOT_CONFIG_PCI
	select UBOOT_CONFIG_VIRTIO
	help
	  This driver provides support for virtio based paravirtual device
	  drivers over PCI.

config UBOOT_CONFIG_VIRTIO_SANDBOX
	bool "Sandbox driver for virtio devices"
	depends on UBOOT_CONFIG_SANDBOX
	select UBOOT_CONFIG_VIRTIO
	help
	  This driver provides support for Sandbox implementation of virtio
	  transport driver which is used for testing purpose only.

config UBOOT_CONFIG_VIRTIO_NET
	bool "virtio net driver"
	depends on UBOOT_CONFIG_VIRTIO
	help
	  This is the virtual net driver for virtio. It can be used with
	  QEMU based targets.

config UBOOT_CONFIG_VIRTIO_BLK
	bool "virtio block driver"
	depends on UBOOT_CONFIG_VIRTIO
	depends on UBOOT_CONFIG_BLK
	help
	  This is the virtual block driver for virtio. It can be used with
	  QEMU based targets.

config UBOOT_CONFIG_VIRTIO_RNG
	bool "virtio rng driver"
	depends on UBOOT_CONFIG_DM_RNG
	depends on UBOOT_CONFIG_VIRTIO
	default y
	help
	  This is the virtual random number generator driver. It can be used
	  with QEMU based targets.
endmenu
```
