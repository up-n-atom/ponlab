// SPDX-License-Identifier: GPL-2.0
/*
 * Copyright (C) 2020-2024 MaxLinear, Inc.
 * Copyright (C) 2019-2020 Intel Corporation.
 *
 * This program is free software; you can redistribute it and/or modify it
 * under the terms of the GNU General Public License, as published by the Free
 * Software Foundation; either version 2 of the License, or (at your option)
 * any later version.
 *
 * This program is distributed in the hope that it will be useful, but WITHOUT
 * ANY WARRANTY; without even the implied warranty of MERCHANTABILITY or
 * FITNESS FOR A PARTICULAR PURPOSE.
 * See the GNU General Public License for more details.
 *
 * You should have received a copy of the GNU General Public License along
 * with this program; if not, see <http://www.gnu.org/licenses/>.
 */

&hsiol_xpcs1 {
	compatible = "mxl,lgm-xpcs-c10";
	phys = <&cb1phy0 PHY_TYPE_XPCS_DL>;
	mxl,cbphy_app = <&cb1phy0_app>;
	xpcs-mode = <0>;
	tx_vboost_lvl = <15 0 15 0 0 0 0 0>;
	rx_ctle_boost = <7 0 7 0 0 0 0 0>;
};

&hsior_xpcs1 {
	compatible = "mxl,lgm-xpcs-c10";
	phys = <&cb3phy0 PHY_TYPE_XPCS_DL>;
	mxl,cbphy_app = <&cb3phy0_app>;
	xpcs-mode = <0>;
	tx_vboost_lvl = <15 0 15 0 0 0 0 0>;
	rx_ctle_boost = <7 0 7 0 0 0 0 0>;
};
