// SPDX-License-Identifier: GPL-2.0
/*
 * Copyright (C) 2023 MaxLinear, Inc.
 */

/dts-v1/;
#include "octopus_641_base.dtsi"
#include "octopus_641_sfp_eth_wan.dtsi"
#include "octopus_641_pcie20.dtsi"
#include "octopus_emmc.dtsi"
#include "octopus_641_pm.dtsi"
#include "octopus_641_led.dtsi"
#include "voice.dtsi"
