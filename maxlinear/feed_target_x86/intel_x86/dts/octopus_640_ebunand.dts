// SPDX-License-Identifier: GPL-2.0
/*
 * Copyright (C) 2024 MaxLinear, Inc.
 * NAND flash model only support 1GB DDR.
 */

/dts-v1/;
#include "octopus_640_base.dtsi"
#include "lgmc_emta_1GB.dtsi"
#include "octopus_640_p34x_lan.dtsi"
#include "octopus_640_10g_phy_wan.dtsi"
#include "octopus_ebu_nand.dtsi"
#include "octopus_640_led.dtsi"
#include "octopus_640_gpy215.dtsi"
#include "octopus_640_gsw120.dtsi"
#include "voice.dtsi"
