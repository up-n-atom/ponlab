// SPDX-License-Identifier: GPL-2.0
/*
 * Copyright (C) 2023 MaxLinear, Inc.
 *
 * This program is free software; you can redistribute it and/or modify it
 * under the terms of the GNU General Public License, as published by the Free
 * Software Foundation; either version 2 of the License, or (at your option)
 * any later version.
 *
 * This program is distributed in the hope that it will be useful, but WITHOUT
 * ANY WARRANTY; without even the implied warranty of MERCHANTABILITY or
 * FITNESS FOR A PARTICULAR PURPOSE.
 * See the GNU General Public License for more details.
 *
 * You should have received a copy of the GNU General Public License along
 * with this program; if not, see <http://www.gnu.org/licenses/>.
 */

/dts-v1/;
#include "lgm_haps_datapath.dts"

&cqm_lgm {
       mxl,wav700 = <1>;
};

&combophy3 {
	status = "okay";
};

&pcie40 {
	status = "okay";
	intel,rst-interval = <100>;
	reset-gpios = <&gpio0 21 GPIO_ACTIVE_LOW>;
	num-lanes = <1>;
};
