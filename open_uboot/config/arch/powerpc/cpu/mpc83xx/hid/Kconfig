## open_uboot/config/board/AndesTech/ax25-ae350/Kconfig
```kconfig
if UBOOT_CONFIG_TARGET_AX25_AE350

config UBOOT_CONFIG_SYS_CPU
	default "ax25"

config UBOOT_CONFIG_SYS_BOARD
	default "ax25-ae350"

config UBOOT_CONFIG_SYS_VENDOR
	default "AndesTech"

config UBOOT_CONFIG_SYS_SOC
	default "ae350"

config UBOOT_CONFIG_SYS_CONFIG_NAME
	default "ax25-ae350"

config UBOOT_CONFIG_ENV_SIZE
	default 0x2000 if UBOOT_CONFIG_ENV_IS_IN_SPI_FLASH

config UBOOT_CONFIG_ENV_OFFSET
	default 0x140000 if UBOOT_CONFIG_ENV_IS_IN_SPI_FLASH

config UBOOT_CONFIG_SPL_TEXT_BASE
	default 0x800000

config UBOOT_CONFIG_SPL_OPENSBI_LOAD_ADDR
	default 0x01000000

config UBOOT_CONFIG_BOARD_SPECIFIC_OPTIONS # dummy
	def_bool y
	select UBOOT_CONFIG_RISCV_NDS
	select UBOOT_CONFIG_SUPPORT_SPL
	select UBOOT_CONFIG_BINMAN if SPL
	imply SMP
	imply SPL_RAM_SUPPORT
	imply SPL_RAM_DEVICE

endif
```

## open_uboot/config/board/BuR/brppt1/Kconfig
```kconfig
if UBOOT_CONFIG_TARGET_BRPPT1

config UBOOT_CONFIG_SYS_BOARD
	default "brppt1"

config UBOOT_CONFIG_SYS_VENDOR
	default "BuR"

config UBOOT_CONFIG_SYS_SOC
	default "am33xx"

config UBOOT_CONFIG_SYS_CONFIG_NAME
	default "brppt1"

endif
```

## open_uboot/config/board/BuR/brsmarc1/Kconfig
```kconfig
if UBOOT_CONFIG_TARGET_BRSMARC1

config UBOOT_CONFIG_SYS_BOARD
	default "brsmarc1"

config UBOOT_CONFIG_SYS_VENDOR
	default "BuR"

config UBOOT_CONFIG_SYS_SOC
	default "am33xx"

config UBOOT_CONFIG_SYS_CONFIG_NAME
	default "brsmarc1"

endif
```

## open_uboot/config/board/BuR/brxre1/Kconfig
```kconfig
if UBOOT_CONFIG_TARGET_BRXRE1

config UBOOT_CONFIG_SYS_BOARD
	default "brxre1"

config UBOOT_CONFIG_SYS_VENDOR
	default "BuR"

config UBOOT_CONFIG_SYS_SOC
	default "am33xx"

config UBOOT_CONFIG_SYS_CONFIG_NAME
	default "brxre1"

endif
```

## open_uboot/config/board/BuS/eb_cpu5282/Kconfig
```kconfig
if UBOOT_CONFIG_TARGET_EB_CPU5282

config UBOOT_CONFIG_SYS_CPU
	default "mcf52x2"

config UBOOT_CONFIG_SYS_BOARD
	default "eb_cpu5282"

config UBOOT_CONFIG_SYS_VENDOR
	default "BuS"

config UBOOT_CONFIG_SYS_CONFIG_NAME
	default "eb_cpu5282"

endif
```

## open_uboot/config/board/LaCie/net2big_v2/Kconfig
```kconfig
if UBOOT_CONFIG_TARGET_NET2BIG_V2

config UBOOT_CONFIG_SYS_BOARD
	default "net2big_v2"

config UBOOT_CONFIG_SYS_VENDOR
	default "LaCie"

config UBOOT_CONFIG_SYS_CONFIG_NAME
	default "lacie_kw"

endif
```

## open_uboot/config/board/LaCie/netspace_v2/Kconfig
```kconfig
if UBOOT_CONFIG_TARGET_NETSPACE_V2

config UBOOT_CONFIG_SYS_BOARD
	default "netspace_v2"

config UBOOT_CONFIG_SYS_VENDOR
	default "LaCie"

config UBOOT_CONFIG_SYS_CONFIG_NAME
	default "lacie_kw"

endif
```

## open_uboot/config/board/Marvell/dreamplug/Kconfig
```kconfig
if UBOOT_CONFIG_TARGET_DREAMPLUG

config UBOOT_CONFIG_SYS_BOARD
	default "dreamplug"

config UBOOT_CONFIG_SYS_VENDOR
	default "Marvell"

config UBOOT_CONFIG_SYS_CONFIG_NAME
	default "dreamplug"

endif
```

## open_uboot/config/board/Marvell/octeon_ebb7304/Kconfig
```kconfig
if UBOOT_CONFIG_TARGET_OCTEON_EBB7304

config UBOOT_CONFIG_SYS_BOARD
	string
	default "octeon_ebb7304"

config UBOOT_CONFIG_SYS_VENDOR
	string
	default "Marvell"

config UBOOT_CONFIG_SYS_CONFIG_NAME
	string
	default "octeon_ebb7304"

config UBOOT_CONFIG_DEFAULT_DEVICE_TREE
	string
	default "mrvl,octeon-ebb7304"

endif
```

## open_uboot/config/board/Marvell/octeontx/Kconfig
```kconfig
if UBOOT_CONFIG_TARGET_OCTEONTX_81XX || UBOOT_CONFIG_TARGET_OCTEONTX_83XX

config UBOOT_CONFIG_SYS_VENDOR
	string
	default	"Marvell"

config UBOOT_CONFIG_SYS_BOARD
	string
	default "octeontx"

config UBOOT_CONFIG_SYS_CONFIG_NAME
	default "octeontx_common"

endif
```

## open_uboot/config/board/Marvell/octeontx2/Kconfig
```kconfig
if UBOOT_CONFIG_TARGET_OCTEONTX2_95XX || UBOOT_CONFIG_TARGET_OCTEONTX2_96XX

config UBOOT_CONFIG_SYS_VENDOR
	string
	default	"Marvell"

config UBOOT_CONFIG_SYS_BOARD
	string
	default "octeontx2"

config UBOOT_CONFIG_SYS_CONFIG_NAME
	default "octeontx2_common"

endif
```

## open_uboot/config/board/Marvell/openrd/Kconfig
```kconfig
if UBOOT_CONFIG_TARGET_OPENRD

config UBOOT_CONFIG_SYS_BOARD
	default "openrd"

config UBOOT_CONFIG_SYS_VENDOR
	default "Marvell"

config UBOOT_CONFIG_SYS_CONFIG_NAME
	default "openrd"

endif
```
