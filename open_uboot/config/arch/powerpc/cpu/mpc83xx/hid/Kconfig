## open_uboot/config/arch/powerpc/cpu/mpc83xx/initreg/Kconfig.lcrr
```kconfig
menu "LCRR - Clock Ratio Register register"

if !ARCH_MPC8309 && !UBOOT_CONFIG_ARCH_MPC831X && !UBOOT_CONFIG_ARCH_MPC832X

choice
	prompt "DLL bypass"

config UBOOT_CONFIG_LCRR_DBYP_UNSET
	bool "Don't set value"

config UBOOT_CONFIG_LCRR_DBYP_PLL_ENABLED
	bool "PLL enabled"

config UBOOT_CONFIG_LCRR_DBYP_PLL_BYPASSED
	bool "PLL bypassed"

endchoice

endif

if UBOOT_CONFIG_ARCH_MPC834X || UBOOT_CONFIG_ARCH_MPC8360

choice
	prompt "Additional delay cycles for SDRAM control signals"

config UBOOT_CONFIG_LCRR_BUFCMDC_UNSET
	bool "Don't set value"

config UBOOT_CONFIG_LCRR_BUFCMDC_4
	bool "4"

config UBOOT_CONFIG_LCRR_BUFCMDC_1
	bool "1"

config UBOOT_CONFIG_LCRR_BUFCMDC_2
	bool "2"

config UBOOT_CONFIG_LCRR_BUFCMDC_3
	bool "3"

endchoice

choice
	prompt "Extended CAS latency"

config UBOOT_CONFIG_LCRR_ECL_UNSET
	bool "Don't set value"

config UBOOT_CONFIG_LCRR_ECL_4
	bool "4"

config UBOOT_CONFIG_LCRR_ECL_5
	bool "5"

config UBOOT_CONFIG_LCRR_ECL_6
	bool "6"

config UBOOT_CONFIG_LCRR_ECL_7
	bool "7"

endchoice

endif # ARCH_MPC834X || UBOOT_CONFIG_ARCH_MPC8360

if !ARCH_MPC8308

choice
	prompt "External address delay cycles"

config UBOOT_CONFIG_LCRR_EADC_UNSET
	bool "Don't set value"

config UBOOT_CONFIG_LCRR_EADC_4
	bool "4"

config UBOOT_CONFIG_LCRR_EADC_1
	bool "1"

config UBOOT_CONFIG_LCRR_EADC_2
	bool "2"

config UBOOT_CONFIG_LCRR_EADC_3
	bool "3"

endchoice

endif # !ARCH_MPC8308

choice
	prompt "System clock divider"

config UBOOT_CONFIG_LCRR_CLKDIV_UNSET
	bool "Don't set value"

config UBOOT_CONFIG_LCRR_CLKDIV_2
	bool "2"

config UBOOT_CONFIG_LCRR_CLKDIV_4
	bool "4"

config UBOOT_CONFIG_LCRR_CLKDIV_8
	bool "8"

endchoice

config UBOOT_CONFIG_LCRR_DBYP
	hex
	default 0x0 if UBOOT_CONFIG_LCRR_DBYP_UNSET || UBOOT_CONFIG_LCRR_DBYP_PLL_ENABLED
	default 0x80000000 if UBOOT_CONFIG_LCRR_DBYP_PLL_BYPASSED

config UBOOT_CONFIG_LCRR_BUFCMDC
	hex
	default 0x0 if UBOOT_CONFIG_LCRR_BUFCMDC_4 || UBOOT_CONFIG_LCRR_BUFCMDC_UNSET
	default 0x10000000 if UBOOT_CONFIG_LCRR_BUFCMDC_1
	default 0x20000000 if UBOOT_CONFIG_LCRR_BUFCMDC_2
	default 0x30000000 if UBOOT_CONFIG_LCRR_BUFCMDC_3

config UBOOT_CONFIG_LCRR_ECL
	hex
	default 0x0 if UBOOT_CONFIG_LCRR_ECL_4 || UBOOT_CONFIG_LCRR_ECL_UNSET
	default 0x1000000 if UBOOT_CONFIG_LCRR_ECL_5
	default 0x2000000 if UBOOT_CONFIG_LCRR_ECL_6
	default 0x3000000 if UBOOT_CONFIG_LCRR_ECL_7

config UBOOT_CONFIG_LCRR_EADC
	hex
	default 0x0 if UBOOT_CONFIG_LCRR_EADC_4 || UBOOT_CONFIG_LCRR_EADC_UNSET
	default 0x10000 if UBOOT_CONFIG_LCRR_EADC_1
	default 0x20000 if UBOOT_CONFIG_LCRR_EADC_2
	default 0x30000 if UBOOT_CONFIG_LCRR_EADC_3

config UBOOT_CONFIG_LCRR_CLKDIV
	hex
	default 0x0 if UBOOT_CONFIG_LCRR_CLKDIV_UNSET
	default 0x2 if UBOOT_CONFIG_LCRR_CLKDIV_2
	default 0x4 if UBOOT_CONFIG_LCRR_CLKDIV_4
	default 0x8 if UBOOT_CONFIG_LCRR_CLKDIV_8

endmenu
```
