## open_uboot/config/arch/powerpc/cpu/mpc8xx/Kconfig
```kconfig
menu "mpc8xx CPU"
	depends on UBOOT_CONFIG_MPC8xx

config UBOOT_CONFIG_SYS_CPU
	default "mpc8xx"

choice
	prompt "Target select"
	optional

config UBOOT_CONFIG_TARGET_MCR3000
	bool "Support MCR3000 board from CSSI"

endchoice

choice
	prompt "CPU select"
	default UBOOT_CONFIG_MPC866

config UBOOT_CONFIG_MPC866
	bool "MPC866"
	select UBOOT_CONFIG_SYS_CACHE_SHIFT_4

config UBOOT_CONFIG_MPC885
	bool "MPC885"
	select UBOOT_CONFIG_SYS_CACHE_SHIFT_4

endchoice

config 8xx_GCLK_FREQ
	int "CPU GCLK Frequency"

comment "Specific commands"

config UBOOT_CONFIG_CMD_IMMAP
	bool "Enable various commands to dump IMMR information"
	help
	  This enables various commands such as:

	    siuinfo - print System Interface Unit (SIU) registers
	    memcinfo - print Memory Controller registers

comment "Configuration Registers"

config UBOOT_CONFIG_SYS_SIUMCR
	hex "SIUMCR register"
	help
	  SIU Module Configuration (11-6)

config UBOOT_CONFIG_SYS_SYPCR
	hex "SYPCR register"
	help
	  System Protection Control (11-9)

config UBOOT_CONFIG_SYS_TBSCR
	hex "TBSCR register"
	help
	  Time Base Status and Control (11-26)

config UBOOT_CONFIG_SYS_PISCR
	hex "PISCR register"
	help
	  Periodic Interrupt Status and Control (11-31)

config UBOOT_CONFIG_SYS_PLPRCR_BOOL
	bool "Customise PLPRCR"

config UBOOT_CONFIG_SYS_PLPRCR
	hex "PLPRCR register"
	depends on UBOOT_CONFIG_SYS_PLPRCR_BOOL
	help
	  PLL, Low-Power, and Reset Control Register (15-30)

config UBOOT_CONFIG_SYS_SCCR
	hex "SCCR register"
	help
	  System Clock and reset Control Register (15-27)

config UBOOT_CONFIG_SYS_SCCR_MASK
	hex "MASK for setting SCCR register"

config UBOOT_CONFIG_SYS_DER
	hex "DER register"
	help
	  Debug Event Register (37-47)

comment "Memory mapping"

config UBOOT_CONFIG_SYS_BR0_PRELIM
	hex "Preliminary value for BR0"

config UBOOT_CONFIG_SYS_OR0_PRELIM
	hex "Preliminary value for OR0"

config UBOOT_CONFIG_SYS_BR1_PRELIM_BOOL
	bool "Define Bank 1"

config UBOOT_CONFIG_SYS_BR1_PRELIM
	hex "Preliminary value for BR1"
	depends on UBOOT_CONFIG_SYS_BR1_PRELIM_BOOL

config UBOOT_CONFIG_SYS_OR1_PRELIM
	hex "Preliminary value for OR1"
	depends on UBOOT_CONFIG_SYS_BR1_PRELIM_BOOL

config UBOOT_CONFIG_SYS_BR2_PRELIM_BOOL
	bool "Define Bank 2"

config UBOOT_CONFIG_SYS_BR2_PRELIM
	hex "Preliminary value for BR2"
	depends on UBOOT_CONFIG_SYS_BR2_PRELIM_BOOL

config UBOOT_CONFIG_SYS_OR2_PRELIM
	hex "Preliminary value for OR2"
	depends on UBOOT_CONFIG_SYS_BR2_PRELIM_BOOL

config UBOOT_CONFIG_SYS_BR3_PRELIM_BOOL
	bool "Define Bank 3"

config UBOOT_CONFIG_SYS_BR3_PRELIM
	hex "Preliminary value for BR3"
	depends on UBOOT_CONFIG_SYS_BR3_PRELIM_BOOL

config UBOOT_CONFIG_SYS_OR3_PRELIM
	hex "Preliminary value for OR3"
	depends on UBOOT_CONFIG_SYS_BR3_PRELIM_BOOL

config UBOOT_CONFIG_SYS_BR4_PRELIM_BOOL
	bool "Define Bank 4"

config UBOOT_CONFIG_SYS_BR4_PRELIM
	hex "Preliminary value for BR4"
	depends on UBOOT_CONFIG_SYS_BR4_PRELIM_BOOL

config UBOOT_CONFIG_SYS_OR4_PRELIM
	hex "Preliminary value for OR4"
	depends on UBOOT_CONFIG_SYS_BR4_PRELIM_BOOL

config UBOOT_CONFIG_SYS_BR5_PRELIM_BOOL
	bool "Define Bank 5"

config UBOOT_CONFIG_SYS_BR5_PRELIM
	hex "Preliminary value for BR5"
	depends on UBOOT_CONFIG_SYS_BR5_PRELIM_BOOL

config UBOOT_CONFIG_SYS_OR5_PRELIM
	hex "Preliminary value for OR5"
	depends on UBOOT_CONFIG_SYS_BR5_PRELIM_BOOL

config UBOOT_CONFIG_SYS_BR6_PRELIM_BOOL
	bool "Define Bank 6"

config UBOOT_CONFIG_SYS_BR6_PRELIM
	hex "Preliminary value for BR6"
	depends on UBOOT_CONFIG_SYS_BR6_PRELIM_BOOL

config UBOOT_CONFIG_SYS_OR6_PRELIM
	hex "Preliminary value for OR6"
	depends on UBOOT_CONFIG_SYS_BR6_PRELIM_BOOL

config UBOOT_CONFIG_SYS_BR7_PRELIM_BOOL
	bool "Define Bank 7"

config UBOOT_CONFIG_SYS_BR7_PRELIM
	hex "Preliminary value for BR7"
	depends on UBOOT_CONFIG_SYS_BR7_PRELIM_BOOL

config UBOOT_CONFIG_SYS_OR7_PRELIM
	hex "Preliminary value for OR7"
	depends on UBOOT_CONFIG_SYS_BR7_PRELIM_BOOL

config UBOOT_CONFIG_SYS_IMMR
	hex "Value for IMMR"

source "../../../../board/cssi/MCR3000/Kconfig"

endmenu
```

## open_uboot/config/arch/riscv/cpu/ax25/Kconfig
```kconfig
config UBOOT_CONFIG_RISCV_NDS
	bool
	select UBOOT_CONFIG_ARCH_EARLY_INIT_R
	imply CPU
	imply CPU_RISCV
	imply RISCV_TIMER if (RISCV_SMODE || UBOOT_CONFIG_SPL_RISCV_SMODE)
	imply ANDES_PLIC if (RISCV_MMODE || UBOOT_CONFIG_SPL_RISCV_MMODE)
	imply ANDES_PLMT_TIMER if (RISCV_MMODE || UBOOT_CONFIG_SPL_RISCV_MMODE)
	imply SPL_CPU
	imply SPL_OPENSBI
	imply SPL_LOAD_FIT
	help
	  Run U-Boot on AndeStar V5 platforms and use some specific features
	  which are provided by Andes Technology AndeStar V5 families.

if UBOOT_CONFIG_RISCV_NDS

config UBOOT_CONFIG_RISCV_NDS_CACHE
	bool "AndeStar V5 families specific cache support"
	depends on UBOOT_CONFIG_RISCV_MMODE || UBOOT_CONFIG_SPL_RISCV_MMODE
	help
	  Provide Andes Technology AndeStar V5 families specific cache support.

endif
```

## open_uboot/config/arch/sandbox/Kconfig
```kconfig
menu "Sandbox architecture"
	depends on UBOOT_CONFIG_SANDBOX

config UBOOT_CONFIG_ARCH_MAP_SYSMEM
	def_bool y

config UBOOT_CONFIG_SYS_ARCH
	default "sandbox"

config UBOOT_CONFIG_SYS_BOARD
	default "sandbox"

config UBOOT_CONFIG_SYS_CPU
	default "sandbox"

config UBOOT_CONFIG_SANDBOX64
	bool "Use 64-bit addresses"
	select UBOOT_CONFIG_PHYS_64BIT
	select UBOOT_CONFIG_HOST_64BIT

config UBOOT_CONFIG_SANDBOX_RAM_SIZE_MB
	int "RAM size in MiB"
	default 128
	range 64 4095 if !SANDBOX64
	range 64 268435456 if SANDBOX64
	help
	  Memory size of the sandbox in MiB. The default value is 128 MiB.
	  The minimum value is 64 MiB. The maximum value is 4095 MiB for the
	  32bit sandbox.

config UBOOT_CONFIG_SANDBOX_SPL
	bool "Enable SPL for sandbox"
	select UBOOT_CONFIG_SUPPORT_SPL

config UBOOT_CONFIG_SYS_CONFIG_NAME
	default "sandbox_spl" if UBOOT_CONFIG_SANDBOX_SPL
	default "sandbox" if ! UBOOT_CONFIG_SANDBOX_SPL

choice
	prompt "Run sandbox on 32/64-bit host"
	default UBOOT_CONFIG_HOST_64BIT
	help
	  Sandbox can be built on 32-bit and 64-bit hosts.
	  The default is to build on a 64-bit host and run
	  on a 64-bit host. If you want to run sandbox on
	  a 32-bit host, change it here.

config UBOOT_CONFIG_HOST_32BIT
	bool "32-bit host"
	depends on !UBOOT_CONFIG_PHYS_64BIT

config UBOOT_CONFIG_HOST_64BIT
	bool "64-bit host"

endchoice

config UBOOT_CONFIG_SANDBOX_CRASH_RESET
	bool "Reset on crash"
	help
	  If an illegal instruction or an illegal memory access occurs, the
	  sandbox by default writes a crash dump and exits. If you set this
	  flag, the sandbox is reset instead. This may be useful when running
	  test suites like the UEFI self certification test which continue
	  with the next test after a crash.

config UBOOT_CONFIG_SANDBOX_BITS_PER_LONG
	int
	default 32 if UBOOT_CONFIG_HOST_32BIT
	default 64 if UBOOT_CONFIG_HOST_64BIT

endmenu
```

## open_uboot/config/arch/sh/Kconfig
```kconfig
menu "SuperH architecture"
	depends on UBOOT_CONFIG_SH

config UBOOT_CONFIG_CPU_SH4
	bool

choice
	prompt "Target select"
	optional

config UBOOT_CONFIG_TARGET_R2DPLUS
	bool "Renesas R2D-PLUS"
	select UBOOT_CONFIG_CPU_SH4

endchoice

config UBOOT_CONFIG_SYS_ARCH
	default "sh"

config UBOOT_CONFIG_SYS_CPU
	default "sh4" if UBOOT_CONFIG_CPU_SH4

source "lib/Kconfig"

source "../../board/renesas/r2dplus/Kconfig"

endmenu
```

## open_uboot/config/arch/x86/cpu/apollolake/Kconfig
```kconfig
# SPDX-License-Identifier: GPL-2.0
#
# Copyright 2019 Google LLC
#

config UBOOT_CONFIG_INTEL_APOLLOLAKE
	bool
	select UBOOT_CONFIG_FSP_VERSION2
	select UBOOT_CONFIG_HAVE_FSP
	select UBOOT_CONFIG_ARCH_MISC_INIT
	select UBOOT_CONFIG_USE_CAR
	select UBOOT_CONFIG_INTEL_SOC
	select UBOOT_CONFIG_INTEL_PMC
	select UBOOT_CONFIG_TPL_X86_TSC_TIMER_NATIVE
	select UBOOT_CONFIG_SPL_PCH
	select UBOOT_CONFIG_TPL_PCH
	select UBOOT_CONFIG_PCIEX_LENGTH_256MB
	select UBOOT_CONFIG_PCH
	select UBOOT_CONFIG_P2SB
	select UBOOT_CONFIG_SMP_AP_WORK
	select UBOOT_CONFIG_INTEL_GMA_SWSMISCI
	select UBOOT_CONFIG_ACPI_GNVS_EXTERNAL
	select UBOOT_CONFIG_TPL_OF_PLATDATA_PARENT
	select UBOOT_CONFIG_TPL_OF_PLATDATA_INST
	select UBOOT_CONFIG_TPL_READ_ONLY
	imply ENABLE_MRC_CACHE
	imply AHCI_PCI
	imply SCSI
	imply SCSI_AHCI
	imply SPI_FLASH
	imply USB
	imply USB_EHCI_HCD
	imply TPL
	imply SPL
	imply TPL_X86_16BIT_INIT
	imply TPL_OF_PLATDATA
	imply ACPI_PMC
	imply MMC
	imply DM_MMC
	imply MMC_PCI
	imply MMC_SDHCI
	imply CMD_MMC
	imply VIDEO_FSP
	imply PINCTRL_INTEL
	imply PINCTRL_INTEL_APL
	imply HAVE_VBT
	imply HAVE_X86_FIT
	imply INTEL_GPIO
	imply SMP
	imply HAVE_ITSS
	imply HAVE_P2SB
	imply CLK
	imply CMD_CLK
	imply CLK_INTEL
	imply ACPI_GPE
	imply INTEL_GMA_ACPI

if UBOOT_CONFIG_INTEL_APOLLOLAKE

config UBOOT_CONFIG_DCACHE_RAM_BASE
	default 0xfef00000

config UBOOT_CONFIG_DCACHE_RAM_SIZE
	default 0xc0000

config UBOOT_CONFIG_DCACHE_RAM_MRC_VAR_SIZE
	default 0xb0000

config UBOOT_CONFIG_CPU_SPECIFIC_OPTIONS
	def_bool y
	select UBOOT_CONFIG_SMM_TSEG
	select UBOOT_CONFIG_X86_RAMTEST

config UBOOT_CONFIG_SMM_TSEG_SIZE
	hex
	default 0x800000

config UBOOT_CONFIG_MMCONF_BASE_ADDRESS
	hex
	default 0xe0000000

config UBOOT_CONFIG_TPL_SIZE_LIMIT
	default 0x7800

config UBOOT_CONFIG_CPU_ADDR_BITS
	default 39

config UBOOT_CONFIG_APL_SPI_FLASH_BOOT
	bool "Support booting with SPI-flash driver instead memory-mapped SPI"
	select UBOOT_CONFIG_TPL_SPI_FLASH_SUPPORT
	select UBOOT_CONFIG_TPL_SPI
	select UBOOT_CONFIG_TPL_DM_SPI
	select UBOOT_CONFIG_TPL_DM_SPI_FLASH
	help
	  This enables SPI and SPI flash in TPL. Without the this only
	  available boot method is to use memory-mapped SPI. Since this is
	  actually fast and produces a TPL which is 7KB smaller, memory-mapped
	  SPI is the default.

config UBOOT_CONFIG_APL_BOOT_FROM_FAST_SPI_FLASH
	bool "Boot using SPI flash driver"
	select UBOOT_CONFIG_APL_SPI_FLASH_BOOT
	help
	  This option is separate from APL_SPI_FLASH_BOOT since it is useful to
	  be able to compare booting speed with the same build. Enable this to
	  use the SPI-flash driver to load SPL, U-Boot and FSP-M. For technical
	  reasons FSP-S is currently always loaded from memory-mapped SPI. See
	  Apollo Lake's arch_fsp_init_r() for details about that.

config UBOOT_CONFIG_VBT_ADDR
	default 0xff3f1000

endif
```

## open_uboot/config/arch/x86/cpu/broadwell/Kconfig
```kconfig
# SPDX-License-Identifier: GPL-2.0
#
# Copyright (C) 2016 Google Inc.
#

config UBOOT_CONFIG_INTEL_BROADWELL
	bool
	select UBOOT_CONFIG_CACHE_MRC_BIN
	select UBOOT_CONFIG_ARCH_EARLY_INIT_R
	imply HAVE_INTEL_ME
	imply ENABLE_MRC_CACHE
	imply AHCI_PCI
	imply ICH_SPI
	imply INTEL_BROADWELL_GPIO
	imply SCSI
	imply SCSI_AHCI
	imply SPI_FLASH
	imply USB
	imply USB_EHCI_HCD
	imply VIDEO_BROADWELL_IGD

if UBOOT_CONFIG_INTEL_BROADWELL

config UBOOT_CONFIG_DCACHE_RAM_BASE
	default 0xff7c0000

config UBOOT_CONFIG_DCACHE_RAM_SIZE
	default 0x40000

config UBOOT_CONFIG_DCACHE_RAM_MRC_VAR_SIZE
	default 0x30000

config UBOOT_CONFIG_CPU_SPECIFIC_OPTIONS
	def_bool y
	select UBOOT_CONFIG_SMM_TSEG
	select UBOOT_CONFIG_X86_RAMTEST

config UBOOT_CONFIG_SMM_TSEG_SIZE
	hex
	default 0x800000

endif
```

## open_uboot/config/arch/x86/cpu/efi/Kconfig
```kconfig
if UBOOT_CONFIG_EFI

config UBOOT_CONFIG_SYS_CAR_ADDR
	hex
	default 0x100000

config UBOOT_CONFIG_SYS_CAR_SIZE
	hex
	default 0x20000

endif
```

## open_uboot/config/arch/x86/cpu/quark/Kconfig
```kconfig
# SPDX-License-Identifier: GPL-2.0+
#
# Copyright (C) 2015, Bin Meng <bmeng.cn@gmail.com>

config UBOOT_CONFIG_INTEL_QUARK
	bool
	select UBOOT_CONFIG_HAVE_RMU
	select UBOOT_CONFIG_ARCH_EARLY_INIT_R
	select UBOOT_CONFIG_ARCH_MISC_INIT
	imply ENABLE_MRC_CACHE
	imply ETH_DESIGNWARE
	imply ICH_SPI
	imply INTEL_ICH6_GPIO
	imply MMC
	imply MMC_PCI
	imply MMC_SDHCI
	imply MMC_SDHCI_SDMA
	imply SPI_FLASH
	imply SYS_NS16550
	imply USB
	imply USB_EHCI_HCD

if UBOOT_CONFIG_INTEL_QUARK

config UBOOT_CONFIG_HAVE_RMU
	bool "Add a Remote Management Unit (RMU) binary"
	help
	  Select this option to add a Remote Management Unit (RMU) binary
	  to the resulting U-Boot image. It is a data block (up to 64K) of
	  machine-specific code which must be put in the flash for the RMU
	  within the Quark SoC processor to access when powered up before
	  system BIOS is executed.

config UBOOT_CONFIG_RMU_FILE
	string "Remote Management Unit (RMU) binary filename"
	depends on UBOOT_CONFIG_HAVE_RMU
	default "rmu.bin"
	help
	  The filename of the file to use as Remote Management Unit (RMU)
	  binary in the board directory.

config UBOOT_CONFIG_RMU_ADDR
	hex "Remote Management Unit (RMU) binary location"
	depends on UBOOT_CONFIG_HAVE_RMU
	default 0xfff00000
	help
	  The location of the RMU binary is determined by a strap. It must be
	  put in flash at a location matching the strap-determined base address.

	  The default base address of 0xfff00000 indicates that the binary must
	  be located at offset 0 from the beginning of a 1MB flash device.

config UBOOT_CONFIG_HAVE_CMC
	bool
	default UBOOT_CONFIG_HAVE_RMU

config UBOOT_CONFIG_CMC_FILE
	string
	depends on UBOOT_CONFIG_HAVE_CMC
	default UBOOT_CONFIG_RMU_FILE

config UBOOT_CONFIG_CMC_ADDR
	hex
	depends on UBOOT_CONFIG_HAVE_CMC
	default UBOOT_CONFIG_RMU_ADDR

config UBOOT_CONFIG_ESRAM_BASE
	hex
	default 0x80000000
	help
	  Embedded SRAM (eSRAM) memory-mapped base address.

config UBOOT_CONFIG_PCIE_ECAM_BASE
	hex
	default 0xe0000000

config UBOOT_CONFIG_RCBA_BASE
	hex
	default 0xfed1c000
	help
	  Root Complex register block memory-mapped base address.

config UBOOT_CONFIG_ACPI_PM1_BASE
	hex
	default 0x1000
	help
	  ACPI Power Management 1 (PM1) i/o-mapped base address.
	  This device is defined in ACPI specification, with 16 bytes in size.

config UBOOT_CONFIG_ACPI_PBLK_BASE
	hex
	default 0x1010
	help
	  ACPI Processor Block (PBLK) i/o-mapped base address.
	  This device is defined in ACPI specification, with 16 bytes in size.

config UBOOT_CONFIG_SPI_DMA_BASE
	hex
	default 0x1020
	help
	  SPI DMA i/o-mapped base address.

config UBOOT_CONFIG_GPIO_BASE
	hex
	default 0x1080
	help
	  GPIO i/o-mapped base address.

config UBOOT_CONFIG_ACPI_GPE0_BASE
	hex
	default 0x1100
	help
	  ACPI General Purpose Event 0 (GPE0) i/o-mapped base address.
	  This device is defined in ACPI specification, with 64 bytes in size.

config UBOOT_CONFIG_WDT_BASE
	hex
	default 0x1140
	help
	  Watchdog timer i/o-mapped base address.

config UBOOT_CONFIG_SYS_CAR_ADDR
	hex
	default UBOOT_CONFIG_ESRAM_BASE

config UBOOT_CONFIG_SYS_CAR_SIZE
	hex
	default 0x8000
	help
	  Space in bytes in eSRAM used as Cache-As-ARM (CAR).
	  Note this size must not exceed eSRAM's total size.

config UBOOT_CONFIG_X86_TSC_TIMER_FREQ
	int
	default 400000000

endif
```

## open_uboot/config/arch/x86/cpu/tangier/Kconfig
```kconfig
# SPDX-License-Identifier: GPL-2.0+
#
# Copyright (c) 2017 Intel Corporation

config UBOOT_CONFIG_INTEL_TANGIER
	bool
	depends on UBOOT_CONFIG_INTEL_MID
	imply INTEL_MID_SERIAL
	imply MMC
	imply MMC_SDHCI
	imply MMC_SDHCI_SDMA
	imply MMC_SDHCI_TANGIER
	imply MISC
	imply USB
	imply USB_XHCI_HCD
	imply USB_DWC3
	imply USB_DWC3_GENERIC

if UBOOT_CONFIG_INTEL_TANGIER

config UBOOT_CONFIG_SYS_CAR_ADDR
	hex
	default 0x19200000

config UBOOT_CONFIG_SYS_CAR_SIZE
	hex
	default 0x4000
	help
	  Space in bytes in eSRAM used as Cache-As-RAM (CAR).
	  Note this size must not exceed eSRAM's total size.

endif
```

## open_uboot/config/board/AndesTech/adp-ag101p/Kconfig
```kconfig
if UBOOT_CONFIG_TARGET_ADP_AG101P

config UBOOT_CONFIG_SYS_CPU
	default "n1213"

config UBOOT_CONFIG_SYS_BOARD
	default "adp-ag101p"

config UBOOT_CONFIG_SYS_VENDOR
	default "AndesTech"

config UBOOT_CONFIG_SYS_SOC
	default "ag101"

config UBOOT_CONFIG_SYS_CONFIG_NAME
	default "adp-ag101p"

endif
```
