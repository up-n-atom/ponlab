## open_uboot/config/arch/powerpc/cpu/mpc83xx/hid/Kconfig
```kconfig
menu "HID setup"

menu "HID0 initial"

config UBOOT_CONFIG_HID0_INIT_EMCP
	bool "Enable machine check int on mcp"

config UBOOT_CONFIG_HID0_INIT_ECPE
	bool "Enable cache parity errors"

config UBOOT_CONFIG_HID0_INIT_EBA
	bool "Enable address parity checking"

config UBOOT_CONFIG_HID0_INIT_EBD
	bool "Enable data parity checking"

choice
	prompt "HID0 clock configuration"

config UBOOT_CONFIG_HID0_INIT_CLKOUT_OFF
	bool "Clock output off"

config UBOOT_CONFIG_HID0_INIT_CLKOUT_CORE_HALF
	bool "Core clock / 2"

config UBOOT_CONFIG_HID0_INIT_CLKOUT_CORE
	bool "Core clock"

config UBOOT_CONFIG_HID0_INIT_CLKOUT_BUS
	bool "Bus clock"

endchoice

config UBOOT_CONFIG_HID0_INIT_PAR
	bool "Disable precharge of artry_out"

config UBOOT_CONFIG_HID0_INIT_DOZE
	bool "Enable doze mode"

config UBOOT_CONFIG_HID0_INIT_NAP
	bool "Enable nap mode"

config UBOOT_CONFIG_HID0_INIT_SLEEP
	bool "Enable sleep mode"

config UBOOT_CONFIG_HID0_INIT_DPM
	bool "Enable dynamic power management"

config UBOOT_CONFIG_HID0_INIT_ICE
	bool "Enable instruction cache"

config UBOOT_CONFIG_HID0_INIT_DCE
	bool "Enable data cache"

config UBOOT_CONFIG_HID0_INIT_ILOCK
	bool "Lock instruction cache"

config UBOOT_CONFIG_HID0_INIT_DLOCK
	bool "Lock data cache"

config UBOOT_CONFIG_HID0_INIT_ICFI
	bool "Flash invalidate instruction cache"

config UBOOT_CONFIG_HID0_INIT_DCFI
	bool "Flash invalidate data cache"

config UBOOT_CONFIG_HID0_INIT_IFEM
	bool "Enable m bit on bus for instruction fetches"

config UBOOT_CONFIG_HID0_INIT_DECAREN
	bool "Decrementer auto reload"

config UBOOT_CONFIG_HID0_INIT_FBIOB
	bool "Force indirect branch on the bus"

config UBOOT_CONFIG_HID0_INIT_ABE
	bool "Enable address broadcast"

config UBOOT_CONFIG_HID0_INIT_NOOPTI
	bool "No-op data cache touch intructions"

endmenu

menu "HID0 final"

config UBOOT_CONFIG_HID0_FINAL_EMCP
	bool "Enable machine check int on mcp"

config UBOOT_CONFIG_HID0_FINAL_ECPE
	bool "Enable cache parity errors"

config UBOOT_CONFIG_HID0_FINAL_EBA
	bool "Enable address parity checking"

config UBOOT_CONFIG_HID0_FINAL_EBD
	bool "Enable data parity checking"

choice
	prompt "HID0 clock configuration"

config UBOOT_CONFIG_HID0_FINAL_CLKOUT_OFF
	bool "Clock output off"

config UBOOT_CONFIG_HID0_FINAL_CLKOUT_CORE_HALF
	bool "Core clock / 2"

config UBOOT_CONFIG_HID0_FINAL_CLKOUT_CORE
	bool "Core clock"

config UBOOT_CONFIG_HID0_FINAL_CLKOUT_BUS
	bool "Bus clock"

endchoice

config UBOOT_CONFIG_HID0_FINAL_PAR
	bool "Disable precharge of artry_out"

config UBOOT_CONFIG_HID0_FINAL_DOZE
	bool "Enable doze mode"

config UBOOT_CONFIG_HID0_FINAL_NAP
	bool "Enable nap mode"

config UBOOT_CONFIG_HID0_FINAL_SLEEP
	bool "Enable sleep mode"

config UBOOT_CONFIG_HID0_FINAL_DPM
	bool "Enable dynamic power management"

config UBOOT_CONFIG_HID0_FINAL_ICE
	bool "Enable instruction cache"

config UBOOT_CONFIG_HID0_FINAL_DCE
	bool "Enable data cache"

config UBOOT_CONFIG_HID0_FINAL_ILOCK
	bool "Lock instruction cache"

config UBOOT_CONFIG_HID0_FINAL_DLOCK
	bool "Lock data cache"

config UBOOT_CONFIG_HID0_FINAL_ICFI
	bool "Flash invalidate instruction cache"

config UBOOT_CONFIG_HID0_FINAL_DCFI
	bool "Flash invalidate data cache"

config UBOOT_CONFIG_HID0_FINAL_IFEM
	bool "Enable m bit on bus for instruction fetches"

config UBOOT_CONFIG_HID0_FINAL_DECAREN
	bool "Decrementer auto reload"

config UBOOT_CONFIG_HID0_FINAL_FBIOB
	bool "Force indirect branch on the bus"

config UBOOT_CONFIG_HID0_FINAL_ABE
	bool "Enable address broadcast"

config UBOOT_CONFIG_HID0_FINAL_NOOPTI
	bool "No-op data cache touch intructions"

endmenu

config UBOOT_CONFIG_HID0_INIT_EMCP_BIT
	hex
	default 0x0 if ! UBOOT_CONFIG_HID0_INIT_EMCP
	default 0x80000000 if UBOOT_CONFIG_HID0_INIT_EMCP

config UBOOT_CONFIG_HID0_INIT_ECPE_BIT
	hex
	default 0x0 if ! UBOOT_CONFIG_HID0_INIT_ECPE
	default 0x40000000 if UBOOT_CONFIG_HID0_INIT_ECPE

config UBOOT_CONFIG_HID0_INIT_EBA_BIT
	hex
	default 0x0 if ! UBOOT_CONFIG_HID0_INIT_EBA
	default 0x20000000 if UBOOT_CONFIG_HID0_INIT_EBA

config UBOOT_CONFIG_HID0_INIT_EBD_BIT
	hex
	default 0x0 if ! UBOOT_CONFIG_HID0_INIT_EBD
	default 0x10000000 if UBOOT_CONFIG_HID0_INIT_EBD

config UBOOT_CONFIG_HID0_INIT_CLKOUT
	hex
	default 0x0 if UBOOT_CONFIG_HID0_INIT_CLKOUT_OFF
	default 0x8000000 if UBOOT_CONFIG_HID0_INIT_CLKOUT_CORE_HALF
	default 0x2000000 if UBOOT_CONFIG_HID0_INIT_CLKOUT_CORE
	default 0xa000000 if UBOOT_CONFIG_HID0_INIT_CLKOUT_BUS

config UBOOT_CONFIG_HID0_INIT_PAR_BIT
	hex
	default 0x0 if ! UBOOT_CONFIG_HID0_INIT_PAR
	default 0x1000000 if UBOOT_CONFIG_HID0_INIT_PAR

config UBOOT_CONFIG_HID0_INIT_DOZE_BIT
	hex
	default 0x0 if ! UBOOT_CONFIG_HID0_INIT_DOZE
	default 0x800000 if UBOOT_CONFIG_HID0_INIT_DOZE

config UBOOT_CONFIG_HID0_INIT_NAP_BIT
	hex
	default 0x0 if ! UBOOT_CONFIG_HID0_INIT_NAP
	default 0x400000 if UBOOT_CONFIG_HID0_INIT_NAP

config UBOOT_CONFIG_HID0_INIT_SLEEP_BIT
	hex
	default 0x0 if ! UBOOT_CONFIG_HID0_INIT_SLEEP
	default 0x200000 if UBOOT_CONFIG_HID0_INIT_SLEEP

config UBOOT_CONFIG_HID0_INIT_DPM_BIT
	hex
	default 0x0 if ! UBOOT_CONFIG_HID0_INIT_DPM
	default 0x100000 if UBOOT_CONFIG_HID0_INIT_DPM

config UBOOT_CONFIG_HID0_INIT_ICE_BIT
	hex
	default 0x0 if ! UBOOT_CONFIG_HID0_INIT_ICE
	default 0x8000 if UBOOT_CONFIG_HID0_INIT_ICE

config UBOOT_CONFIG_HID0_INIT_DCE_BIT
	hex
	default 0x0 if ! UBOOT_CONFIG_HID0_INIT_DCE
	default 0x4000 if UBOOT_CONFIG_HID0_INIT_DCE

config UBOOT_CONFIG_HID0_INIT_ILOCK_BIT
	hex
	default 0x0 if ! UBOOT_CONFIG_HID0_INIT_ILOCK
	default 0x2000 if UBOOT_CONFIG_HID0_INIT_ILOCK

config UBOOT_CONFIG_HID0_INIT_DLOCK_BIT
	hex
	default 0x0 if ! UBOOT_CONFIG_HID0_INIT_DLOCK
	default 0x1000 if UBOOT_CONFIG_HID0_INIT_DLOCK

config UBOOT_CONFIG_HID0_INIT_ICFI_BIT
	hex
	default 0x0 if ! UBOOT_CONFIG_HID0_INIT_ICFI
	default 0x800 if UBOOT_CONFIG_HID0_INIT_ICFI

config UBOOT_CONFIG_HID0_INIT_DCFI_BIT
	hex
	default 0x0 if ! UBOOT_CONFIG_HID0_INIT_DCFI
	default 0x400 if UBOOT_CONFIG_HID0_INIT_DCFI

config UBOOT_CONFIG_HID0_INIT_IFEM_BIT
	hex
	default 0x0 if ! UBOOT_CONFIG_HID0_INIT_IFEM
	default 0x80 if UBOOT_CONFIG_HID0_INIT_IFEM

config UBOOT_CONFIG_HID0_INIT_DECAREN_BIT
	hex
	default 0x0 if ! UBOOT_CONFIG_HID0_INIT_DECAREN
	default 0x40 if UBOOT_CONFIG_HID0_INIT_DECAREN

config UBOOT_CONFIG_HID0_INIT_FBIOB_BIT
	hex
	default 0x0 if ! UBOOT_CONFIG_HID0_INIT_FBIOB
	default 0x10 if UBOOT_CONFIG_HID0_INIT_FBIOB

config UBOOT_CONFIG_HID0_INIT_ABE_BIT
	hex
	default 0x0 if ! UBOOT_CONFIG_HID0_INIT_ABE
	default 0x8 if UBOOT_CONFIG_HID0_INIT_ABE

config UBOOT_CONFIG_HID0_INIT_NOOPTI_BIT
	hex
	default 0x0 if ! UBOOT_CONFIG_HID0_INIT_NOOPTI
	default 0x1 if UBOOT_CONFIG_HID0_INIT_NOOPTI

config UBOOT_CONFIG_HID0_FINAL_EMCP_BIT
	hex
	default 0x0 if ! UBOOT_CONFIG_HID0_FINAL_EMCP
	default 0x80000000 if UBOOT_CONFIG_HID0_FINAL_EMCP

config UBOOT_CONFIG_HID0_FINAL_ECPE_BIT
	hex
	default 0x0 if ! UBOOT_CONFIG_HID0_FINAL_ECPE
	default 0x40000000 if UBOOT_CONFIG_HID0_FINAL_ECPE

config UBOOT_CONFIG_HID0_FINAL_EBA_BIT
	hex
	default 0x0 if ! UBOOT_CONFIG_HID0_FINAL_EBA
	default 0x20000000 if UBOOT_CONFIG_HID0_FINAL_EBA

config UBOOT_CONFIG_HID0_FINAL_EBD_BIT
	hex
	default 0x0 if ! UBOOT_CONFIG_HID0_FINAL_EBD
	default 0x10000000 if UBOOT_CONFIG_HID0_FINAL_EBD

config UBOOT_CONFIG_HID0_FINAL_CLKOUT
	hex
	default 0x0 if UBOOT_CONFIG_HID0_FINAL_CLKOUT_OFF
	default 0x8000000 if UBOOT_CONFIG_HID0_FINAL_CLKOUT_CORE_HALF
	default 0x2000000 if UBOOT_CONFIG_HID0_FINAL_CLKOUT_CORE
	default 0xa000000 if UBOOT_CONFIG_HID0_FINAL_CLKOUT_BUS

config UBOOT_CONFIG_HID0_FINAL_SBCLK_BIT
	hex
	default 0x0 if ! UBOOT_CONFIG_HID0_FINAL_SBCLK
	default 0x8000000 if UBOOT_CONFIG_HID0_FINAL_SBCLK

config UBOOT_CONFIG_HID0_FINAL_ECLK_BIT
	hex
	default 0x0 if ! UBOOT_CONFIG_HID0_FINAL_ECLK
	default 0x2000000 if UBOOT_CONFIG_HID0_FINAL_ECLK

config UBOOT_CONFIG_HID0_FINAL_PAR_BIT
	hex
	default 0x0 if ! UBOOT_CONFIG_HID0_FINAL_PAR
	default 0x1000000 if UBOOT_CONFIG_HID0_FINAL_PAR

config UBOOT_CONFIG_HID0_FINAL_DOZE_BIT
	hex
	default 0x0 if ! UBOOT_CONFIG_HID0_FINAL_DOZE
	default 0x800000 if UBOOT_CONFIG_HID0_FINAL_DOZE

config UBOOT_CONFIG_HID0_FINAL_NAP_BIT
	hex
	default 0x0 if ! UBOOT_CONFIG_HID0_FINAL_NAP
	default 0x400000 if UBOOT_CONFIG_HID0_FINAL_NAP

config UBOOT_CONFIG_HID0_FINAL_SLEEP_BIT
	hex
	default 0x0 if ! UBOOT_CONFIG_HID0_FINAL_SLEEP
	default 0x200000 if UBOOT_CONFIG_HID0_FINAL_SLEEP

config UBOOT_CONFIG_HID0_FINAL_DPM_BIT
	hex
	default 0x0 if ! UBOOT_CONFIG_HID0_FINAL_DPM
	default 0x100000 if UBOOT_CONFIG_HID0_FINAL_DPM

config UBOOT_CONFIG_HID0_FINAL_ICE_BIT
	hex
	default 0x0 if ! UBOOT_CONFIG_HID0_FINAL_ICE
	default 0x8000 if UBOOT_CONFIG_HID0_FINAL_ICE

config UBOOT_CONFIG_HID0_FINAL_DCE_BIT
	hex
	default 0x0 if ! UBOOT_CONFIG_HID0_FINAL_DCE
	default 0x4000 if UBOOT_CONFIG_HID0_FINAL_DCE

config UBOOT_CONFIG_HID0_FINAL_ILOCK_BIT
	hex
	default 0x0 if ! UBOOT_CONFIG_HID0_FINAL_ILOCK
	default 0x2000 if UBOOT_CONFIG_HID0_FINAL_ILOCK

config UBOOT_CONFIG_HID0_FINAL_DLOCK_BIT
	hex
	default 0x0 if ! UBOOT_CONFIG_HID0_FINAL_DLOCK
	default 0x1000 if UBOOT_CONFIG_HID0_FINAL_DLOCK

config UBOOT_CONFIG_HID0_FINAL_ICFI_BIT
	hex
	default 0x0 if ! UBOOT_CONFIG_HID0_FINAL_ICFI
	default 0x800 if UBOOT_CONFIG_HID0_FINAL_ICFI

config UBOOT_CONFIG_HID0_FINAL_DCFI_BIT
	hex
	default 0x0 if ! UBOOT_CONFIG_HID0_FINAL_DCFI
	default 0x400 if UBOOT_CONFIG_HID0_FINAL_DCFI

config UBOOT_CONFIG_HID0_FINAL_IFEM_BIT
	hex
	default 0x0 if ! UBOOT_CONFIG_HID0_FINAL_IFEM
	default 0x80 if UBOOT_CONFIG_HID0_FINAL_IFEM

config UBOOT_CONFIG_HID0_FINAL_DECAREN_BIT
	hex
	default 0x0 if ! UBOOT_CONFIG_HID0_FINAL_DECAREN
	default 0x40 if UBOOT_CONFIG_HID0_FINAL_DECAREN

config UBOOT_CONFIG_HID0_FINAL_FBIOB_BIT
	hex
	default 0x0 if ! UBOOT_CONFIG_HID0_FINAL_FBIOB
	default 0x10 if UBOOT_CONFIG_HID0_FINAL_FBIOB

config UBOOT_CONFIG_HID0_FINAL_ABE_BIT
	hex
	default 0x0 if ! UBOOT_CONFIG_HID0_FINAL_ABE
	default 0x8 if UBOOT_CONFIG_HID0_FINAL_ABE

config UBOOT_CONFIG_HID0_FINAL_NOOPTI_BIT
	hex
	default 0x0 if ! UBOOT_CONFIG_HID0_FINAL_NOOPTI
	default 0x1 if UBOOT_CONFIG_HID0_FINAL_NOOPTI

menu "HID2"

config UBOOT_CONFIG_HID2_LET
	bool "True little-endian mode"

config UBOOT_CONFIG_HID2_IFEB
	bool "Instruction fetch burst extension"

config UBOOT_CONFIG_HID2_MESISTATE
	bool "MESI state enable"

config UBOOT_CONFIG_HID2_IFEC
	bool "Instruction fetch cancel extension"

config UBOOT_CONFIG_HID2_EBQS
	bool "BIU queue sharing"

config UBOOT_CONFIG_HID2_EBPX
	bool "BIU pipeline extension"

if !ARCH_MPC8360

config UBOOT_CONFIG_HID2_ELRW
	bool "Weighted LRU"

config UBOOT_CONFIG_HID2_NOKS
	bool "No kill for snoop"

endif

config UBOOT_CONFIG_HID2_HBE
	bool "High bat enable"

choice
	prompt "Instruction cache way-lock"

config UBOOT_CONFIG_HID2_IWLCK_NONE
	bool "No ways locked"

config UBOOT_CONFIG_HID2_IWLCK_0
	bool "Way 0 locked"

config UBOOT_CONFIG_HID2_IWLCK_1
	bool "Way 0 through 1 locked"

config UBOOT_CONFIG_HID2_IWLCK_2
	bool "Way 0 through 2 locked"

if UBOOT_CONFIG_ARCH_MPC8360 || UBOOT_CONFIG_ARCH_MPC8379

config UBOOT_CONFIG_HID2_IWLCK_3
	bool "Way 0 through 3 locked"

config UBOOT_CONFIG_HID2_IWLCK_4
	bool "Way 0 through 4 locked"

config UBOOT_CONFIG_HID2_IWLCK_5
	bool "Way 0 through 5 locked"

config UBOOT_CONFIG_HID2_IWLCK_6
	bool "Way 0 through 6 locked"

endif

endchoice

config UBOOT_CONFIG_HID2_ICWP
	bool "Instruction cache way protection"

choice
	prompt "Data cache way-lock"

config UBOOT_CONFIG_HID2_DWLCK_NONE
	bool "No ways locked"

config UBOOT_CONFIG_HID2_DWLCK_0
	bool "Way 0 locked"

config UBOOT_CONFIG_HID2_DWLCK_1
	bool "Way 0 through 1 locked"

config UBOOT_CONFIG_HID2_DWLCK_2
	bool "Way 0 through 2 locked"

if UBOOT_CONFIG_ARCH_MPC8360 || UBOOT_CONFIG_ARCH_MPC8379

config UBOOT_CONFIG_HID2_DWLCK_3
	bool "Way 0 through 3 locked"

config UBOOT_CONFIG_HID2_DWLCK_4
	bool "Way 0 through 4 locked"

config UBOOT_CONFIG_HID2_DWLCK_5
	bool "Way 0 through 5 locked"

config UBOOT_CONFIG_HID2_DWLCK_6
	bool "Way 0 through 6 locked"

endif

endchoice

config UBOOT_CONFIG_HID2_LET_BIT
	hex
	default 0x0 if ! UBOOT_CONFIG_HID2_LET
	default 0x8000000 if UBOOT_CONFIG_HID2_LET

config UBOOT_CONFIG_HID2_IFEB_BIT
	hex
	default 0x0 if ! UBOOT_CONFIG_HID2_IFEB
	default 0x4000000 if UBOOT_CONFIG_HID2_IFEB

config UBOOT_CONFIG_HID2_MESISTATE_BIT
	hex
	default 0x0 if ! UBOOT_CONFIG_HID2_MESISTATE
	default 0x1000000 if UBOOT_CONFIG_HID2_MESISTATE

config UBOOT_CONFIG_HID2_IFEC_BIT
	hex
	default 0x0 if ! UBOOT_CONFIG_HID2_IFEC
	default 0x800000 if UBOOT_CONFIG_HID2_IFEC

config UBOOT_CONFIG_HID2_EBQS_BIT
	hex
	default 0x0 if ! UBOOT_CONFIG_HID2_EBQS
	default 0x400000 if UBOOT_CONFIG_HID2_EBQS

config UBOOT_CONFIG_HID2_EBPX_BIT
	hex
	default 0x0 if ! UBOOT_CONFIG_HID2_EBPX
	default 0x200000 if UBOOT_CONFIG_HID2_EBPX

config UBOOT_CONFIG_HID2_ELRW_BIT
	hex
	default 0x0 if ! UBOOT_CONFIG_HID2_ELRW
	default 0x100000 if UBOOT_CONFIG_HID2_ELRW

config UBOOT_CONFIG_HID2_NOKS_BIT
	hex
	default 0x0 if ! UBOOT_CONFIG_HID2_NOKS
	default 0x80000 if UBOOT_CONFIG_HID2_NOKS

config UBOOT_CONFIG_HID2_HBE_BIT
	hex
	default 0x0 if ! UBOOT_CONFIG_HID2_HBE
	default 0x40000 if UBOOT_CONFIG_HID2_HBE

config UBOOT_CONFIG_HID2_IWLCK
	hex
	default 0x0 if UBOOT_CONFIG_HID2_IWLCK_NONE
	default 0x2000 if UBOOT_CONFIG_HID2_IWLCK_0
	default 0x4000 if UBOOT_CONFIG_HID2_IWLCK_1
	default 0x6000 if UBOOT_CONFIG_HID2_IWLCK_2
	default 0x8000 if UBOOT_CONFIG_HID2_IWLCK_3
	default 0xA000 if UBOOT_CONFIG_HID2_IWLCK_4
	default 0xC000 if UBOOT_CONFIG_HID2_IWLCK_5
	default 0xE000 if UBOOT_CONFIG_HID2_IWLCK_6

config UBOOT_CONFIG_HID2_ICWP_BIT
	hex
	default 0x0 if ! UBOOT_CONFIG_HID2_ICWP
	default 0x1000 if UBOOT_CONFIG_HID2_ICWP

config UBOOT_CONFIG_HID2_DWLCK
	hex
	default 0x0 if UBOOT_CONFIG_HID2_DWLCK_NONE
	default 0x20 if UBOOT_CONFIG_HID2_DWLCK_0
	default 0x40 if UBOOT_CONFIG_HID2_DWLCK_1
	default 0x60 if UBOOT_CONFIG_HID2_DWLCK_2
	default 0x80 if UBOOT_CONFIG_HID2_DWLCK_3
	default 0xA0 if UBOOT_CONFIG_HID2_DWLCK_4
	default 0xC0 if UBOOT_CONFIG_HID2_DWLCK_5
	default 0xE0 if UBOOT_CONFIG_HID2_DWLCK_6

endmenu

endmenu
```
