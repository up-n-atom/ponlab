## open_uboot/config/arch/powerpc/cpu/mpc85xx/Kconfig
```kconfig
menu "mpc85xx CPU"
	depends on UBOOT_CONFIG_MPC85xx

config UBOOT_CONFIG_SYS_CPU
	default "mpc85xx"

config UBOOT_CONFIG_CMD_ERRATA
	bool "Enable the 'errata' command"
	depends on UBOOT_CONFIG_MPC85xx
	default y
	help
	  This enables the 'errata' command which displays a list of errata
	  work-arounds which are enabled for the current board.

choice
	prompt "Target select"
	optional

config UBOOT_CONFIG_TARGET_SOCRATES
	bool "Support socrates"
	select UBOOT_CONFIG_ARCH_MPC8544

config UBOOT_CONFIG_TARGET_P3041DS
	bool "Support P3041DS"
	select UBOOT_CONFIG_PHYS_64BIT
	select UBOOT_CONFIG_ARCH_P3041
	select UBOOT_CONFIG_BOARD_LATE_INIT if CHAIN_OF_TRUST
	imply CMD_SATA
	imply PANIC_HANG

config UBOOT_CONFIG_TARGET_P4080DS
	bool "Support P4080DS"
	select UBOOT_CONFIG_PHYS_64BIT
	select UBOOT_CONFIG_ARCH_P4080
	select UBOOT_CONFIG_BOARD_LATE_INIT if CHAIN_OF_TRUST
	imply CMD_SATA
	imply PANIC_HANG

config UBOOT_CONFIG_TARGET_P5040DS
	bool "Support P5040DS"
	select UBOOT_CONFIG_PHYS_64BIT
	select UBOOT_CONFIG_ARCH_P5040
	select UBOOT_CONFIG_BOARD_LATE_INIT if CHAIN_OF_TRUST
	imply CMD_SATA
	imply PANIC_HANG

config UBOOT_CONFIG_TARGET_MPC8548CDS
	bool "Support MPC8548CDS"
	select UBOOT_CONFIG_ARCH_MPC8548
	select UBOOT_CONFIG_FSL_VIA
	select UBOOT_CONFIG_SYS_CACHE_SHIFT_5

config UBOOT_CONFIG_TARGET_P1010RDB_PA
	bool "Support P1010RDB_PA"
	select UBOOT_CONFIG_ARCH_P1010
	select UBOOT_CONFIG_BOARD_LATE_INIT if CHAIN_OF_TRUST
	select UBOOT_CONFIG_SUPPORT_SPL
	select UBOOT_CONFIG_SUPPORT_TPL
	imply CMD_EEPROM
	imply CMD_SATA
	imply PANIC_HANG

config UBOOT_CONFIG_TARGET_P1010RDB_PB
	bool "Support P1010RDB_PB"
	select UBOOT_CONFIG_ARCH_P1010
	select UBOOT_CONFIG_BOARD_LATE_INIT if CHAIN_OF_TRUST
	select UBOOT_CONFIG_SUPPORT_SPL
	select UBOOT_CONFIG_SUPPORT_TPL
	imply CMD_EEPROM
	imply CMD_SATA
	imply PANIC_HANG

config UBOOT_CONFIG_TARGET_P1020RDB_PC
	bool "Support P1020RDB-PC"
	select UBOOT_CONFIG_SUPPORT_SPL
	select UBOOT_CONFIG_SUPPORT_TPL
	select UBOOT_CONFIG_ARCH_P1020
	imply CMD_EEPROM
	imply CMD_SATA
	imply PANIC_HANG

config UBOOT_CONFIG_TARGET_P1020RDB_PD
	bool "Support P1020RDB-PD"
	select UBOOT_CONFIG_SUPPORT_SPL
	select UBOOT_CONFIG_SUPPORT_TPL
	select UBOOT_CONFIG_ARCH_P1020
	imply CMD_EEPROM
	imply CMD_SATA
	imply PANIC_HANG

config UBOOT_CONFIG_TARGET_P2020RDB
	bool "Support P2020RDB-PC"
	select UBOOT_CONFIG_SUPPORT_SPL
	select UBOOT_CONFIG_SUPPORT_TPL
	select UBOOT_CONFIG_ARCH_P2020
	imply CMD_EEPROM
	imply CMD_SATA
	imply SATA_SIL

config UBOOT_CONFIG_TARGET_P2041RDB
	bool "Support P2041RDB"
	select UBOOT_CONFIG_ARCH_P2041
	select UBOOT_CONFIG_BOARD_LATE_INIT if CHAIN_OF_TRUST
	select UBOOT_CONFIG_PHYS_64BIT
	imply CMD_SATA
	imply FSL_SATA

config UBOOT_CONFIG_TARGET_QEMU_PPCE500
	bool "Support qemu-ppce500"
	select UBOOT_CONFIG_ARCH_QEMU_E500
	select UBOOT_CONFIG_PHYS_64BIT

config UBOOT_CONFIG_TARGET_T1024RDB
	bool "Support T1024RDB"
	select UBOOT_CONFIG_ARCH_T1024
	select UBOOT_CONFIG_BOARD_LATE_INIT if CHAIN_OF_TRUST
	select UBOOT_CONFIG_SUPPORT_SPL
	select UBOOT_CONFIG_PHYS_64BIT
	select UBOOT_CONFIG_FSL_DDR_INTERACTIVE
	imply CMD_EEPROM
	imply PANIC_HANG

config UBOOT_CONFIG_TARGET_T1042RDB
	bool "Support T1042RDB"
	select UBOOT_CONFIG_ARCH_T1042
	select UBOOT_CONFIG_BOARD_LATE_INIT if CHAIN_OF_TRUST
	select UBOOT_CONFIG_SUPPORT_SPL
	select UBOOT_CONFIG_PHYS_64BIT

config UBOOT_CONFIG_TARGET_T1042D4RDB
	bool "Support T1042D4RDB"
	select UBOOT_CONFIG_ARCH_T1042
	select UBOOT_CONFIG_BOARD_LATE_INIT if CHAIN_OF_TRUST
	select UBOOT_CONFIG_SUPPORT_SPL
	select UBOOT_CONFIG_PHYS_64BIT
	imply PANIC_HANG

config UBOOT_CONFIG_TARGET_T1042RDB_PI
	bool "Support T1042RDB_PI"
	select UBOOT_CONFIG_ARCH_T1042
	select UBOOT_CONFIG_BOARD_LATE_INIT if CHAIN_OF_TRUST
	select UBOOT_CONFIG_SUPPORT_SPL
	select UBOOT_CONFIG_PHYS_64BIT
	imply PANIC_HANG

config UBOOT_CONFIG_TARGET_T2080QDS
	bool "Support T2080QDS"
	select UBOOT_CONFIG_ARCH_T2080
	select UBOOT_CONFIG_BOARD_LATE_INIT if CHAIN_OF_TRUST
	select UBOOT_CONFIG_SUPPORT_SPL
	select UBOOT_CONFIG_PHYS_64BIT
	select UBOOT_CONFIG_FSL_DDR_FIRST_SLOT_QUAD_CAPABLE
	select UBOOT_CONFIG_FSL_DDR_INTERACTIVE
	imply CMD_SATA

config UBOOT_CONFIG_TARGET_T2080RDB
	bool "Support T2080RDB"
	select UBOOT_CONFIG_ARCH_T2080
	select UBOOT_CONFIG_BOARD_LATE_INIT if CHAIN_OF_TRUST
	select UBOOT_CONFIG_SUPPORT_SPL
	select UBOOT_CONFIG_PHYS_64BIT
	imply CMD_SATA
	imply PANIC_HANG

config UBOOT_CONFIG_TARGET_T4240RDB
	bool "Support T4240RDB"
	select UBOOT_CONFIG_ARCH_T4240
	select UBOOT_CONFIG_SUPPORT_SPL
	select UBOOT_CONFIG_PHYS_64BIT
	select UBOOT_CONFIG_FSL_DDR_FIRST_SLOT_QUAD_CAPABLE
	imply CMD_SATA
	imply PANIC_HANG

config UBOOT_CONFIG_TARGET_KMP204X
	bool "Support kmp204x"
	select UBOOT_CONFIG_VENDOR_KM

config UBOOT_CONFIG_TARGET_KMCENT2
	bool "Support kmcent2"
	select UBOOT_CONFIG_VENDOR_KM

endchoice

config UBOOT_CONFIG_ARCH_B4420
	bool
	select UBOOT_CONFIG_E500MC
	select UBOOT_CONFIG_E6500
	select UBOOT_CONFIG_FSL_LAW
	select UBOOT_CONFIG_SYS_FSL_DDR_VER_47
	select UBOOT_CONFIG_SYS_FSL_ERRATUM_A004477
	select UBOOT_CONFIG_SYS_FSL_ERRATUM_A005871
	select UBOOT_CONFIG_SYS_FSL_ERRATUM_A006379
	select UBOOT_CONFIG_SYS_FSL_ERRATUM_A006384
	select UBOOT_CONFIG_SYS_FSL_ERRATUM_A006475
	select UBOOT_CONFIG_SYS_FSL_ERRATUM_A006593
	select UBOOT_CONFIG_SYS_FSL_ERRATUM_A007075
	select UBOOT_CONFIG_SYS_FSL_ERRATUM_A007186
	select UBOOT_CONFIG_SYS_FSL_ERRATUM_A007212
	select UBOOT_CONFIG_SYS_FSL_ERRATUM_A009942
	select UBOOT_CONFIG_SYS_FSL_HAS_DDR3
	select UBOOT_CONFIG_SYS_FSL_HAS_SEC
	select UBOOT_CONFIG_SYS_FSL_QORIQ_CHASSIS2
	select UBOOT_CONFIG_SYS_FSL_SEC_BE
	select UBOOT_CONFIG_SYS_FSL_SEC_COMPAT_4
	select UBOOT_CONFIG_SYS_PPC64
	select UBOOT_CONFIG_FSL_IFC
	imply CMD_EEPROM
	imply CMD_NAND
	imply CMD_REGINFO

config UBOOT_CONFIG_ARCH_B4860
	bool
	select UBOOT_CONFIG_E500MC
	select UBOOT_CONFIG_E6500
	select UBOOT_CONFIG_FSL_LAW
	select UBOOT_CONFIG_SYS_FSL_DDR_VER_47
	select UBOOT_CONFIG_SYS_FSL_ERRATUM_A004477
	select UBOOT_CONFIG_SYS_FSL_ERRATUM_A005871
	select UBOOT_CONFIG_SYS_FSL_ERRATUM_A006379
	select UBOOT_CONFIG_SYS_FSL_ERRATUM_A006384
	select UBOOT_CONFIG_SYS_FSL_ERRATUM_A006475
	select UBOOT_CONFIG_SYS_FSL_ERRATUM_A006593
	select UBOOT_CONFIG_SYS_FSL_ERRATUM_A007075
	select UBOOT_CONFIG_SYS_FSL_ERRATUM_A007186
	select UBOOT_CONFIG_SYS_FSL_ERRATUM_A007212
	select UBOOT_CONFIG_SYS_FSL_ERRATUM_A007907
	select UBOOT_CONFIG_SYS_FSL_ERRATUM_A009942
	select UBOOT_CONFIG_SYS_FSL_HAS_DDR3
	select UBOOT_CONFIG_SYS_FSL_HAS_SEC
	select UBOOT_CONFIG_SYS_FSL_QORIQ_CHASSIS2
	select UBOOT_CONFIG_SYS_FSL_SEC_BE
	select UBOOT_CONFIG_SYS_FSL_SEC_COMPAT_4
	select UBOOT_CONFIG_SYS_PPC64
	select UBOOT_CONFIG_FSL_IFC
	imply CMD_EEPROM
	imply CMD_NAND
	imply CMD_REGINFO

config UBOOT_CONFIG_ARCH_BSC9131
	bool
	select UBOOT_CONFIG_FSL_LAW
	select UBOOT_CONFIG_SYS_FSL_DDR_VER_44
	select UBOOT_CONFIG_SYS_FSL_ERRATUM_A004477
	select UBOOT_CONFIG_SYS_FSL_ERRATUM_A005125
	select UBOOT_CONFIG_SYS_FSL_ERRATUM_ESDHC111
	select UBOOT_CONFIG_SYS_FSL_HAS_DDR3
	select UBOOT_CONFIG_SYS_FSL_HAS_SEC
	select UBOOT_CONFIG_SYS_FSL_SEC_BE
	select UBOOT_CONFIG_SYS_FSL_SEC_COMPAT_4
	select UBOOT_CONFIG_FSL_IFC
	imply CMD_EEPROM
	imply CMD_NAND
	imply CMD_REGINFO

config UBOOT_CONFIG_ARCH_BSC9132
	bool
	select UBOOT_CONFIG_FSL_LAW
	select UBOOT_CONFIG_SYS_FSL_DDR_VER_46
	select UBOOT_CONFIG_SYS_FSL_ERRATUM_A004477
	select UBOOT_CONFIG_SYS_FSL_ERRATUM_A005125
	select UBOOT_CONFIG_SYS_FSL_ERRATUM_A005434
	select UBOOT_CONFIG_SYS_FSL_ERRATUM_ESDHC111
	select UBOOT_CONFIG_SYS_FSL_ERRATUM_I2C_A004447
	select UBOOT_CONFIG_SYS_FSL_ERRATUM_IFC_A002769
	select UBOOT_CONFIG_FSL_PCIE_RESET
	select UBOOT_CONFIG_SYS_FSL_HAS_DDR3
	select UBOOT_CONFIG_SYS_FSL_HAS_SEC
	select UBOOT_CONFIG_SYS_FSL_SEC_BE
	select UBOOT_CONFIG_SYS_FSL_SEC_COMPAT_4
	select UBOOT_CONFIG_SYS_PPC_E500_USE_DEBUG_TLB
	select UBOOT_CONFIG_FSL_IFC
	imply CMD_EEPROM
	imply CMD_MTDPARTS
	imply CMD_NAND
	imply CMD_PCI
	imply CMD_REGINFO

config UBOOT_CONFIG_ARCH_C29X
	bool
	select UBOOT_CONFIG_FSL_LAW
	select UBOOT_CONFIG_SYS_FSL_DDR_VER_46
	select UBOOT_CONFIG_SYS_FSL_ERRATUM_A005125
	select UBOOT_CONFIG_SYS_FSL_ERRATUM_ESDHC111
	select UBOOT_CONFIG_FSL_PCIE_RESET
	select UBOOT_CONFIG_SYS_FSL_HAS_DDR3
	select UBOOT_CONFIG_SYS_FSL_HAS_SEC
	select UBOOT_CONFIG_SYS_FSL_SEC_BE
	select UBOOT_CONFIG_SYS_FSL_SEC_COMPAT_6
	select UBOOT_CONFIG_SYS_PPC_E500_USE_DEBUG_TLB
	select UBOOT_CONFIG_FSL_IFC
	imply CMD_NAND
	imply CMD_PCI
	imply CMD_REGINFO

config UBOOT_CONFIG_ARCH_MPC8536
	bool
	select UBOOT_CONFIG_FSL_LAW
	select UBOOT_CONFIG_SYS_FSL_ERRATUM_A004508
	select UBOOT_CONFIG_SYS_FSL_ERRATUM_A005125
	select UBOOT_CONFIG_FSL_PCIE_RESET
	select UBOOT_CONFIG_SYS_FSL_HAS_DDR2
	select UBOOT_CONFIG_SYS_FSL_HAS_DDR3
	select UBOOT_CONFIG_SYS_FSL_HAS_SEC
	select UBOOT_CONFIG_SYS_FSL_SEC_BE
	select UBOOT_CONFIG_SYS_FSL_SEC_COMPAT_2
	select UBOOT_CONFIG_SYS_PPC_E500_USE_DEBUG_TLB
	select UBOOT_CONFIG_FSL_ELBC
	imply CMD_NAND
	imply CMD_SATA
	imply CMD_REGINFO

config UBOOT_CONFIG_ARCH_MPC8540
	bool
	select UBOOT_CONFIG_FSL_LAW
	select UBOOT_CONFIG_SYS_FSL_HAS_DDR1

config UBOOT_CONFIG_ARCH_MPC8544
	bool
	select UBOOT_CONFIG_FSL_LAW
	select UBOOT_CONFIG_SYS_CACHE_SHIFT_5
	select UBOOT_CONFIG_SYS_FSL_ERRATUM_A005125
	select UBOOT_CONFIG_FSL_PCIE_RESET
	select UBOOT_CONFIG_SYS_FSL_HAS_DDR2
	select UBOOT_CONFIG_SYS_FSL_HAS_SEC
	select UBOOT_CONFIG_SYS_FSL_SEC_BE
	select UBOOT_CONFIG_SYS_FSL_SEC_COMPAT_2
	select UBOOT_CONFIG_SYS_PPC_E500_USE_DEBUG_TLB
	select UBOOT_CONFIG_FSL_ELBC

config UBOOT_CONFIG_ARCH_MPC8548
	bool
	select UBOOT_CONFIG_FSL_LAW
	select UBOOT_CONFIG_SYS_FSL_ERRATUM_A005125
	select UBOOT_CONFIG_SYS_FSL_ERRATUM_NMG_DDR120
	select UBOOT_CONFIG_SYS_FSL_ERRATUM_NMG_LBC103
	select UBOOT_CONFIG_SYS_FSL_ERRATUM_NMG_ETSEC129
	select UBOOT_CONFIG_SYS_FSL_ERRATUM_I2C_A004447
	select UBOOT_CONFIG_FSL_PCIE_RESET
	select UBOOT_CONFIG_SYS_FSL_HAS_DDR2
	select UBOOT_CONFIG_SYS_FSL_HAS_DDR1
	select UBOOT_CONFIG_SYS_FSL_HAS_SEC
	select UBOOT_CONFIG_SYS_FSL_SEC_BE
	select UBOOT_CONFIG_SYS_FSL_SEC_COMPAT_2
	select UBOOT_CONFIG_SYS_PPC_E500_USE_DEBUG_TLB
	imply CMD_REGINFO

config UBOOT_CONFIG_ARCH_MPC8560
	bool
	select UBOOT_CONFIG_FSL_LAW
	select UBOOT_CONFIG_SYS_FSL_HAS_DDR1

config UBOOT_CONFIG_ARCH_P1010
	bool
	select UBOOT_CONFIG_FSL_LAW
	select UBOOT_CONFIG_SYS_CACHE_SHIFT_5
	select UBOOT_CONFIG_SYS_FSL_ERRATUM_A004477
	select UBOOT_CONFIG_SYS_FSL_ERRATUM_A004508
	select UBOOT_CONFIG_SYS_FSL_ERRATUM_A005125
	select UBOOT_CONFIG_SYS_FSL_ERRATUM_A005275
	select UBOOT_CONFIG_SYS_FSL_ERRATUM_A006261
	select UBOOT_CONFIG_SYS_FSL_ERRATUM_A007075
	select UBOOT_CONFIG_SYS_FSL_ERRATUM_ESDHC111
	select UBOOT_CONFIG_SYS_FSL_ERRATUM_I2C_A004447
	select UBOOT_CONFIG_SYS_FSL_ERRATUM_IFC_A002769
	select UBOOT_CONFIG_SYS_FSL_ERRATUM_P1010_A003549
	select UBOOT_CONFIG_SYS_FSL_ERRATUM_SEC_A003571
	select UBOOT_CONFIG_SYS_FSL_ERRATUM_IFC_A003399
	select UBOOT_CONFIG_FSL_PCIE_RESET
	select UBOOT_CONFIG_SYS_FSL_HAS_DDR3
	select UBOOT_CONFIG_SYS_FSL_HAS_SEC
	select UBOOT_CONFIG_SYS_FSL_SEC_BE
	select UBOOT_CONFIG_SYS_FSL_SEC_COMPAT_4
	select UBOOT_CONFIG_SYS_PPC_E500_USE_DEBUG_TLB
	select UBOOT_CONFIG_FSL_IFC
	imply CMD_EEPROM
	imply CMD_MTDPARTS
	imply CMD_NAND
	imply CMD_SATA
	imply CMD_PCI
	imply CMD_REGINFO
	imply FSL_SATA

config UBOOT_CONFIG_ARCH_P1011
	bool
	select UBOOT_CONFIG_FSL_LAW
	select UBOOT_CONFIG_SYS_FSL_ERRATUM_A004508
	select UBOOT_CONFIG_SYS_FSL_ERRATUM_A005125
	select UBOOT_CONFIG_SYS_FSL_ERRATUM_ELBC_A001
	select UBOOT_CONFIG_SYS_FSL_ERRATUM_ESDHC111
	select UBOOT_CONFIG_FSL_PCIE_DISABLE_ASPM
	select UBOOT_CONFIG_SYS_FSL_HAS_DDR3
	select UBOOT_CONFIG_SYS_FSL_HAS_SEC
	select UBOOT_CONFIG_SYS_FSL_SEC_BE
	select UBOOT_CONFIG_SYS_FSL_SEC_COMPAT_2
	select UBOOT_CONFIG_SYS_PPC_E500_USE_DEBUG_TLB
	select UBOOT_CONFIG_FSL_ELBC

config UBOOT_CONFIG_ARCH_P1020
	bool
	select UBOOT_CONFIG_FSL_LAW
	select UBOOT_CONFIG_SYS_CACHE_SHIFT_5
	select UBOOT_CONFIG_SYS_FSL_ERRATUM_A004508
	select UBOOT_CONFIG_SYS_FSL_ERRATUM_A005125
	select UBOOT_CONFIG_SYS_FSL_ERRATUM_ELBC_A001
	select UBOOT_CONFIG_SYS_FSL_ERRATUM_ESDHC111
	select UBOOT_CONFIG_FSL_PCIE_DISABLE_ASPM
	select UBOOT_CONFIG_FSL_PCIE_RESET
	select UBOOT_CONFIG_SYS_FSL_HAS_DDR3
	select UBOOT_CONFIG_SYS_FSL_HAS_SEC
	select UBOOT_CONFIG_SYS_FSL_SEC_BE
	select UBOOT_CONFIG_SYS_FSL_SEC_COMPAT_2
	select UBOOT_CONFIG_SYS_PPC_E500_USE_DEBUG_TLB
	select UBOOT_CONFIG_FSL_ELBC
	imply CMD_NAND
	imply CMD_SATA
	imply CMD_PCI
	imply CMD_REGINFO
	imply SATA_SIL

config UBOOT_CONFIG_ARCH_P1021
	bool
	select UBOOT_CONFIG_FSL_LAW
	select UBOOT_CONFIG_SYS_FSL_ERRATUM_A004508
	select UBOOT_CONFIG_SYS_FSL_ERRATUM_A005125
	select UBOOT_CONFIG_SYS_FSL_ERRATUM_ELBC_A001
	select UBOOT_CONFIG_SYS_FSL_ERRATUM_ESDHC111
	select UBOOT_CONFIG_FSL_PCIE_DISABLE_ASPM
	select UBOOT_CONFIG_FSL_PCIE_RESET
	select UBOOT_CONFIG_SYS_FSL_HAS_DDR3
	select UBOOT_CONFIG_SYS_FSL_HAS_SEC
	select UBOOT_CONFIG_SYS_FSL_SEC_BE
	select UBOOT_CONFIG_SYS_FSL_SEC_COMPAT_2
	select UBOOT_CONFIG_SYS_PPC_E500_USE_DEBUG_TLB
	select UBOOT_CONFIG_FSL_ELBC
	imply CMD_REGINFO
	imply CMD_NAND
	imply CMD_SATA
	imply CMD_REGINFO
	imply SATA_SIL

config UBOOT_CONFIG_ARCH_P1023
	bool
	select UBOOT_CONFIG_FSL_LAW
	select UBOOT_CONFIG_SYS_FSL_ERRATUM_A004508
	select UBOOT_CONFIG_SYS_FSL_ERRATUM_A005125
	select UBOOT_CONFIG_SYS_FSL_ERRATUM_I2C_A004447
	select UBOOT_CONFIG_FSL_PCIE_RESET
	select UBOOT_CONFIG_SYS_FSL_HAS_DDR3
	select UBOOT_CONFIG_SYS_FSL_HAS_SEC
	select UBOOT_CONFIG_SYS_FSL_SEC_BE
	select UBOOT_CONFIG_SYS_FSL_SEC_COMPAT_4
	select UBOOT_CONFIG_FSL_ELBC

config UBOOT_CONFIG_ARCH_P1024
	bool
	select UBOOT_CONFIG_FSL_LAW
	select UBOOT_CONFIG_SYS_FSL_ERRATUM_A004508
	select UBOOT_CONFIG_SYS_FSL_ERRATUM_A005125
	select UBOOT_CONFIG_SYS_FSL_ERRATUM_ELBC_A001
	select UBOOT_CONFIG_SYS_FSL_ERRATUM_ESDHC111
	select UBOOT_CONFIG_FSL_PCIE_DISABLE_ASPM
	select UBOOT_CONFIG_FSL_PCIE_RESET
	select UBOOT_CONFIG_SYS_FSL_HAS_DDR3
	select UBOOT_CONFIG_SYS_FSL_HAS_SEC
	select UBOOT_CONFIG_SYS_FSL_SEC_BE
	select UBOOT_CONFIG_SYS_FSL_SEC_COMPAT_2
	select UBOOT_CONFIG_SYS_PPC_E500_USE_DEBUG_TLB
	select UBOOT_CONFIG_FSL_ELBC
	imply CMD_EEPROM
	imply CMD_NAND
	imply CMD_SATA
	imply CMD_PCI
	imply CMD_REGINFO
	imply SATA_SIL

config UBOOT_CONFIG_ARCH_P1025
	bool
	select UBOOT_CONFIG_FSL_LAW
	select UBOOT_CONFIG_SYS_FSL_ERRATUM_A004508
	select UBOOT_CONFIG_SYS_FSL_ERRATUM_A005125
	select UBOOT_CONFIG_SYS_FSL_ERRATUM_ELBC_A001
	select UBOOT_CONFIG_SYS_FSL_ERRATUM_ESDHC111
	select UBOOT_CONFIG_FSL_PCIE_DISABLE_ASPM
	select UBOOT_CONFIG_FSL_PCIE_RESET
	select UBOOT_CONFIG_SYS_FSL_HAS_DDR3
	select UBOOT_CONFIG_SYS_FSL_HAS_SEC
	select UBOOT_CONFIG_SYS_FSL_SEC_BE
	select UBOOT_CONFIG_SYS_FSL_SEC_COMPAT_2
	select UBOOT_CONFIG_SYS_PPC_E500_USE_DEBUG_TLB
	select UBOOT_CONFIG_FSL_ELBC
	imply CMD_SATA
	imply CMD_REGINFO

config UBOOT_CONFIG_ARCH_P2020
	bool
	select UBOOT_CONFIG_FSL_LAW
	select UBOOT_CONFIG_SYS_CACHE_SHIFT_5
	select UBOOT_CONFIG_SYS_FSL_ERRATUM_A004477
	select UBOOT_CONFIG_SYS_FSL_ERRATUM_A004508
	select UBOOT_CONFIG_SYS_FSL_ERRATUM_A005125
	select UBOOT_CONFIG_SYS_FSL_ERRATUM_ESDHC111
	select UBOOT_CONFIG_SYS_FSL_ERRATUM_ESDHC_A001
	select UBOOT_CONFIG_FSL_PCIE_RESET
	select UBOOT_CONFIG_SYS_FSL_HAS_DDR3
	select UBOOT_CONFIG_SYS_FSL_HAS_SEC
	select UBOOT_CONFIG_SYS_FSL_SEC_BE
	select UBOOT_CONFIG_SYS_FSL_SEC_COMPAT_2
	select UBOOT_CONFIG_SYS_PPC_E500_USE_DEBUG_TLB
	select UBOOT_CONFIG_FSL_ELBC
	imply CMD_EEPROM
	imply CMD_NAND
	imply CMD_REGINFO

config UBOOT_CONFIG_ARCH_P2041
	bool
	select UBOOT_CONFIG_E500MC
	select UBOOT_CONFIG_FSL_LAW
	select UBOOT_CONFIG_SYS_CACHE_SHIFT_6
	select UBOOT_CONFIG_SYS_FSL_ERRATUM_A004510
	select UBOOT_CONFIG_SYS_FSL_ERRATUM_A004849
	select UBOOT_CONFIG_SYS_FSL_ERRATUM_A005275
	select UBOOT_CONFIG_SYS_FSL_ERRATUM_A006261
	select UBOOT_CONFIG_SYS_FSL_ERRATUM_CPU_A003999
	select UBOOT_CONFIG_SYS_FSL_ERRATUM_DDR_A003
	select UBOOT_CONFIG_SYS_FSL_ERRATUM_DDR_A003474
	select UBOOT_CONFIG_SYS_FSL_ERRATUM_ESDHC111
	select UBOOT_CONFIG_SYS_FSL_ERRATUM_I2C_A004447
	select UBOOT_CONFIG_SYS_FSL_ERRATUM_NMG_CPU_A011
	select UBOOT_CONFIG_SYS_FSL_ERRATUM_SRIO_A004034
	select UBOOT_CONFIG_SYS_FSL_ERRATUM_USB14
	select UBOOT_CONFIG_SYS_FSL_HAS_DDR3
	select UBOOT_CONFIG_SYS_FSL_HAS_SEC
	select UBOOT_CONFIG_SYS_FSL_QORIQ_CHASSIS1
	select UBOOT_CONFIG_SYS_FSL_SEC_BE
	select UBOOT_CONFIG_SYS_FSL_SEC_COMPAT_4
	select UBOOT_CONFIG_FSL_ELBC
	imply CMD_NAND

config UBOOT_CONFIG_ARCH_P3041
	bool
	select UBOOT_CONFIG_E500MC
	select UBOOT_CONFIG_FSL_LAW
	select UBOOT_CONFIG_SYS_CACHE_SHIFT_6
	select UBOOT_CONFIG_SYS_FSL_DDR_VER_44
	select UBOOT_CONFIG_SYS_FSL_ERRATUM_A004510
	select UBOOT_CONFIG_SYS_FSL_ERRATUM_A004849
	select UBOOT_CONFIG_SYS_FSL_ERRATUM_A005275
	select UBOOT_CONFIG_SYS_FSL_ERRATUM_A005812
	select UBOOT_CONFIG_SYS_FSL_ERRATUM_A006261
	select UBOOT_CONFIG_SYS_FSL_ERRATUM_CPU_A003999
	select UBOOT_CONFIG_SYS_FSL_ERRATUM_DDR_A003
	select UBOOT_CONFIG_SYS_FSL_ERRATUM_DDR_A003474
	select UBOOT_CONFIG_SYS_FSL_ERRATUM_ESDHC111
	select UBOOT_CONFIG_SYS_FSL_ERRATUM_I2C_A004447
	select UBOOT_CONFIG_SYS_FSL_ERRATUM_NMG_CPU_A011
	select UBOOT_CONFIG_SYS_FSL_ERRATUM_SRIO_A004034
	select UBOOT_CONFIG_SYS_FSL_ERRATUM_USB14
	select UBOOT_CONFIG_SYS_FSL_HAS_DDR3
	select UBOOT_CONFIG_SYS_FSL_HAS_SEC
	select UBOOT_CONFIG_SYS_FSL_QORIQ_CHASSIS1
	select UBOOT_CONFIG_SYS_FSL_SEC_BE
	select UBOOT_CONFIG_SYS_FSL_SEC_COMPAT_4
	select UBOOT_CONFIG_FSL_ELBC
	imply CMD_NAND
	imply CMD_SATA
	imply CMD_REGINFO
	imply FSL_SATA

config UBOOT_CONFIG_ARCH_P4080
	bool
	select UBOOT_CONFIG_E500MC
	select UBOOT_CONFIG_FSL_LAW
	select UBOOT_CONFIG_SYS_CACHE_SHIFT_6
	select UBOOT_CONFIG_SYS_FSL_DDR_VER_44
	select UBOOT_CONFIG_SYS_FSL_ERRATUM_A004510
	select UBOOT_CONFIG_SYS_FSL_ERRATUM_A004580
	select UBOOT_CONFIG_SYS_FSL_ERRATUM_A004849
	select UBOOT_CONFIG_SYS_FSL_ERRATUM_A005812
	select UBOOT_CONFIG_SYS_FSL_ERRATUM_A007075
	select UBOOT_CONFIG_SYS_FSL_ERRATUM_CPC_A002
	select UBOOT_CONFIG_SYS_FSL_ERRATUM_CPC_A003
	select UBOOT_CONFIG_SYS_FSL_ERRATUM_CPU_A003999
	select UBOOT_CONFIG_SYS_FSL_ERRATUM_DDR_A003
	select UBOOT_CONFIG_SYS_FSL_ERRATUM_DDR_A003474
	select UBOOT_CONFIG_SYS_FSL_ERRATUM_ELBC_A001
	select UBOOT_CONFIG_SYS_FSL_ERRATUM_ESDHC111
	select UBOOT_CONFIG_SYS_FSL_ERRATUM_ESDHC13
	select UBOOT_CONFIG_SYS_FSL_ERRATUM_ESDHC135
	select UBOOT_CONFIG_SYS_FSL_ERRATUM_I2C_A004447
	select UBOOT_CONFIG_SYS_FSL_ERRATUM_NMG_CPU_A011
	select UBOOT_CONFIG_SYS_FSL_ERRATUM_SRIO_A004034
	select UBOOT_CONFIG_SYS_P4080_ERRATUM_CPU22
	select UBOOT_CONFIG_SYS_P4080_ERRATUM_PCIE_A003
	select UBOOT_CONFIG_SYS_P4080_ERRATUM_SERDES8
	select UBOOT_CONFIG_SYS_P4080_ERRATUM_SERDES9
	select UBOOT_CONFIG_SYS_P4080_ERRATUM_SERDES_A001
	select UBOOT_CONFIG_SYS_P4080_ERRATUM_SERDES_A005
	select UBOOT_CONFIG_SYS_FSL_HAS_DDR3
	select UBOOT_CONFIG_SYS_FSL_HAS_SEC
	select UBOOT_CONFIG_SYS_FSL_QORIQ_CHASSIS1
	select UBOOT_CONFIG_SYS_FSL_SEC_BE
	select UBOOT_CONFIG_SYS_FSL_SEC_COMPAT_4
	select UBOOT_CONFIG_FSL_ELBC
	imply CMD_SATA
	imply CMD_REGINFO
	imply SATA_SIL

config UBOOT_CONFIG_ARCH_P5040
	bool
	select UBOOT_CONFIG_E500MC
	select UBOOT_CONFIG_FSL_LAW
	select UBOOT_CONFIG_SYS_CACHE_SHIFT_6
	select UBOOT_CONFIG_SYS_FSL_DDR_VER_44
	select UBOOT_CONFIG_SYS_FSL_ERRATUM_A004510
	select UBOOT_CONFIG_SYS_FSL_ERRATUM_A004699
	select UBOOT_CONFIG_SYS_FSL_ERRATUM_A005275
	select UBOOT_CONFIG_SYS_FSL_ERRATUM_A005812
	select UBOOT_CONFIG_SYS_FSL_ERRATUM_A006261
	select UBOOT_CONFIG_SYS_FSL_ERRATUM_DDR_A003
	select UBOOT_CONFIG_SYS_FSL_ERRATUM_DDR_A003474
	select UBOOT_CONFIG_SYS_FSL_ERRATUM_ESDHC111
	select UBOOT_CONFIG_SYS_FSL_ERRATUM_USB14
	select UBOOT_CONFIG_SYS_FSL_HAS_DDR3
	select UBOOT_CONFIG_SYS_FSL_HAS_SEC
	select UBOOT_CONFIG_SYS_FSL_QORIQ_CHASSIS1
	select UBOOT_CONFIG_SYS_FSL_SEC_BE
	select UBOOT_CONFIG_SYS_FSL_SEC_COMPAT_4
	select UBOOT_CONFIG_SYS_PPC64
	select UBOOT_CONFIG_FSL_ELBC
	imply CMD_SATA
	imply CMD_REGINFO
	imply FSL_SATA

config UBOOT_CONFIG_ARCH_QEMU_E500
	bool
	select UBOOT_CONFIG_SYS_CACHE_SHIFT_5

config UBOOT_CONFIG_ARCH_T1024
	bool
	select UBOOT_CONFIG_E500MC
	select UBOOT_CONFIG_FSL_LAW
	select UBOOT_CONFIG_SYS_CACHE_SHIFT_6
	select UBOOT_CONFIG_SYS_FSL_DDR_VER_50
	select UBOOT_CONFIG_SYS_FSL_ERRATUM_A008378
	select UBOOT_CONFIG_SYS_FSL_ERRATUM_A008109
	select UBOOT_CONFIG_SYS_FSL_ERRATUM_A009663
	select UBOOT_CONFIG_SYS_FSL_ERRATUM_A009942
	select UBOOT_CONFIG_SYS_FSL_ERRATUM_ESDHC111
	select UBOOT_CONFIG_SYS_FSL_HAS_DDR3
	select UBOOT_CONFIG_SYS_FSL_HAS_DDR4
	select UBOOT_CONFIG_SYS_FSL_HAS_SEC
	select UBOOT_CONFIG_SYS_FSL_QORIQ_CHASSIS2
	select UBOOT_CONFIG_SYS_FSL_SEC_BE
	select UBOOT_CONFIG_SYS_FSL_SEC_COMPAT_5
	select UBOOT_CONFIG_FSL_IFC
	imply CMD_EEPROM
	imply CMD_NAND
	imply CMD_MTDPARTS
	imply CMD_REGINFO

config UBOOT_CONFIG_ARCH_T1040
	bool
	select UBOOT_CONFIG_E500MC
	select UBOOT_CONFIG_FSL_LAW
	select UBOOT_CONFIG_SYS_CACHE_SHIFT_6
	select UBOOT_CONFIG_SYS_FSL_DDR_VER_50
	select UBOOT_CONFIG_SYS_FSL_ERRATUM_A008044
	select UBOOT_CONFIG_SYS_FSL_ERRATUM_A008378
	select UBOOT_CONFIG_SYS_FSL_ERRATUM_A008109
	select UBOOT_CONFIG_SYS_FSL_ERRATUM_A009663
	select UBOOT_CONFIG_SYS_FSL_ERRATUM_A009942
	select UBOOT_CONFIG_SYS_FSL_ERRATUM_ESDHC111
	select UBOOT_CONFIG_SYS_FSL_HAS_DDR3
	select UBOOT_CONFIG_SYS_FSL_HAS_DDR4
	select UBOOT_CONFIG_SYS_FSL_HAS_SEC
	select UBOOT_CONFIG_SYS_FSL_QORIQ_CHASSIS2
	select UBOOT_CONFIG_SYS_FSL_SEC_BE
	select UBOOT_CONFIG_SYS_FSL_SEC_COMPAT_5
	select UBOOT_CONFIG_FSL_IFC
	imply CMD_MTDPARTS
	imply CMD_NAND
	imply CMD_REGINFO

config UBOOT_CONFIG_ARCH_T1042
	bool
	select UBOOT_CONFIG_E500MC
	select UBOOT_CONFIG_FSL_LAW
	select UBOOT_CONFIG_SYS_CACHE_SHIFT_6
	select UBOOT_CONFIG_SYS_FSL_DDR_VER_50
	select UBOOT_CONFIG_SYS_FSL_ERRATUM_A008044
	select UBOOT_CONFIG_SYS_FSL_ERRATUM_A008378
	select UBOOT_CONFIG_SYS_FSL_ERRATUM_A008109
	select UBOOT_CONFIG_SYS_FSL_ERRATUM_A009663
	select UBOOT_CONFIG_SYS_FSL_ERRATUM_A009942
	select UBOOT_CONFIG_SYS_FSL_ERRATUM_ESDHC111
	select UBOOT_CONFIG_SYS_FSL_HAS_DDR3
	select UBOOT_CONFIG_SYS_FSL_HAS_DDR4
	select UBOOT_CONFIG_SYS_FSL_HAS_SEC
	select UBOOT_CONFIG_SYS_FSL_QORIQ_CHASSIS2
	select UBOOT_CONFIG_SYS_FSL_SEC_BE
	select UBOOT_CONFIG_SYS_FSL_SEC_COMPAT_5
	select UBOOT_CONFIG_FSL_IFC
	imply CMD_MTDPARTS
	imply CMD_NAND
	imply CMD_REGINFO

config UBOOT_CONFIG_ARCH_T2080
	bool
	select UBOOT_CONFIG_E500MC
	select UBOOT_CONFIG_E6500
	select UBOOT_CONFIG_FSL_LAW
	select UBOOT_CONFIG_SYS_CACHE_SHIFT_6
	select UBOOT_CONFIG_SYS_FSL_DDR_VER_47
	select UBOOT_CONFIG_SYS_FSL_ERRATUM_A006379
	select UBOOT_CONFIG_SYS_FSL_ERRATUM_A006593
	select UBOOT_CONFIG_SYS_FSL_ERRATUM_A007186
	select UBOOT_CONFIG_SYS_FSL_ERRATUM_A007212
	select UBOOT_CONFIG_SYS_FSL_ERRATUM_A007815
	select UBOOT_CONFIG_SYS_FSL_ERRATUM_A007907
	select UBOOT_CONFIG_SYS_FSL_ERRATUM_A008109
	select UBOOT_CONFIG_SYS_FSL_ERRATUM_A009942
	select UBOOT_CONFIG_SYS_FSL_ERRATUM_ESDHC111
	select UBOOT_CONFIG_FSL_PCIE_RESET
	select UBOOT_CONFIG_SYS_FSL_HAS_DDR3
	select UBOOT_CONFIG_SYS_FSL_HAS_SEC
	select UBOOT_CONFIG_SYS_FSL_QORIQ_CHASSIS2
	select UBOOT_CONFIG_SYS_FSL_SEC_BE
	select UBOOT_CONFIG_SYS_FSL_SEC_COMPAT_4
	select UBOOT_CONFIG_SYS_PPC64
	select UBOOT_CONFIG_FSL_IFC
	imply CMD_SATA
	imply CMD_NAND
	imply CMD_REGINFO
	imply FSL_SATA
	imply ID_EEPROM

config UBOOT_CONFIG_ARCH_T4240
	bool
	select UBOOT_CONFIG_E500MC
	select UBOOT_CONFIG_E6500
	select UBOOT_CONFIG_FSL_LAW
	select UBOOT_CONFIG_SYS_CACHE_SHIFT_6
	select UBOOT_CONFIG_SYS_FSL_DDR_VER_47
	select UBOOT_CONFIG_SYS_FSL_ERRATUM_A004468
	select UBOOT_CONFIG_SYS_FSL_ERRATUM_A005871
	select UBOOT_CONFIG_SYS_FSL_ERRATUM_A006261
	select UBOOT_CONFIG_SYS_FSL_ERRATUM_A006379
	select UBOOT_CONFIG_SYS_FSL_ERRATUM_A006593
	select UBOOT_CONFIG_SYS_FSL_ERRATUM_A007186
	select UBOOT_CONFIG_SYS_FSL_ERRATUM_A007798
	select UBOOT_CONFIG_SYS_FSL_ERRATUM_A007815
	select UBOOT_CONFIG_SYS_FSL_ERRATUM_A007907
	select UBOOT_CONFIG_SYS_FSL_ERRATUM_A008109
	select UBOOT_CONFIG_SYS_FSL_ERRATUM_A009942
	select UBOOT_CONFIG_SYS_FSL_HAS_DDR3
	select UBOOT_CONFIG_SYS_FSL_HAS_SEC
	select UBOOT_CONFIG_SYS_FSL_QORIQ_CHASSIS2
	select UBOOT_CONFIG_SYS_FSL_SEC_BE
	select UBOOT_CONFIG_SYS_FSL_SEC_COMPAT_4
	select UBOOT_CONFIG_SYS_PPC64
	select UBOOT_CONFIG_FSL_IFC
	imply CMD_SATA
	imply CMD_NAND
	imply CMD_REGINFO
	imply FSL_SATA

config UBOOT_CONFIG_MPC85XX_HAVE_RESET_VECTOR
	bool "Indicate reset vector at CONFIG_RESET_VECTOR_ADDRESS - 0xffc"
	depends on UBOOT_CONFIG_MPC85xx

config UBOOT_CONFIG_BOOKE
	bool
	default y

config UBOOT_CONFIG_E500
	bool
	default y
	help
		Enable PowerPC E500 cores, including e500v1, e500v2, e500mc

config UBOOT_CONFIG_E500MC
	bool
	imply CMD_PCI
	help
		Enble PowerPC E500MC core

config UBOOT_CONFIG_E6500
	bool
	help
		Enable PowerPC E6500 core

config UBOOT_CONFIG_FSL_LAW
	bool
	help
		Use Freescale common code for Local Access Window

config UBOOT_CONFIG_NXP_ESBC
	bool	"NXP_ESBC"
	help
		Enable Freescale Secure Boot feature. Normally selected
		by defconfig. If unsure, do not change.

config UBOOT_CONFIG_MAX_CPUS
	int "Maximum number of CPUs permitted for MPC85xx"
	default 12 if UBOOT_CONFIG_ARCH_T4240
	default 8 if UBOOT_CONFIG_ARCH_P4080
	default 4 if UBOOT_CONFIG_ARCH_B4860 || \
		     ARCH_P2041 || \
		     ARCH_P3041 || \
		     ARCH_P5040 || \
		     ARCH_T1040 || \
		     ARCH_T1042 || \
		     ARCH_T2080
	default 2 if UBOOT_CONFIG_ARCH_B4420 || \
		     ARCH_BSC9132 || \
		     ARCH_P1020 || \
		     ARCH_P1021 || \
		     ARCH_P1023 || \
		     ARCH_P1024 || \
		     ARCH_P1025 || \
		     ARCH_P2020 || \
		     ARCH_T1024
	default 1
	help
	  Set this number to the maximum number of possible CPUs in the SoC.
	  SoCs may have multiple clusters with each cluster may have multiple
	  ports. If some ports are reserved but higher ports are used for
	  cores, count the reserved ports. This will allocate enough memory
	  in spin table to properly handle all cores.

config UBOOT_CONFIG_SYS_CCSRBAR_DEFAULT
	hex "Default CCSRBAR address"
	default	0xff700000 if UBOOT_CONFIG_ARCH_BSC9131	|| \
				ARCH_BSC9132	|| \
				ARCH_C29X	|| \
				ARCH_MPC8536	|| \
				ARCH_MPC8540	|| \
				ARCH_MPC8544	|| \
				ARCH_MPC8548	|| \
				ARCH_MPC8560	|| \
				ARCH_P1010	|| \
				ARCH_P1011	|| \
				ARCH_P1020	|| \
				ARCH_P1021	|| \
				ARCH_P1024	|| \
				ARCH_P1025	|| \
				ARCH_P2020
	default 0xff600000 if UBOOT_CONFIG_ARCH_P1023
	default 0xfe000000 if UBOOT_CONFIG_ARCH_B4420	|| \
				ARCH_B4860	|| \
				ARCH_P2041	|| \
				ARCH_P3041	|| \
				ARCH_P4080	|| \
				ARCH_P5040	|| \
				ARCH_T1024	|| \
				ARCH_T1040	|| \
				ARCH_T1042	|| \
				ARCH_T2080	|| \
				ARCH_T4240
	default 0xe0000000 if UBOOT_CONFIG_ARCH_QEMU_E500
	help
		Default value of CCSRBAR comes from power-on-reset. It
		is fixed on each SoC. Some SoCs can have different value
		if changed by pre-boot regime. The value here must match
		the current value in SoC. If not sure, do not change.

config UBOOT_CONFIG_SYS_FSL_ERRATUM_A004468
	bool

config UBOOT_CONFIG_SYS_FSL_ERRATUM_A004477
	bool

config UBOOT_CONFIG_SYS_FSL_ERRATUM_A004508
	bool

config UBOOT_CONFIG_SYS_FSL_ERRATUM_A004580
	bool

config UBOOT_CONFIG_SYS_FSL_ERRATUM_A004699
	bool

config UBOOT_CONFIG_SYS_FSL_ERRATUM_A004849
	bool

config UBOOT_CONFIG_SYS_FSL_ERRATUM_A004510
	bool

config UBOOT_CONFIG_SYS_FSL_ERRATUM_A004510_SVR_REV
	hex
	depends on UBOOT_CONFIG_SYS_FSL_ERRATUM_A004510
	default 0x20 if UBOOT_CONFIG_ARCH_P4080
	default 0x10

config UBOOT_CONFIG_SYS_FSL_ERRATUM_A004510_SVR_REV2
	hex
	depends on (SYS_FSL_ERRATUM_A004510 && (ARCH_P2041 || UBOOT_CONFIG_ARCH_P3041))
	default 0x11

config UBOOT_CONFIG_SYS_FSL_ERRATUM_A005125
	bool

config UBOOT_CONFIG_SYS_FSL_ERRATUM_A005434
	bool

config UBOOT_CONFIG_SYS_FSL_ERRATUM_A005812
	bool

config UBOOT_CONFIG_SYS_FSL_ERRATUM_A005871
	bool

config UBOOT_CONFIG_SYS_FSL_ERRATUM_A005275
	bool

config UBOOT_CONFIG_SYS_FSL_ERRATUM_A006261
	bool

config UBOOT_CONFIG_SYS_FSL_ERRATUM_A006379
	bool

config UBOOT_CONFIG_SYS_FSL_ERRATUM_A006384
	bool

config UBOOT_CONFIG_SYS_FSL_ERRATUM_A006475
	bool

config UBOOT_CONFIG_SYS_FSL_ERRATUM_A006593
	bool

config UBOOT_CONFIG_SYS_FSL_ERRATUM_A007075
	bool

config UBOOT_CONFIG_SYS_FSL_ERRATUM_A007186
	bool

config UBOOT_CONFIG_SYS_FSL_ERRATUM_A007212
	bool

config UBOOT_CONFIG_SYS_FSL_ERRATUM_A007815
	bool

config UBOOT_CONFIG_SYS_FSL_ERRATUM_A007798
	bool

config UBOOT_CONFIG_SYS_FSL_ERRATUM_A007907
	bool

config UBOOT_CONFIG_SYS_FSL_ERRATUM_A008044
	bool

config UBOOT_CONFIG_SYS_FSL_ERRATUM_CPC_A002
	bool

config UBOOT_CONFIG_SYS_FSL_ERRATUM_CPC_A003
	bool

config UBOOT_CONFIG_SYS_FSL_ERRATUM_CPU_A003999
	bool

config UBOOT_CONFIG_SYS_FSL_ERRATUM_ELBC_A001
	bool

config UBOOT_CONFIG_SYS_FSL_ERRATUM_I2C_A004447
	bool

config UBOOT_CONFIG_SYS_FSL_A004447_SVR_REV
	hex
	depends on UBOOT_CONFIG_SYS_FSL_ERRATUM_I2C_A004447
	default 0x00 if UBOOT_CONFIG_ARCH_MPC8548
	default 0x10 if UBOOT_CONFIG_ARCH_P1010
	default 0x11 if UBOOT_CONFIG_ARCH_P1023 || UBOOT_CONFIG_ARCH_P2041 || UBOOT_CONFIG_ARCH_BSC9132
	default 0x20 if UBOOT_CONFIG_ARCH_P3041 || UBOOT_CONFIG_ARCH_P4080

config UBOOT_CONFIG_SYS_FSL_ERRATUM_IFC_A002769
	bool

config UBOOT_CONFIG_SYS_FSL_ERRATUM_IFC_A003399
	bool

config UBOOT_CONFIG_SYS_FSL_ERRATUM_NMG_CPU_A011
	bool

config UBOOT_CONFIG_SYS_FSL_ERRATUM_NMG_ETSEC129
	bool

config UBOOT_CONFIG_SYS_FSL_ERRATUM_NMG_LBC103
	bool

config UBOOT_CONFIG_SYS_FSL_ERRATUM_P1010_A003549
	bool

config UBOOT_CONFIG_SYS_FSL_ERRATUM_SATA_A001
	bool

config UBOOT_CONFIG_SYS_FSL_ERRATUM_SEC_A003571
	bool

config UBOOT_CONFIG_SYS_FSL_ERRATUM_SRIO_A004034
	bool

config UBOOT_CONFIG_SYS_FSL_ERRATUM_USB14
	bool

config UBOOT_CONFIG_SYS_P4080_ERRATUM_CPU22
	bool

config UBOOT_CONFIG_SYS_P4080_ERRATUM_PCIE_A003
	bool

config UBOOT_CONFIG_SYS_P4080_ERRATUM_SERDES8
	bool

config UBOOT_CONFIG_SYS_P4080_ERRATUM_SERDES9
	bool

config UBOOT_CONFIG_SYS_P4080_ERRATUM_SERDES_A001
	bool

config UBOOT_CONFIG_SYS_P4080_ERRATUM_SERDES_A005
	bool

config UBOOT_CONFIG_FSL_PCIE_DISABLE_ASPM
	bool

config UBOOT_CONFIG_FSL_PCIE_RESET
	bool

config UBOOT_CONFIG_SYS_FSL_QORIQ_CHASSIS1
	bool

config UBOOT_CONFIG_SYS_FSL_QORIQ_CHASSIS2
	bool

config UBOOT_CONFIG_SYS_FSL_NUM_LAWS
	int "Number of local access windows"
	depends on UBOOT_CONFIG_FSL_LAW
	default 32 if UBOOT_CONFIG_ARCH_B4420	|| \
			ARCH_B4860	|| \
			ARCH_P2041	|| \
			ARCH_P3041	|| \
			ARCH_P4080	|| \
			ARCH_P5040	|| \
			ARCH_T2080	|| \
			ARCH_T4240
	default 16 if UBOOT_CONFIG_ARCH_T1024	|| \
			ARCH_T1040	|| \
			ARCH_T1042
	default 12 if UBOOT_CONFIG_ARCH_BSC9131	|| \
			ARCH_BSC9132	|| \
			ARCH_C29X	|| \
			ARCH_MPC8536	|| \
			ARCH_P1010	|| \
			ARCH_P1011	|| \
			ARCH_P1020	|| \
			ARCH_P1021	|| \
			ARCH_P1023	|| \
			ARCH_P1024	|| \
			ARCH_P1025	|| \
			ARCH_P2020
	default 10 if UBOOT_CONFIG_ARCH_MPC8544	|| \
			ARCH_MPC8548
	default 8 if UBOOT_CONFIG_ARCH_MPC8540	|| \
			ARCH_MPC8560
	help
		Number of local access windows. This is fixed per SoC.
		If not sure, do not change.

config UBOOT_CONFIG_SYS_FSL_THREADS_PER_CORE
	int
	default 2 if UBOOT_CONFIG_E6500
	default 1

config UBOOT_CONFIG_SYS_NUM_TLBCAMS
	int "Number of TLB CAM entries"
	default 64 if UBOOT_CONFIG_E500MC
	default 16
	help
		Number of TLB CAM entries for Book-E chips. 64 for E500MC,
		16 for other E500 SoCs.

config UBOOT_CONFIG_SYS_PPC64
	bool

config UBOOT_CONFIG_SYS_PPC_E500_USE_DEBUG_TLB
	bool

config UBOOT_CONFIG_FSL_IFC
	bool

config UBOOT_CONFIG_FSL_ELBC
	bool

config UBOOT_CONFIG_SYS_PPC_E500_DEBUG_TLB
	int "Temporary TLB entry for external debugger"
	depends on UBOOT_CONFIG_SYS_PPC_E500_USE_DEBUG_TLB
	default 0 if UBOOT_CONFIG_ARCH_MPC8544 || UBOOT_CONFIG_ARCH_MPC8548
	default 1 if UBOOT_CONFIG_ARCH_MPC8536
	default 2 if UBOOT_CONFIG_ARCH_P1011	|| \
			ARCH_P1020	|| \
			ARCH_P1021	|| \
			ARCH_P1024	|| \
			ARCH_P1025	|| \
			ARCH_P2020
	default 3 if UBOOT_CONFIG_ARCH_P1010	|| \
			ARCH_BSC9132	|| \
			ARCH_C29X
	help
		Select a temporary TLB entry to be used during boot to work
                around limitations in e500v1 and e500v2 external debugger
                support. This reduces the portions of the boot code where
                breakpoints and single stepping do not work. The value of this
                symbol should be set to the TLB1 entry to be used for this
                purpose. If unsure, do not change.

config UBOOT_CONFIG_SYS_FSL_IFC_CLK_DIV
	int "Divider of platform clock"
	depends on UBOOT_CONFIG_FSL_IFC
	default 2 if UBOOT_CONFIG_ARCH_B4420	|| \
			ARCH_B4860	|| \
			ARCH_T1024	|| \
			ARCH_T1040	|| \
			ARCH_T1042	|| \
			ARCH_T4240
	default 1
	help
		Defines divider of platform clock(clock input to
		IFC controller).

config UBOOT_CONFIG_SYS_FSL_LBC_CLK_DIV
	int "Divider of platform clock"
	depends on UBOOT_CONFIG_FSL_ELBC || UBOOT_CONFIG_ARCH_MPC8540 || \
		ARCH_MPC8548 || \
		ARCH_MPC8560

	default 2 if UBOOT_CONFIG_ARCH_P2041	|| \
			ARCH_P3041	|| \
			ARCH_P4080	|| \
			ARCH_P5040
	default 1

	help
		Defines divider of platform clock(clock input to
		eLBC controller).

config UBOOT_CONFIG_FSL_VIA
	bool

source "../../../../board/emulation/qemu-ppce500/Kconfig"
source "../../../../board/freescale/corenet_ds/Kconfig"
source "../../../../board/freescale/mpc8548cds/Kconfig"
source "../../../../board/freescale/p1010rdb/Kconfig"
source "../../../../board/freescale/p1_p2_rdb_pc/Kconfig"
source "../../../../board/freescale/p2041rdb/Kconfig"
source "../../../../board/freescale/t102xrdb/Kconfig"
source "../../../../board/freescale/t104xrdb/Kconfig"
source "../../../../board/freescale/t208xqds/Kconfig"
source "../../../../board/freescale/t208xrdb/Kconfig"
source "../../../../board/freescale/t4rdb/Kconfig"
source "../../../../board/keymile/Kconfig"
source "../../../../board/socrates/Kconfig"

endmenu
```
