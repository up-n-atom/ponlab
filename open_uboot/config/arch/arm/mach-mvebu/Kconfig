## open_uboot/config/arch/arm/mach-stm32/Kconfig
```kconfig
if UBOOT_CONFIG_ARCH_STM32

config UBOOT_CONFIG_STM32F4
	bool "stm32f4 family"
	select UBOOT_CONFIG_CLK
	select UBOOT_CONFIG_DM_GPIO
	select UBOOT_CONFIG_DM_RESET
	select UBOOT_CONFIG_MISC
	select UBOOT_CONFIG_PINCTRL
	select UBOOT_CONFIG_PINCTRL_STM32
	select UBOOT_CONFIG_RAM
	select UBOOT_CONFIG_STM32_RCC
	select UBOOT_CONFIG_STM32_RESET
	select UBOOT_CONFIG_STM32_SDRAM
	select UBOOT_CONFIG_STM32_SERIAL
	select UBOOT_CONFIG_STM32_TIMER
	select UBOOT_CONFIG_TIMER

config UBOOT_CONFIG_STM32F7
	bool "stm32f7 family"
	select UBOOT_CONFIG_CLK
	select UBOOT_CONFIG_DM_GPIO
	select UBOOT_CONFIG_DM_RESET
	select UBOOT_CONFIG_MISC
	select UBOOT_CONFIG_PINCTRL
	select UBOOT_CONFIG_PINCTRL_STM32
	select UBOOT_CONFIG_RAM
	select UBOOT_CONFIG_SPL
	select UBOOT_CONFIG_SPL_BOARD_INIT
	select UBOOT_CONFIG_SPL_CLK
	select UBOOT_CONFIG_SPL_DM
	select UBOOT_CONFIG_SPL_DM_RESET
	select UBOOT_CONFIG_SPL_DM_SEQ_ALIAS
	select UBOOT_CONFIG_SPL_DRIVERS_MISC
	select UBOOT_CONFIG_SPL_GPIO
	select UBOOT_CONFIG_SPL_LIBCOMMON_SUPPORT
	select UBOOT_CONFIG_SPL_LIBGENERIC_SUPPORT
	select UBOOT_CONFIG_SPL_MTD_SUPPORT
	select UBOOT_CONFIG_SPL_OF_CONTROL
	select UBOOT_CONFIG_SPL_OF_LIBFDT
	select UBOOT_CONFIG_SPL_OF_TRANSLATE
	select UBOOT_CONFIG_SPL_PINCTRL
	select UBOOT_CONFIG_SPL_RAM
	select UBOOT_CONFIG_SPL_SERIAL
	select UBOOT_CONFIG_SPL_SYS_MALLOC_SIMPLE
	select UBOOT_CONFIG_SPL_TIMER
	select UBOOT_CONFIG_SPL_XIP_SUPPORT
	select UBOOT_CONFIG_STM32_RCC
	select UBOOT_CONFIG_STM32_RESET
	select UBOOT_CONFIG_STM32_SDRAM
	select UBOOT_CONFIG_STM32_SERIAL
	select UBOOT_CONFIG_STM32_TIMER
	select UBOOT_CONFIG_SUPPORT_SPL
	select UBOOT_CONFIG_TIMER
	imply SPL_OS_BOOT

config UBOOT_CONFIG_STM32H7
	bool "stm32h7 family"
	select UBOOT_CONFIG_CLK
	select UBOOT_CONFIG_DM_GPIO
	select UBOOT_CONFIG_DM_RESET
	select UBOOT_CONFIG_MISC
	select UBOOT_CONFIG_PINCTRL
	select UBOOT_CONFIG_PINCTRL_STM32
	select UBOOT_CONFIG_RAM
	select UBOOT_CONFIG_REGMAP
	select UBOOT_CONFIG_STM32_RCC
	select UBOOT_CONFIG_STM32_RESET
	select UBOOT_CONFIG_STM32_SDRAM
	select UBOOT_CONFIG_STM32_SERIAL
	select UBOOT_CONFIG_STM32_TIMER
	select UBOOT_CONFIG_SYSCON
	select UBOOT_CONFIG_TIMER

source "stm32f4/Kconfig"
source "stm32f7/Kconfig"
source "stm32h7/Kconfig"

endif
```

## open_uboot/config/arch/arm/mach-stm32/stm32h7/Kconfig
```kconfig
if UBOOT_CONFIG_STM32H7

config UBOOT_CONFIG_TARGET_STM32H743_DISCO
	bool "STM32H743 Discovery board"

config UBOOT_CONFIG_TARGET_STM32H743_EVAL
	bool "STM32H743 Evaluation board"

config UBOOT_CONFIG_TARGET_STM32H750_ART_PI
	bool "STM32H750 ART Pi board"

source "../../../../board/st/stm32h743-eval/Kconfig"
source "../../../../board/st/stm32h743-disco/Kconfig"
source "../../../../board/st/stm32h750-art-pi/Kconfig"

endif
```

## open_uboot/config/arch/arm/mach-tegra/tegra114/Kconfig
```kconfig
if UBOOT_CONFIG_TEGRA114

choice
	prompt "Tegra114 board select"
	optional

config UBOOT_CONFIG_TARGET_DALMORE
	bool "NVIDIA Tegra114 Dalmore evaluation board"
	select UBOOT_CONFIG_BOARD_LATE_INIT

endchoice

config UBOOT_CONFIG_SYS_SOC
	default "tegra114"

source "../../../../board/nvidia/dalmore/Kconfig"

endif
```

## open_uboot/config/arch/arm/mach-tegra/tegra20/Kconfig
```kconfig
if UBOOT_CONFIG_TEGRA20

choice
	prompt "Tegra20 board select"
	optional

config UBOOT_CONFIG_TARGET_HARMONY
	bool "NVIDIA Tegra20 Harmony evaluation board"
	select UBOOT_CONFIG_BOARD_LATE_INIT

config UBOOT_CONFIG_TARGET_MEDCOM_WIDE
	bool "Avionic Design Medcom-Wide board"
	select UBOOT_CONFIG_BOARD_LATE_INIT

config UBOOT_CONFIG_TARGET_PAZ00
	bool "Paz00 board"
	select UBOOT_CONFIG_BOARD_LATE_INIT

config UBOOT_CONFIG_TARGET_PLUTUX
	bool "Avionic Design Plutux board"
	select UBOOT_CONFIG_BOARD_LATE_INIT

config UBOOT_CONFIG_TARGET_SEABOARD
	bool "NVIDIA Seaboard"
	select UBOOT_CONFIG_BOARD_LATE_INIT

config UBOOT_CONFIG_TARGET_TEC
	bool "Avionic Design Tamonten Evaluation Carrier"
	select UBOOT_CONFIG_BOARD_LATE_INIT

config UBOOT_CONFIG_TARGET_TRIMSLICE
	bool "Compulab TrimSlice board"
	select UBOOT_CONFIG_BOARD_LATE_INIT

config UBOOT_CONFIG_TARGET_VENTANA
	bool "NVIDIA Tegra20 Ventana evaluation board"
	select UBOOT_CONFIG_BOARD_LATE_INIT

config UBOOT_CONFIG_TARGET_COLIBRI_T20
	bool "Toradex Colibri T20 board"
	select UBOOT_CONFIG_BOARD_LATE_INIT

endchoice

config UBOOT_CONFIG_SYS_SOC
	default "tegra20"

source "../../../../board/nvidia/harmony/Kconfig"
source "../../../../board/avionic-design/medcom-wide/Kconfig"
source "../../../../board/compal/paz00/Kconfig"
source "../../../../board/avionic-design/plutux/Kconfig"
source "../../../../board/nvidia/seaboard/Kconfig"
source "../../../../board/avionic-design/tec/Kconfig"
source "../../../../board/compulab/trimslice/Kconfig"
source "../../../../board/nvidia/ventana/Kconfig"
source "../../../../board/toradex/colibri_t20/Kconfig"

endif
```

## open_uboot/config/arch/arm/mach-tegra/tegra210/Kconfig
```kconfig
if UBOOT_CONFIG_TEGRA210

choice
	prompt "Tegra210 board select"

config UBOOT_CONFIG_TARGET_P2371_0000
	bool "NVIDIA Tegra210 P2371-0000 board"
	select UBOOT_CONFIG_BOARD_LATE_INIT
	help
	  P2371-0000 is a P2581 or P2530 CPU board married to a P2595 I/O
	  board. The combination contains SoC, DRAM, eMMC, SD card slot,
	  HDMI, USB micro-B port, Ethernet via USB3, USB3 host port, SATA,
	  a GPIO expansion header, and an analog audio jack.

config UBOOT_CONFIG_TARGET_P2371_2180
	bool "NVIDIA Tegra210 P2371-2180 (Jetson TX1) board"
	select UBOOT_CONFIG_BOARD_LATE_INIT
	help
	  P2371-2180 (Jetson TX1 developer kit) is a P2180 CPU board married
	  to a P2597 I/O board. The combination contains SoC, DRAM, eMMC, SD
	  card slot, HDMI, USB micro-B port, Ethernet via USB3, USB3 host
	  port, SATA, PCIe, and two GPIO expansion headers.

config UBOOT_CONFIG_TARGET_P2571
	bool "NVIDIA Tegra210 P2571 base board"
	select UBOOT_CONFIG_BOARD_LATE_INIT
	help
	  P2571 is a P2530 married to a P1963 I/O board

config UBOOT_CONFIG_TARGET_P3450_0000
	bool "NVIDIA Jetson Nano Developer Kit"
	select UBOOT_CONFIG_BOARD_LATE_INIT
	help
	  P3450-0000 is a P3448 CPU board married to a P3449 I/O board.

endchoice

config UBOOT_CONFIG_SYS_SOC
	default "tegra210"

source "../../../../board/nvidia/p2371-0000/Kconfig"
source "../../../../board/nvidia/p2371-2180/Kconfig"
source "../../../../board/nvidia/p2571/Kconfig"
source "../../../../board/nvidia/p3450-0000/Kconfig"

endif
```

## open_uboot/config/arch/arm/mach-uniphier/Kconfig
```kconfig
if UBOOT_CONFIG_ARCH_UNIPHIER

config UBOOT_CONFIG_SYS_CONFIG_NAME
	default "uniphier"

choice
        prompt "UniPhier SoC select"

config UBOOT_CONFIG_ARCH_UNIPHIER_V7_MULTI
	bool "UniPhier V7 SoCs"
	select UBOOT_CONFIG_ARCH_SUPPORT_PSCI
	select UBOOT_CONFIG_ARMV7_NONSEC
	select UBOOT_CONFIG_CPU_V7A
	select UBOOT_CONFIG_CPU_V7_HAS_NONSEC

config UBOOT_CONFIG_ARCH_UNIPHIER_V8_MULTI
	bool "UniPhier V8 SoCs"
	depends on !UBOOT_CONFIG_SPL
	select UBOOT_CONFIG_ARM64
	select UBOOT_CONFIG_CMD_UNZIP

endchoice

config UBOOT_CONFIG_ARCH_UNIPHIER_LD4
	bool "Enable UniPhier LD4 SoC support"
	depends on UBOOT_CONFIG_ARCH_UNIPHIER_V7_MULTI
	depends on !UBOOT_CONFIG_SPL || UBOOT_CONFIG_SPL_TEXT_BASE = 0x00040000
	default y

config UBOOT_CONFIG_ARCH_UNIPHIER_SLD8
	bool "Enable UniPhier sLD8 SoC support"
	depends on UBOOT_CONFIG_ARCH_UNIPHIER_V7_MULTI
	depends on !UBOOT_CONFIG_SPL || UBOOT_CONFIG_SPL_TEXT_BASE = 0x00040000
	default y

config UBOOT_CONFIG_ARCH_UNIPHIER_PRO4
	bool "Enable UniPhier Pro4 SoC support"
	depends on UBOOT_CONFIG_ARCH_UNIPHIER_V7_MULTI
	depends on !UBOOT_CONFIG_SPL || UBOOT_CONFIG_SPL_TEXT_BASE = 0x00100000
	default y

config UBOOT_CONFIG_ARCH_UNIPHIER_PRO5
	bool "Enable UniPhier Pro5 SoC support"
	depends on UBOOT_CONFIG_ARCH_UNIPHIER_V7_MULTI
	depends on !UBOOT_CONFIG_SPL || UBOOT_CONFIG_SPL_TEXT_BASE = 0x00100000
	default y

config UBOOT_CONFIG_ARCH_UNIPHIER_PXS2
	bool "Enable UniPhier Pxs2 SoC support"
	depends on UBOOT_CONFIG_ARCH_UNIPHIER_V7_MULTI
	depends on !UBOOT_CONFIG_SPL || UBOOT_CONFIG_SPL_TEXT_BASE = 0x00100000
	default y

config UBOOT_CONFIG_ARCH_UNIPHIER_LD6B
	bool "Enable UniPhier LD6b SoC support"
	depends on UBOOT_CONFIG_ARCH_UNIPHIER_V7_MULTI
	depends on !UBOOT_CONFIG_SPL || UBOOT_CONFIG_SPL_TEXT_BASE = 0x00100000
	default y

config UBOOT_CONFIG_ARCH_UNIPHIER_LD11
	bool "Enable UniPhier LD11 SoC support"
	depends on UBOOT_CONFIG_ARCH_UNIPHIER_V8_MULTI
	default y

config UBOOT_CONFIG_ARCH_UNIPHIER_LD20
	bool "Enable UniPhier LD20 SoC support"
	depends on UBOOT_CONFIG_ARCH_UNIPHIER_V8_MULTI
	default y
	select UBOOT_CONFIG_OF_BOARD_SETUP

config UBOOT_CONFIG_ARCH_UNIPHIER_PXS3
	bool "Enable UniPhier PXs3 SoC support"
	depends on UBOOT_CONFIG_ARCH_UNIPHIER_V8_MULTI
	default y

config UBOOT_CONFIG_CACHE_UNIPHIER
	bool "Enable the UniPhier L2 cache controller"
	depends on UBOOT_CONFIG_ARCH_UNIPHIER_V7_MULTI
	default y
	select UBOOT_CONFIG_SYS_CACHE_SHIFT_7
	help
	  This option allows to use the UniPhier System Cache as L2 cache.

config UBOOT_CONFIG_MICRO_SUPPORT_CARD
	bool "Use Micro Support Card"
	depends on UBOOT_CONFIG_UNIPHIER_SYSTEM_BUS
	help
	  This option provides support for the expansion board, available
	  on some UniPhier reference boards.

	  Say Y to use the on-board UART, Ether, LED devices.

config UBOOT_CONFIG_CMD_PINMON
	bool "Enable boot mode pins monitor command"
	default y
	help
	  The command "pinmon" shows the state of the boot mode pins.
	  The boot mode pins are latched when the system reset is deasserted
	  and determine which device the system should load a boot image from.

config UBOOT_CONFIG_CMD_DDRPHY_DUMP
	bool "Enable dump command of DDR PHY parameters"
	depends on UBOOT_CONFIG_ARCH_UNIPHIER_LD4 || UBOOT_CONFIG_ARCH_UNIPHIER_PRO4 || \
		ARCH_UNIPHIER_SLD8 || UBOOT_CONFIG_ARCH_UNIPHIER_LD11
	default y
	help
	  The command "ddrphy" shows the resulting parameters of DDR PHY
	  training; it is useful for the evaluation of DDR PHY training.

config UBOOT_CONFIG_CMD_DDRMPHY_DUMP
	bool "Enable dump command of DDR Multi PHY parameters"
	depends on UBOOT_CONFIG_ARCH_UNIPHIER_PXS2 || UBOOT_CONFIG_ARCH_UNIPHIER_LD6B
	default y
	help
	  The command "ddrmphy" shows the resulting parameters of DDR Multi PHY
	  training; it is useful for the evaluation of DDR Multi PHY training.

config UBOOT_CONFIG_SYS_SOC
	default "uniphier-v7" if UBOOT_CONFIG_ARCH_UNIPHIER_V7_MULTI
endif
```

## open_uboot/config/arch/arm/mach-zynq/Kconfig
```kconfig
if UBOOT_CONFIG_ARCH_ZYNQ

config UBOOT_CONFIG_SPL_LDSCRIPT
	default "arch/arm/mach-zynq/u-boot-spl.lds"

config UBOOT_CONFIG_SPL_FS_FAT
	default y

config UBOOT_CONFIG_SPL_LIBCOMMON_SUPPORT
	default y

config UBOOT_CONFIG_SPL_LIBDISK_SUPPORT
	default y

config UBOOT_CONFIG_SPL_LIBGENERIC_SUPPORT
	default y

config UBOOT_CONFIG_SPL_MMC
	default y if UBOOT_CONFIG_MMC_SDHCI_ZYNQ

config UBOOT_CONFIG_SPL_SERIAL
	default y

config UBOOT_CONFIG_SPL_SPI_FLASH_SUPPORT
	default y if UBOOT_CONFIG_ZYNQ_QSPI

config UBOOT_CONFIG_SPL_SPI
	default y if UBOOT_CONFIG_ZYNQ_QSPI

config UBOOT_CONFIG_ZYNQ_DDRC_INIT
	bool "Zynq DDRC initialization"
	default y
	help
	  This option used to perform DDR specific initialization
	  if required. There might be cases like ddr less where we
	  want to skip ddr init and this option is useful for it.

config UBOOT_CONFIG_SYS_BOARD
	string "Board name"
	default "zynq"

config UBOOT_CONFIG_SYS_VENDOR
	string "Vendor name"
	default "xilinx"

config UBOOT_CONFIG_SYS_SOC
	default "zynq"

config UBOOT_CONFIG_SYS_CONFIG_NAME
	string "Board configuration name"
	default "zynq-common"
	help
	  This option contains information about board configuration name.
	  Based on this option include/configs/<CONFIG_SYS_CONFIG_NAME>.h header
	  will be used for board configuration.

config UBOOT_CONFIG_SYS_MALLOC_F_LEN
	default 0x800

config UBOOT_CONFIG_SYS_MALLOC_LEN
	default 0x1400000

config UBOOT_CONFIG_BOOT_INIT_FILE
	string "boot.bin init register filename"
	default ""
	help
	  Add register writes to boot.bin format (max 256 pairs).
	  Expect a table of register-value pairs, e.g. "0x12345678 0x4321"

config UBOOT_CONFIG_ZYNQ_SDHCI_MAX_FREQ
	default 52000000

source "../../../board/xilinx/Kconfig"
source "../../../board/xilinx/zynq/Kconfig"

endif
```

## open_uboot/config/arch/microblaze/Kconfig
```kconfig
menu "MicroBlaze architecture"
	depends on UBOOT_CONFIG_MICROBLAZE

config UBOOT_CONFIG_SYS_ARCH
	default "microblaze"

choice
	prompt "Target select"
	optional

config UBOOT_CONFIG_TARGET_MICROBLAZE_GENERIC
	bool "Support microblaze-generic"
	select UBOOT_CONFIG_BOARD_LATE_INIT
	select UBOOT_CONFIG_DM
	select UBOOT_CONFIG_DM_SERIAL
	select UBOOT_CONFIG_OF_CONTROL
	select UBOOT_CONFIG_SUPPORT_SPL
	select UBOOT_CONFIG_SYSRESET
	select UBOOT_CONFIG_DM_SPI
	select UBOOT_CONFIG_DM_SPI_FLASH
	select UBOOT_CONFIG_SPI
	imply CMD_DM

endchoice

source "../../board/xilinx/Kconfig"
source "../../board/xilinx/microblaze-generic/Kconfig"

endmenu
```
