## open_uboot/config/arch/arm/mach-mvebu/Kconfig
```kconfig
if UBOOT_CONFIG_ARCH_MVEBU

config UBOOT_CONFIG_HAVE_MVEBU_EFUSE
	bool

config UBOOT_CONFIG_ARMADA_32BIT
	bool
	select UBOOT_CONFIG_ARCH_MISC_INIT
	select UBOOT_CONFIG_BOARD_EARLY_INIT_F
	select UBOOT_CONFIG_CPU_V7A
	select UBOOT_CONFIG_SPL_DM if SPL
	select UBOOT_CONFIG_SPL_DM_SEQ_ALIAS if SPL
	select UBOOT_CONFIG_SPL_OF_CONTROL if SPL
	select UBOOT_CONFIG_SPL_SKIP_LOWLEVEL_INIT if SPL
	select UBOOT_CONFIG_SPL_SIMPLE_BUS if SPL
	select UBOOT_CONFIG_SUPPORT_SPL
	select UBOOT_CONFIG_TRANSLATION_OFFSET

config UBOOT_CONFIG_ARMADA_64BIT
	bool
	select UBOOT_CONFIG_ARM64

# ARMv7 SoCs...
config UBOOT_CONFIG_ARMADA_375
	bool
	select UBOOT_CONFIG_ARMADA_32BIT

config UBOOT_CONFIG_ARMADA_38X
	bool
	select UBOOT_CONFIG_ARMADA_32BIT
	select UBOOT_CONFIG_HAVE_MVEBU_EFUSE

config UBOOT_CONFIG_ARMADA_38X_HS_IMPEDANCE_THRESH
	hex  "Armada 38x USB 2.0 High-Speed Impedance Threshold (0x0 - 0x7)"
	depends on UBOOT_CONFIG_ARMADA_38X
	default 0x6
	range 0x0 0x7

config UBOOT_CONFIG_ARMADA_XP
	bool
	select UBOOT_CONFIG_ARMADA_32BIT

# ARMv8 SoCs...
config UBOOT_CONFIG_ARMADA_3700
	bool
	select UBOOT_CONFIG_ARM64

# Armada 7K and 8K are very similar - use only one Kconfig symbol for both
config UBOOT_CONFIG_ARMADA_8K
	bool
	select UBOOT_CONFIG_ARM64

# Armada PLL frequency (used for NAND clock generation)
config UBOOT_CONFIG_SYS_MVEBU_PLL_CLOCK
	int
	default "2000000000" if UBOOT_CONFIG_ARMADA_XP || UBOOT_CONFIG_ARMADA_3700 || UBOOT_CONFIG_ARMADA_8K || UBOOT_CONFIG_ARMADA_MSYS
	default "1000000000" if UBOOT_CONFIG_ARMADA_38X || UBOOT_CONFIG_ARMADA_375

# Armada XP/38x SoC types...
config UBOOT_CONFIG_MV78230
	bool
	select UBOOT_CONFIG_ARMADA_XP

config UBOOT_CONFIG_MV78260
	bool
	select UBOOT_CONFIG_ARMADA_XP
	imply CMD_SATA

config UBOOT_CONFIG_MV78460
	bool
	select UBOOT_CONFIG_ARMADA_XP

config UBOOT_CONFIG_ARMADA_MSYS
	bool
	select UBOOT_CONFIG_ARMADA_32BIT

config 98DX4251
	bool
	select UBOOT_CONFIG_ARMADA_MSYS

config 98DX3336
	bool
	select UBOOT_CONFIG_ARMADA_MSYS

config 98DX3236
	bool
	select UBOOT_CONFIG_ARMADA_MSYS

config 88F6820
	bool
	select UBOOT_CONFIG_ARMADA_38X

choice
	prompt "Armada XP/375/38x/3700/7K/8K board select"
	optional

config UBOOT_CONFIG_TARGET_CLEARFOG
	bool "Support ClearFog"
	select 88F6820
	select UBOOT_CONFIG_BOARD_LATE_INIT

config UBOOT_CONFIG_TARGET_HELIOS4
	bool "Support Helios4"
	select 88F6820

config UBOOT_CONFIG_TARGET_MVEBU_ARMADA_37XX
	bool "Support Armada 37xx platforms"
	select UBOOT_CONFIG_ARMADA_3700
	imply SCSI

config UBOOT_CONFIG_TARGET_DB_88F6720
	bool "Support DB-88F6720 Armada 375"
	select UBOOT_CONFIG_ARMADA_375

config UBOOT_CONFIG_TARGET_DB_88F6820_GP
	bool "Support DB-88F6820-GP"
	select 88F6820

config UBOOT_CONFIG_TARGET_DB_88F6820_AMC
	bool "Support DB-88F6820-AMC"
	select 88F6820

config UBOOT_CONFIG_TARGET_TURRIS_OMNIA
	bool "Support Turris Omnia"
	select 88F6820
	select UBOOT_CONFIG_BOARD_LATE_INIT
	select UBOOT_CONFIG_DM_I2C
	select UBOOT_CONFIG_I2C_MUX
	select UBOOT_CONFIG_I2C_MUX_PCA954x
	select UBOOT_CONFIG_SPL_DRIVERS_MISC
	select UBOOT_CONFIG_SPL_I2C_MUX
	select UBOOT_CONFIG_SPL_SYS_MALLOC_SIMPLE
	select UBOOT_CONFIG_SYS_I2C_MVTWSI
	select UBOOT_CONFIG_ATSHA204A

config UBOOT_CONFIG_TARGET_TURRIS_MOX
	bool "Support Turris Mox"
	select UBOOT_CONFIG_ARMADA_3700

config UBOOT_CONFIG_TARGET_MVEBU_ARMADA_8K
	bool "Support Armada 7k/8k platforms"
	select UBOOT_CONFIG_ARMADA_8K
	select UBOOT_CONFIG_BOARD_LATE_INIT
	imply SCSI

config UBOOT_CONFIG_TARGET_OCTEONTX2_CN913x
	bool "Support CN913x platforms"
	select UBOOT_CONFIG_ARMADA_8K
	imply BOARD_EARLY_INIT_R
	select UBOOT_CONFIG_BOARD_LATE_INIT
	imply SCSI

config UBOOT_CONFIG_TARGET_DB_MV784MP_GP
	bool "Support db-mv784mp-gp"
	select UBOOT_CONFIG_MV78460

config UBOOT_CONFIG_TARGET_DS414
	bool "Support Synology DS414"
	select UBOOT_CONFIG_MV78230

config UBOOT_CONFIG_TARGET_MAXBCM
	bool "Support maxbcm"
	select UBOOT_CONFIG_MV78460

config UBOOT_CONFIG_TARGET_THEADORABLE
	bool "Support theadorable Armada XP"
	select UBOOT_CONFIG_BOARD_LATE_INIT if USB
	select UBOOT_CONFIG_MV78260
	imply CMD_SATA

config UBOOT_CONFIG_TARGET_CONTROLCENTERDC
	bool "Support CONTROLCENTERDC"
	select 88F6820

config UBOOT_CONFIG_TARGET_X530
	bool "Support Allied Telesis x530"
	select 88F6820

config UBOOT_CONFIG_TARGET_DB_XC3_24G4XG
	bool "Support DB-XC3-24G4XG"
	select 98DX3336

config UBOOT_CONFIG_TARGET_CRS3XX_98DX3236
	bool "Support CRS3XX-98DX3236"
	select 98DX3236

endchoice

choice
	prompt "DDR bus width"
	default UBOOT_CONFIG_DDR_64BIT
	depends on UBOOT_CONFIG_ARMADA_XP

config UBOOT_CONFIG_DDR_64BIT
	bool "64bit bus width"

config UBOOT_CONFIG_DDR_32BIT
	bool "32bit bus width"

endchoice

config UBOOT_CONFIG_DDR_LOG_LEVEL
	int "DDR training code log level"
	depends on UBOOT_CONFIG_ARMADA_XP
	default 0
	range 0 3
	help
	  Amount of information provided on error while running the DDR
	  training code.  At level 0, provides an error code in a case of
	  failure, RL, WL errors and other algorithm failure.  At level 1,
	  provides the D-Unit setup (SPD/Static configuration).  At level 2,
	  provides the windows margin as a results of DQS centeralization.
	  At level 3, rovides the windows margin of each DQ as a results of
	  DQS centeralization.

config UBOOT_CONFIG_SYS_BOARD
	default "clearfog" if UBOOT_CONFIG_TARGET_CLEARFOG
	default "helios4" if UBOOT_CONFIG_TARGET_HELIOS4
	default "mvebu_armada-37xx" if UBOOT_CONFIG_TARGET_MVEBU_ARMADA_37XX
	default "db-88f6720" if UBOOT_CONFIG_TARGET_DB_88F6720
	default "db-88f6820-gp" if UBOOT_CONFIG_TARGET_DB_88F6820_GP
	default "db-88f6820-amc" if UBOOT_CONFIG_TARGET_DB_88F6820_AMC
	default "turris_omnia" if UBOOT_CONFIG_TARGET_TURRIS_OMNIA
	default "turris_mox" if UBOOT_CONFIG_TARGET_TURRIS_MOX
	default "mvebu_armada-8k" if UBOOT_CONFIG_TARGET_MVEBU_ARMADA_8K
	default "octeontx2_cn913x" if UBOOT_CONFIG_TARGET_OCTEONTX2_CN913x
	default "db-mv784mp-gp" if UBOOT_CONFIG_TARGET_DB_MV784MP_GP
	default "ds414" if UBOOT_CONFIG_TARGET_DS414
	default "maxbcm" if UBOOT_CONFIG_TARGET_MAXBCM
	default "theadorable" if UBOOT_CONFIG_TARGET_THEADORABLE
	default "a38x" if UBOOT_CONFIG_TARGET_CONTROLCENTERDC
	default "x530" if UBOOT_CONFIG_TARGET_X530
	default "db-xc3-24g4xg" if UBOOT_CONFIG_TARGET_DB_XC3_24G4XG
	default "crs3xx-98dx3236" if UBOOT_CONFIG_TARGET_CRS3XX_98DX3236

config UBOOT_CONFIG_SYS_CONFIG_NAME
	default "clearfog" if UBOOT_CONFIG_TARGET_CLEARFOG
	default "helios4" if UBOOT_CONFIG_TARGET_HELIOS4
	default "mvebu_armada-37xx" if UBOOT_CONFIG_TARGET_MVEBU_ARMADA_37XX
	default "db-88f6720" if UBOOT_CONFIG_TARGET_DB_88F6720
	default "db-88f6820-gp" if UBOOT_CONFIG_TARGET_DB_88F6820_GP
	default "db-88f6820-amc" if UBOOT_CONFIG_TARGET_DB_88F6820_AMC
	default "mvebu_armada-8k" if UBOOT_CONFIG_TARGET_MVEBU_ARMADA_8K
	default "mvebu_armada-8k" if UBOOT_CONFIG_TARGET_OCTEONTX2_CN913x
	default "db-mv784mp-gp" if UBOOT_CONFIG_TARGET_DB_MV784MP_GP
	default "ds414" if UBOOT_CONFIG_TARGET_DS414
	default "maxbcm" if UBOOT_CONFIG_TARGET_MAXBCM
	default "theadorable" if UBOOT_CONFIG_TARGET_THEADORABLE
	default "turris_omnia" if UBOOT_CONFIG_TARGET_TURRIS_OMNIA
	default "turris_mox" if UBOOT_CONFIG_TARGET_TURRIS_MOX
	default "controlcenterdc" if UBOOT_CONFIG_TARGET_CONTROLCENTERDC
	default "x530" if UBOOT_CONFIG_TARGET_X530
	default "db-xc3-24g4xg" if UBOOT_CONFIG_TARGET_DB_XC3_24G4XG
	default "crs3xx-98dx3236" if UBOOT_CONFIG_TARGET_CRS3XX_98DX3236

config UBOOT_CONFIG_SYS_VENDOR
	default "Marvell" if UBOOT_CONFIG_TARGET_DB_MV784MP_GP
	default "Marvell" if UBOOT_CONFIG_TARGET_MVEBU_ARMADA_37XX
	default "Marvell" if UBOOT_CONFIG_TARGET_DB_88F6720
	default "Marvell" if UBOOT_CONFIG_TARGET_DB_88F6820_GP
	default "Marvell" if UBOOT_CONFIG_TARGET_DB_88F6820_AMC
	default "Marvell" if UBOOT_CONFIG_TARGET_MVEBU_ARMADA_8K
	default "Marvell" if UBOOT_CONFIG_TARGET_OCTEONTX2_CN913x
	default "Marvell" if UBOOT_CONFIG_TARGET_DB_XC3_24G4XG
	default "Marvell" if UBOOT_CONFIG_TARGET_MVEBU_DB_88F7040
	default "solidrun" if UBOOT_CONFIG_TARGET_CLEARFOG
	default "kobol" if UBOOT_CONFIG_TARGET_HELIOS4
	default "Synology" if UBOOT_CONFIG_TARGET_DS414
	default "CZ.NIC" if UBOOT_CONFIG_TARGET_TURRIS_OMNIA
	default "CZ.NIC" if UBOOT_CONFIG_TARGET_TURRIS_MOX
	default "gdsys" if UBOOT_CONFIG_TARGET_CONTROLCENTERDC
	default "alliedtelesis" if UBOOT_CONFIG_TARGET_X530
	default "mikrotik" if UBOOT_CONFIG_TARGET_CRS3XX_98DX3236

config UBOOT_CONFIG_SYS_SOC
	default "mvebu"

choice
	prompt "Boot method"
	depends on UBOOT_CONFIG_SPL

config UBOOT_CONFIG_MVEBU_SPL_BOOT_DEVICE_SPI
	bool "SPI NOR flash"
	imply ENV_IS_IN_SPI_FLASH
	imply SPL_DM_SPI
	imply SPL_SPI_FLASH_SUPPORT
	imply SPL_SPI_LOAD
	imply SPL_SPI
	select UBOOT_CONFIG_SPL_BOOTROM_SUPPORT

config UBOOT_CONFIG_MVEBU_SPL_BOOT_DEVICE_MMC
	bool "SDIO/MMC card"
	imply ENV_IS_IN_MMC
	# GPIO needed for eMMC/SD card presence detection
	imply SPL_DM_GPIO
	imply SPL_DM_MMC
	imply SPL_GPIO
	imply SPL_LIBDISK_SUPPORT
	imply SPL_MMC
	select UBOOT_CONFIG_SPL_BOOTROM_SUPPORT

config UBOOT_CONFIG_MVEBU_SPL_BOOT_DEVICE_SATA
	bool "SATA"
	imply SPL_SATA
	imply SPL_LIBDISK_SUPPORT
	select UBOOT_CONFIG_SPL_BOOTROM_SUPPORT

config UBOOT_CONFIG_MVEBU_SPL_BOOT_DEVICE_UART
	bool "UART"
	select UBOOT_CONFIG_SPL_BOOTROM_SUPPORT

endchoice

config UBOOT_CONFIG_MVEBU_EFUSE
	bool "Enable eFuse support"
	depends on UBOOT_CONFIG_HAVE_MVEBU_EFUSE
	help
	  Enable support for reading and writing eFuses on mvebu SoCs.

config UBOOT_CONFIG_MVEBU_EFUSE_FAKE
	bool "Fake eFuse access (dry run)"
	depends on UBOOT_CONFIG_MVEBU_EFUSE
	help
	  This enables a "dry run" mode where eFuses are not really programmed.
	  Instead the eFuse accesses are emulated by writing to and reading
	  from a memory block.
	  This is can be used for testing prog scripts.

config UBOOT_CONFIG_SECURED_MODE_IMAGE
	bool "Build image for trusted boot"
	default false
	depends on 88F6820
	help
	  Build an image that employs the ARMADA SoC's trusted boot framework
	  for securely booting images.

config UBOOT_CONFIG_SECURED_MODE_CSK_INDEX
	int "Index of active CSK"
	default 0
	depends on UBOOT_CONFIG_SECURED_MODE_IMAGE

source "../../../board/solidrun/clearfog/Kconfig"
source "../../../board/kobol/helios4/Kconfig"

endif
```

## open_uboot/config/arch/arm/mach-omap2/Kconfig
```kconfig
if UBOOT_CONFIG_ARCH_OMAP2PLUS

choice
	prompt "OMAP2+ platform select"
	default UBOOT_CONFIG_OMAP34XX

config UBOOT_CONFIG_OMAP34XX
	bool "OMAP34XX SoC"
	select UBOOT_CONFIG_ARM_CORTEX_A8_CVE_2017_5715
	select UBOOT_CONFIG_ARM_ERRATA_430973
	select UBOOT_CONFIG_ARM_ERRATA_454179
	select UBOOT_CONFIG_ARM_ERRATA_621766
	select UBOOT_CONFIG_ARM_ERRATA_725233
	select UBOOT_CONFIG_SPL_USE_TINY_PRINTF if SPL
	imply NAND_OMAP_GPMC
	imply SPL_FS_EXT4
	imply SPL_FS_FAT
	imply SPL_GPIO
	imply SPL_I2C
	imply SPL_LIBCOMMON_SUPPORT
	imply SPL_LIBDISK_SUPPORT
	imply SPL_LIBGENERIC_SUPPORT
	imply SPL_MMC
	imply SPL_NAND_SUPPORT
	imply SPL_OMAP3_ID_NAND
	imply SPL_POWER
	imply SPL_SERIAL
	imply SYS_I2C_OMAP24XX
	imply SYS_THUMB_BUILD
	imply TWL4030_POWER

config UBOOT_CONFIG_OMAP44XX
	bool "OMAP44XX SoC"
	select UBOOT_CONFIG_SPL_USE_TINY_PRINTF
	imply NAND_OMAP_ELM
	imply NAND_OMAP_GPMC
	imply SPL_DISPLAY_PRINT
	imply SPL_FS_EXT4
	imply SPL_FS_FAT
	imply SPL_GPIO
	imply SPL_I2C
	imply SPL_LIBCOMMON_SUPPORT
	imply SPL_LIBDISK_SUPPORT
	imply SPL_LIBGENERIC_SUPPORT
	imply SPL_MMC
	imply SPL_NAND_SIMPLE
	imply SPL_NAND_SUPPORT
	imply SPL_POWER
	imply SPL_SERIAL
	imply SYS_I2C_OMAP24XX
	imply SYS_THUMB_BUILD

config UBOOT_CONFIG_OMAP54XX
	bool "OMAP54XX SoC"
	select UBOOT_CONFIG_ARM_CORTEX_A15_CVE_2017_5715
	select UBOOT_CONFIG_ARM_ERRATA_798870
	select UBOOT_CONFIG_SYS_THUMB_BUILD
	imply NAND_OMAP_ELM
	imply NAND_OMAP_GPMC
	imply SPL_DISPLAY_PRINT
	imply SPL_ENV_SUPPORT
	imply SPL_FS_EXT4
	imply SPL_FS_FAT
	imply SPL_GPIO
	imply SPL_I2C
	imply SPL_LIBCOMMON_SUPPORT
	imply SPL_LIBDISK_SUPPORT
	imply SPL_LIBGENERIC_SUPPORT
	imply SPL_MMC
	imply SPL_NAND_AM33XX_BCH
	imply SPL_NAND_AM33XX_BCH
	imply SPL_NAND_SUPPORT
	imply SPL_POWER
	imply SPL_SERIAL
	imply SYS_I2C_OMAP24XX

config UBOOT_CONFIG_TI814X
	bool "TI814X SoC"
	select UBOOT_CONFIG_SPECIFY_CONSOLE_INDEX
	help
	  Support for AM335x SOC from Texas Instruments.
	  The AM335x high performance SOC features a Cortex-A8
	  ARM core and more.

config UBOOT_CONFIG_TI816X
	bool "TI816X SoC"
	select UBOOT_CONFIG_SPECIFY_CONSOLE_INDEX
	imply NAND_OMAP_ELM
	imply NAND_OMAP_GPMC
	help
	  Support for AM335x SOC from Texas Instruments.
	  The AM335x high performance SOC features a Cortex-A8
	  ARM core and more.

config UBOOT_CONFIG_AM43XX
	bool "AM43XX SoC"
	select UBOOT_CONFIG_SPECIFY_CONSOLE_INDEX
	imply NAND_OMAP_ELM
	imply NAND_OMAP_GPMC
	imply SPL_DM
	imply SPL_DM_SEQ_ALIAS
	imply SPL_NAND_AM33XX_BCH
	imply SPL_NAND_SUPPORT
	imply SPL_OF_CONTROL
	imply SPL_OF_TRANSLATE
	imply SPL_SEPARATE_BSS
	imply SPL_SYS_MALLOC_SIMPLE
	imply SYS_I2C_OMAP24XX
	imply SYS_THUMB_BUILD
	help
	  Support for AM43xx SOC from Texas Instruments.
	  The AM43xx high performance SOC features a Cortex-A9
	  ARM core, a quad core PRU-ICSS for industrial Ethernet
	  protocols, dual camera support, optional 3D graphics
	  and an optional customer programmable secure boot.

config UBOOT_CONFIG_AM33XX
	bool "AM33XX SoC"
	select UBOOT_CONFIG_ARM_CORTEX_A8_CVE_2017_5715
	select UBOOT_CONFIG_SPECIFY_CONSOLE_INDEX
	imply NAND_OMAP_ELM
	imply NAND_OMAP_GPMC
	imply SKIP_LOWLEVEL_INIT
	imply SPL_NAND_AM33XX_BCH
	imply SPL_NAND_SUPPORT
	imply SYS_I2C_OMAP24XX
	imply SYS_THUMB_BUILD
	imply SPL_USE_TINY_PRINTF
	help
	  Support for AM335x SOC from Texas Instruments.
	  The AM335x high performance SOC features a Cortex-A8
	  ARM core, a dual core PRU-ICSS for industrial Ethernet
	  protocols, optional 3D graphics and an optional customer
	  programmable secure boot.

endchoice

config UBOOT_CONFIG_SYS_MPUCLK
	int "MPU CLK speed"
	depends on UBOOT_CONFIG_AM33XX
	default 500
	help
	  Defines the MPU clock speed (in MHz).

config UBOOT_CONFIG_TI_SECURE_EMIF_REGION_START
	hex "Reserved EMIF region start address"
	depends on UBOOT_CONFIG_TI_SECURE_DEVICE
	default 0x0
	help
	  Reserved EMIF region start address. Set to "0" to auto-select
	  to be at the end of the external memory region.

config UBOOT_CONFIG_TI_SECURE_EMIF_TOTAL_REGION_SIZE
	hex "Reserved EMIF region size"
	depends on UBOOT_CONFIG_TI_SECURE_DEVICE
	default 0x0
	help
	  Total reserved EMIF region size. Default is 0, which means no reserved EMIF
	  region on secure devices.

config UBOOT_CONFIG_TI_SECURE_EMIF_PROTECTED_REGION_SIZE
	hex "Size of protected region within reserved EMIF region"
	depends on UBOOT_CONFIG_TI_SECURE_DEVICE
	default 0x0
	help
	  This config option is used to specify the size of the portion of the total
	  reserved EMIF region set aside for secure OS needs that will  be protected
	  using hardware memory firewalls. This value must be smaller than the
	  TI_SECURE_EMIF_TOTAL_REGION_SIZE value.

source "omap3/Kconfig"

source "omap4/Kconfig"

source "omap5/Kconfig"

source "am33xx/Kconfig"

source "../../../board/BuR/brxre1/Kconfig"
source "../../../board/BuR/brsmarc1/Kconfig"
source "../../../board/BuR/brppt1/Kconfig"
source "../../../board/siemens/draco/Kconfig"
source "../../../board/siemens/pxm2/Kconfig"
source "../../../board/siemens/rut/Kconfig"
source "../../../board/ti/ti816x/Kconfig"
source "../../../board/ti/am43xx/Kconfig"
source "../../../board/ti/am335x/Kconfig"
source "../../../board/compulab/cm_t335/Kconfig"
source "../../../board/compulab/cm_t43/Kconfig"
source "../../../board/phytec/phycore_am335x_r2/Kconfig"

config UBOOT_CONFIG_SPL_LDSCRIPT
        default "arch/arm/mach-omap2/u-boot-spl.lds"

endif
```
