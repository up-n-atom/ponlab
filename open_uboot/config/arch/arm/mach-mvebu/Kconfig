## open_uboot/config/arch/arm/mach-omap2/omap4/Kconfig
```kconfig
if UBOOT_CONFIG_OMAP44XX

choice
	prompt "OMAP4 board select"
	optional

config UBOOT_CONFIG_TARGET_OMAP4_PANDA
	bool "TI OMAP4 PandaBoard"

config UBOOT_CONFIG_TARGET_OMAP4_SDP4430
	bool "TI OMAP4 SDP4430"

endchoice

config UBOOT_CONFIG_SYS_SOC
	default "omap4"

source "../../../../board/ti/panda/Kconfig"
source "../../../../board/ti/sdp4430/Kconfig"

endif
```

## open_uboot/config/arch/arm/mach-orion5x/Kconfig
```kconfig
if UBOOT_CONFIG_ARCH_ORION5X

choice
	prompt "Marvell Orion board select"
	optional

config UBOOT_CONFIG_TARGET_EDMINIV2
	bool "LaCie Ethernet Disk mini V2"
	select UBOOT_CONFIG_SUPPORT_SPL

endchoice

config UBOOT_CONFIG_SYS_SOC
	default "orion5x"

source "../../../board/LaCie/edminiv2/Kconfig"

endif
```

## open_uboot/config/arch/arm/mach-qemu/Kconfig
```kconfig
if UBOOT_CONFIG_ARCH_QEMU

config UBOOT_CONFIG_SYS_VENDOR
	default "emulation"

config UBOOT_CONFIG_SYS_BOARD
	default "qemu-arm"

config UBOOT_CONFIG_SYS_CONFIG_NAME
	default "qemu-arm"

choice
	prompt "QEMU ARM architecture"
	default UBOOT_CONFIG_TARGET_QEMU_ARM_64BIT

config UBOOT_CONFIG_TARGET_QEMU_ARM_32BIT
	bool "ARMv7-A, 32bit"
	select UBOOT_CONFIG_ARCH_SUPPORT_PSCI
	select UBOOT_CONFIG_BOARD_LATE_INIT
	select UBOOT_CONFIG_CPU_V7A
	select UBOOT_CONFIG_SYS_ARCH_TIMER

config UBOOT_CONFIG_TARGET_QEMU_ARM_64BIT
	bool "ARMv8, 64bit"
	select UBOOT_CONFIG_ARM64
	select UBOOT_CONFIG_BOARD_LATE_INIT

endchoice

endif
```

## open_uboot/config/arch/arm/mach-rmobile/Kconfig
```kconfig
if UBOOT_CONFIG_ARCH_RMOBILE

choice
	prompt "Target Renesas SoC select"
	default UBOOT_CONFIG_RCAR_32

config UBOOT_CONFIG_RCAR_32
	bool "Renesas ARM SoCs R-Car Gen1/Gen2 (32bit)"
	select UBOOT_CONFIG_CPU_V7A

config UBOOT_CONFIG_RCAR_GEN3
	bool "Renesas ARM SoCs R-Car Gen3 (64bit)"
	select UBOOT_CONFIG_ARM64
	select UBOOT_CONFIG_PHY
	select UBOOT_CONFIG_CMD_CACHE
	select UBOOT_CONFIG_OF_BOARD_SETUP
	select UBOOT_CONFIG_PINCTRL
	select UBOOT_CONFIG_PINCONF
	select UBOOT_CONFIG_PINCTRL_PFC
	select UBOOT_CONFIG_POSITION_INDEPENDENT
	select UBOOT_CONFIG_SUPPORT_SPL
	imply CMD_FS_UUID
	imply CMD_GPT
	imply CMD_UUID
	imply CMD_MMC_SWRITE if MMC
	imply SUPPORT_EMMC_RPMB if MMC
	imply SPL
	imply SPL_BOARD_INIT
	imply SPL_GZIP
	imply SPL_LIBCOMMON_SUPPORT
	imply SPL_LIBGENERIC_SUPPORT
	imply SPL_SERIAL
	imply SPL_SYS_MALLOC_SIMPLE
	imply SPL_TINY_MEMSET
	imply SPL_YMODEM_SUPPORT
	imply SPL_USE_TINY_PRINTF

config UBOOT_CONFIG_RZA1
	prompt "Renesas ARM SoCs RZ/A1 (32bit)"
	select UBOOT_CONFIG_CPU_V7A

endchoice

source "Kconfig.32"
source "Kconfig.64"
source "Kconfig.rza1"

endif
```

## open_uboot/config/arch/arm/mach-rmobile/Kconfig.32
```kconfig
if UBOOT_CONFIG_RCAR_32

config UBOOT_CONFIG_ARCH_RMOBILE_BOARD_STRING
	string "Renesas RCar Gen2 board name"
	default "Board"

config UBOOT_CONFIG_RCAR_GEN2
	bool "Renesas RCar Gen2"
	select UBOOT_CONFIG_PHY
	select UBOOT_CONFIG_PHY_RCAR_GEN2

config UBOOT_CONFIG_R8A7740
	bool "Renesas SoC R8A7740"

config UBOOT_CONFIG_R8A7790
	bool "Renesas SoC R8A7790"
	select UBOOT_CONFIG_RCAR_GEN2
	select UBOOT_CONFIG_ARM_CORTEX_A15_CVE_2017_5715
	imply CLK_R8A7790
	imply PINCTRL_PFC_R8A7790

config UBOOT_CONFIG_R8A7791
	bool "Renesas SoC R8A7791"
	select UBOOT_CONFIG_RCAR_GEN2
	select UBOOT_CONFIG_ARM_CORTEX_A15_CVE_2017_5715
	imply CLK_R8A7791
	imply PINCTRL_PFC_R8A7791

config UBOOT_CONFIG_R8A7792
	bool "Renesas SoC R8A7792"
	select UBOOT_CONFIG_RCAR_GEN2
	select UBOOT_CONFIG_ARM_CORTEX_A15_CVE_2017_5715
	imply CLK_R8A7792
	imply PINCTRL_PFC_R8A7792

config UBOOT_CONFIG_R8A7793
	bool "Renesas SoC R8A7793"
	select UBOOT_CONFIG_RCAR_GEN2
	select UBOOT_CONFIG_ARM_CORTEX_A15_CVE_2017_5715
	imply CLK_R8A7793
	imply PINCTRL_PFC_R8A7793

config UBOOT_CONFIG_R8A7794
	bool "Renesas SoC R8A7794"
	select UBOOT_CONFIG_RCAR_GEN2
	imply CLK_R8A7794
	imply PINCTRL_PFC_R8A7794

choice
	prompt "Renesas ARM SoCs board select"
	optional

config UBOOT_CONFIG_TARGET_ARMADILLO_800EVA
	bool "armadillo 800 eva board"

config UBOOT_CONFIG_TARGET_BLANCHE
	bool "Blanche board"
	select UBOOT_CONFIG_DM
	select UBOOT_CONFIG_DM_SERIAL
	imply CMD_DM

config UBOOT_CONFIG_TARGET_GOSE
	bool "Gose board"
	select UBOOT_CONFIG_DM
	select UBOOT_CONFIG_DM_SERIAL
	select UBOOT_CONFIG_SPL_TINY_MEMSET
	select UBOOT_CONFIG_SUPPORT_SPL
	select UBOOT_CONFIG_SPL_USE_TINY_PRINTF
	imply CMD_DM

config UBOOT_CONFIG_TARGET_KOELSCH
	bool "Koelsch board"
	select UBOOT_CONFIG_DM
	select UBOOT_CONFIG_DM_SERIAL
	select UBOOT_CONFIG_SPL_TINY_MEMSET
	select UBOOT_CONFIG_SUPPORT_SPL
	select UBOOT_CONFIG_SPL_USE_TINY_PRINTF
	imply CMD_DM

config UBOOT_CONFIG_TARGET_LAGER
	bool "Lager board"
	select UBOOT_CONFIG_DM
	select UBOOT_CONFIG_DM_SERIAL
	select UBOOT_CONFIG_SPL_TINY_MEMSET
	select UBOOT_CONFIG_SUPPORT_SPL
	select UBOOT_CONFIG_SPL_USE_TINY_PRINTF
	imply CMD_DM

config UBOOT_CONFIG_TARGET_KZM9G
	bool "KZM9D board"

config UBOOT_CONFIG_TARGET_ALT
	bool "Alt board"
	select UBOOT_CONFIG_DM
	select UBOOT_CONFIG_DM_SERIAL
	select UBOOT_CONFIG_SPL_TINY_MEMSET
	select UBOOT_CONFIG_SUPPORT_SPL
	select UBOOT_CONFIG_SPL_USE_TINY_PRINTF
	imply CMD_DM

config UBOOT_CONFIG_TARGET_SILK
	bool "Silk board"
	select UBOOT_CONFIG_DM
	select UBOOT_CONFIG_DM_SERIAL
	select UBOOT_CONFIG_SPL_TINY_MEMSET
	select UBOOT_CONFIG_SUPPORT_SPL
	select UBOOT_CONFIG_SPL_USE_TINY_PRINTF
	imply CMD_DM

config UBOOT_CONFIG_TARGET_PORTER
	bool "Porter board"
	select UBOOT_CONFIG_DM
	select UBOOT_CONFIG_DM_SERIAL
	select UBOOT_CONFIG_SPL_TINY_MEMSET
	select UBOOT_CONFIG_SUPPORT_SPL
	select UBOOT_CONFIG_SPL_USE_TINY_PRINTF
	imply CMD_DM

config UBOOT_CONFIG_TARGET_STOUT
	bool "Stout board"
	select UBOOT_CONFIG_DM
	select UBOOT_CONFIG_DM_SERIAL
	select UBOOT_CONFIG_SPL_TINY_MEMSET
	select UBOOT_CONFIG_SUPPORT_SPL
	select UBOOT_CONFIG_SPL_USE_TINY_PRINTF
	imply CMD_DM

endchoice

config UBOOT_CONFIG_SYS_SOC
	default "rmobile"

config UBOOT_CONFIG_RMOBILE_EXTRAM_BOOT
	bool "Enable boot from RAM"
	depends on UBOOT_CONFIG_TARGET_ALT || UBOOT_CONFIG_TARGET_BLANCHE || UBOOT_CONFIG_TARGET_KOELSCH || UBOOT_CONFIG_TARGET_LAGER || UBOOT_CONFIG_TARGET_PORTER || UBOOT_CONFIG_TARGET_SILK || UBOOT_CONFIG_TARGET_STOUT

choice
	prompt "Qos setting primary"
	depends on UBOOT_CONFIG_TARGET_ALT || UBOOT_CONFIG_TARGET_BLANCHE || UBOOT_CONFIG_TARGET_GOSE || UBOOT_CONFIG_TARGET_KOELSCH || UBOOT_CONFIG_TARGET_LAGER
	default UBOOT_CONFIG_QOS_PRI_NORMAL

config UBOOT_CONFIG_QOS_PRI_NORMAL
	bool "Non primary"
	help
	   Select normal mode for QoS setting.

config UBOOT_CONFIG_QOS_PRI_MEDIA
	bool "Media primary"
	help
	   Select multimedia primary mode for QoS setting.

config UBOOT_CONFIG_QOS_PRI_GFX
	bool "GFX primary"
	help
	   Select GFX(graphics) primary mode for QoS setting.

endchoice

source "../../../board/atmark-techno/armadillo-800eva/Kconfig"
source "../../../board/renesas/blanche/Kconfig"
source "../../../board/renesas/gose/Kconfig"
source "../../../board/renesas/koelsch/Kconfig"
source "../../../board/renesas/lager/Kconfig"
source "../../../board/kmc/kzm9g/Kconfig"
source "../../../board/renesas/alt/Kconfig"
source "../../../board/renesas/silk/Kconfig"
source "../../../board/renesas/porter/Kconfig"
source "../../../board/renesas/stout/Kconfig"

endif
```

## open_uboot/config/arch/arm/mach-rmobile/Kconfig.64
```kconfig
if UBOOT_CONFIG_RCAR_GEN3

menu "Select Target SoC"

config UBOOT_CONFIG_R8A774A1
	bool "Renesas SoC R8A774A1"
	select UBOOT_CONFIG_GICV2
	imply CLK_R8A774A1
	imply PINCTRL_PFC_R8A774A1

config UBOOT_CONFIG_R8A774B1
	bool "Renesas SoC R8A774B1"
	select UBOOT_CONFIG_GICV2
	imply CLK_R8A774B1
	imply PINCTRL_PFC_R8A774B1

config UBOOT_CONFIG_R8A774C0
	bool "Renesas SoC R8A774C0"
	select UBOOT_CONFIG_GICV2
	imply CLK_R8A774C0
	imply PINCTRL_PFC_R8A774C0

config UBOOT_CONFIG_R8A774E1
	bool "Renesas SoC R8A774E1"
	select UBOOT_CONFIG_GICV2
	imply CLK_R8A774E1
	imply PINCTRL_PFC_R8A774E1

config UBOOT_CONFIG_R8A7795
	bool "Renesas SoC R8A7795"
	select UBOOT_CONFIG_GICV2
	imply CLK_R8A7795
	imply PINCTRL_PFC_R8A7795

config UBOOT_CONFIG_R8A7796
	bool "Renesas SoC R8A7796"
	select UBOOT_CONFIG_GICV2
	imply CLK_R8A7796
	imply PINCTRL_PFC_R8A7796

config UBOOT_CONFIG_R8A77965
	bool "Renesas SoC R8A77965"
	select UBOOT_CONFIG_GICV2
	imply CLK_R8A77965
	imply PINCTRL_PFC_R8A77965

config UBOOT_CONFIG_R8A77970
	bool "Renesas SoC R8A77970"
	select UBOOT_CONFIG_GICV2
	imply CLK_R8A77970
	imply PINCTRL_PFC_R8A77970

config UBOOT_CONFIG_R8A77980
	bool "Renesas SoC R8A77980"
	select UBOOT_CONFIG_GICV2
	imply CLK_R8A77980
	imply PINCTRL_PFC_R8A77980

config UBOOT_CONFIG_R8A77990
	bool "Renesas SoC R8A77990"
	select UBOOT_CONFIG_GICV2
	imply CLK_R8A77990
	imply PINCTRL_PFC_R8A77990

config UBOOT_CONFIG_R8A77995
	bool "Renesas SoC R8A77995"
	select UBOOT_CONFIG_GICV2
	imply CLK_R8A77995
	imply PINCTRL_PFC_R8A77995

config UBOOT_CONFIG_R8A779A0
	bool "Renesas SoC R8A779A0"
	select UBOOT_CONFIG_GICV3
	imply CLK_R8A779A0
	imply PINCTRL_PFC_R8A779A0

config UBOOT_CONFIG_RZ_G2
	bool "Renesas ARM SoCs RZ/G2 (64bit)"

endmenu

choice
	prompt "Renesas ARM64 SoCs board select"
	optional

config UBOOT_CONFIG_TARGET_BEACON_RZG2M
	bool "Beacon EmbeddedWorks RZ/G2 Dev Kit"
	select UBOOT_CONFIG_R8A774A1
	select UBOOT_CONFIG_R8A774B1
	select UBOOT_CONFIG_R8A774E1
	select UBOOT_CONFIG_RZ_G2
	select UBOOT_CONFIG_PINCTRL_PFC_R8A774A1
	select UBOOT_CONFIG_PINCTRL_PFC_R8A774B1
	select UBOOT_CONFIG_PINCTRL_PFC_R8A774E1
	imply MULTI_DTB_FIT
	imply MULTI_DTB_FIT_USER_DEFINED_AREA
	imply CLK_VERSACLOCK
	imply CLK_CCF

config UBOOT_CONFIG_TARGET_CONDOR
	bool "Condor board"
	imply R8A77980
	help
          Support for Renesas R-Car Gen3 Condor platform

config UBOOT_CONFIG_TARGET_DRAAK
	bool "Draak board"
	imply R8A77995
	help
          Support for Renesas R-Car Gen3 Draak platform

config UBOOT_CONFIG_TARGET_EAGLE
	bool "Eagle board"
	imply R8A77970
	help
          Support for Renesas R-Car Gen3 Eagle platform

config UBOOT_CONFIG_TARGET_EBISU
	bool "Ebisu board"
	imply R8A77990
	help
          Support for Renesas R-Car Gen3 Ebisu platform

config UBOOT_CONFIG_TARGET_FALCON
	bool "Falcon board"
	imply R8A779A0
	help
          Support for Renesas R-Car Gen3 Falcon platform

config UBOOT_CONFIG_TARGET_HIHOPE_RZG2
	bool "HiHope RZ/G2 board"
	imply R8A774A1
	imply R8A774B1
	imply R8A774E1
	imply RZ_G2
	imply SYS_MALLOC_F
	imply MULTI_DTB_FIT
	imply MULTI_DTB_FIT_USER_DEFINED_AREA
	help
          Support for RZG2 HiHope platform

config UBOOT_CONFIG_TARGET_SILINUX_EK874
	bool "Silicon Linux EK874 board"
	imply R8A774C0
	imply RZ_G2
	help
          Support for Silicon Linux EK874 platform

config UBOOT_CONFIG_TARGET_SALVATOR_X
	bool "Salvator-X board"
	imply R8A7795
	imply R8A7796
	imply R8A77965
	imply SYS_MALLOC_F
	imply MULTI_DTB_FIT
	imply MULTI_DTB_FIT_USER_DEFINED_AREA
	help
          Support for Renesas R-Car Gen3 platform

config UBOOT_CONFIG_TARGET_ULCB
	bool "ULCB board"
	imply R8A7795
	imply R8A7796
	imply R8A77965
	imply SYS_MALLOC_F
	imply MULTI_DTB_FIT
	imply MULTI_DTB_FIT_USER_DEFINED_AREA
	help
          Support for Renesas R-Car Gen3 ULCB platform

endchoice

config UBOOT_CONFIG_SYS_SOC
	default "rmobile"

source "../../../board/renesas/condor/Kconfig"
source "../../../board/renesas/draak/Kconfig"
source "../../../board/renesas/eagle/Kconfig"
source "../../../board/renesas/ebisu/Kconfig"
source "../../../board/renesas/falcon/Kconfig"
source "../../../board/renesas/salvator-x/Kconfig"
source "../../../board/renesas/ulcb/Kconfig"
source "../../../board/beacon/beacon-rzg2m/Kconfig"
source "../../../board/hoperun/hihope-rzg2/Kconfig"
source "../../../board/silinux/ek874/Kconfig"

config UBOOT_CONFIG_MULTI_DTB_FIT_UNCOMPRESS_SZ
	default 0x80000 if UBOOT_CONFIG_TARGET_BEACON_RZG2M
	default 0x80000 if UBOOT_CONFIG_TARGET_HIHOPE_RZG2
	default 0x80000 if UBOOT_CONFIG_TARGET_SALVATOR_X
	default 0x80000 if UBOOT_CONFIG_TARGET_ULCB

config UBOOT_CONFIG_MULTI_DTB_FIT_USER_DEF_ADDR
	default 0x49000000 if UBOOT_CONFIG_TARGET_BEACON_RZG2M
	default 0x49000000 if UBOOT_CONFIG_TARGET_HIHOPE_RZG2
	default 0x49000000 if UBOOT_CONFIG_TARGET_SALVATOR_X
	default 0x49000000 if UBOOT_CONFIG_TARGET_ULCB

config UBOOT_CONFIG_SYS_MALLOC_F_LEN
	default 0x8000 if UBOOT_CONFIG_RCAR_GEN3

endif
```

## open_uboot/config/arch/arm/mach-rockchip/rk3036/Kconfig
```kconfig
if UBOOT_CONFIG_ROCKCHIP_RK3036

choice
	prompt "RK3036 board select"

config UBOOT_CONFIG_TARGET_EVB_RK3036
	bool "EVB_RK3036"
	select UBOOT_CONFIG_BOARD_LATE_INIT

config UBOOT_CONFIG_TARGET_KYLIN_RK3036
	bool "KYLIN_RK3036"
	select UBOOT_CONFIG_BOARD_LATE_INIT

endchoice

config UBOOT_CONFIG_ROCKCHIP_BOOT_MODE_REG
	default 0x200081c8

config UBOOT_CONFIG_SYS_SOC
	default "rk3036"

config UBOOT_CONFIG_SYS_MALLOC_F_LEN
	default 0x400

config UBOOT_CONFIG_SPL_SERIAL
	default y

source "../../../../board/rockchip/evb_rk3036/Kconfig"
source "../../../../board/rockchip/kylin_rk3036/Kconfig"

endif
```

## open_uboot/config/arch/arm/mach-rockchip/rk322x/Kconfig
```kconfig
if UBOOT_CONFIG_ROCKCHIP_RK322X


config UBOOT_CONFIG_TARGET_EVB_RK3229
	bool "EVB_RK3229"
	select UBOOT_CONFIG_BOARD_LATE_INIT

config UBOOT_CONFIG_ROCKCHIP_BOOT_MODE_REG
	default 0x110005c8

config UBOOT_CONFIG_SYS_SOC
	default "rk322x"

config UBOOT_CONFIG_SYS_MALLOC_F_LEN
	default 0x800

config UBOOT_CONFIG_SPL_LIBCOMMON_SUPPORT
	default y

config UBOOT_CONFIG_SPL_LIBGENERIC_SUPPORT
	default y

config UBOOT_CONFIG_SPL_SERIAL
	default y

config UBOOT_CONFIG_TPL_MAX_SIZE
        default 28672

config UBOOT_CONFIG_TPL_STACK
        default 0x10088000

config UBOOT_CONFIG_TPL_TEXT_BASE
        default 0x10081000

source "../../../../board/rockchip/evb_rk3229/Kconfig"

endif
```

## open_uboot/config/arch/arm/mach-rockchip/rk3308/Kconfig
```kconfig
if UBOOT_CONFIG_ROCKCHIP_RK3308

config UBOOT_CONFIG_TARGET_EVB_RK3308
	bool "EVB_RK3308"
	select UBOOT_CONFIG_BOARD_LATE_INIT

config UBOOT_CONFIG_TARGET_ROC_RK3308_CC
       bool "Firefly roc-rk3308-cc"
	select UBOOT_CONFIG_BOARD_LATE_INIT

config UBOOT_CONFIG_SYS_SOC
	default "rk3308"

config UBOOT_CONFIG_SYS_MALLOC_F_LEN
	default 0x400

config UBOOT_CONFIG_SPL_SERIAL
	default y

config UBOOT_CONFIG_ROCKCHIP_BOOT_MODE_REG
	default 0xff000500


source "../../../../board/rockchip/evb_rk3308/Kconfig"
source "../../../../board/firefly/firefly-rk3308/Kconfig"

endif
```
