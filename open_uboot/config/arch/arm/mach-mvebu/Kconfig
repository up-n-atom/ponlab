## open_uboot/config/arch/mips/mach-octeon/Kconfig
```kconfig
menu "Octeon platforms"
	depends on UBOOT_CONFIG_ARCH_OCTEON

config UBOOT_CONFIG_SYS_SOC
	string
	default "octeon"

config UBOOT_CONFIG_OCTEON_CN7XXX
	bool "Octeon CN7XXX SoC"

config UBOOT_CONFIG_OCTEON_CN70XX
	bool "Octeon CN70XX SoC"
	select UBOOT_CONFIG_OCTEON_CN7XXX

config UBOOT_CONFIG_OCTEON_CN73XX
	bool "Octeon CN73XX SoC"
	select UBOOT_CONFIG_OCTEON_CN7XXX

config UBOOT_CONFIG_OCTEON_CN78XX
	bool "Octeon CN78XX SoC"
	select UBOOT_CONFIG_OCTEON_CN7XXX

choice
	prompt "Octeon MIPS family select"

config UBOOT_CONFIG_SOC_OCTEON3
	bool "Octeon III family"
	help
	 This selects the Octeon III SoC family CN70xx, CN73XX, CN78xx
	 and CNF75XX.

endchoice

choice
	prompt "Octeon 3 board select"
	default UBOOT_CONFIG_TARGET_OCTEON_EBB7304

config UBOOT_CONFIG_TARGET_OCTEON_EBB7304
	bool "Marvell Octeon EBB7304"
	select UBOOT_CONFIG_OCTEON_CN73XX
	help
	 Choose this for the Octeon EBB7304 board

config UBOOT_CONFIG_TARGET_OCTEON_NIC23
	bool "Marvell Octeon NIC23"
	select UBOOT_CONFIG_OCTEON_CN73XX
	help
	 Choose this for the Octeon NIC23 board

endchoice

config UBOOT_CONFIG_SYS_DCACHE_SIZE
	default 32768

config UBOOT_CONFIG_SYS_DCACHE_LINE_SIZE
	default 128

config UBOOT_CONFIG_SYS_ICACHE_SIZE
	default	79872

config UBOOT_CONFIG_SYS_ICACHE_LINE_SIZE
	default 128

config UBOOT_CONFIG_SYS_PCI_64BIT
	bool
	default y

source "../../../board/Marvell/octeon_ebb7304/Kconfig"
source "../../../board/Marvell/octeon_nic23/Kconfig"

endmenu
```

## open_uboot/config/arch/nds32/Kconfig
```kconfig
menu "NDS32 architecture"
	depends on UBOOT_CONFIG_NDS32

config UBOOT_CONFIG_SYS_ARCH
	default "nds32"

choice
	prompt "Target select"
	optional

config UBOOT_CONFIG_TARGET_ADP_AG101P
	bool "Support adp-ag101p"

config UBOOT_CONFIG_TARGET_ADP_AE3XX
	bool "Support adp-ae3xx"

endchoice

config UBOOT_CONFIG_SYS_ICACHE_OFF
	bool "Do not enable icache"
	help
	  Do not enable instruction cache in U-Boot.

config UBOOT_CONFIG_SPL_SYS_ICACHE_OFF
	bool "Do not enable icache in SPL"
	depends on UBOOT_CONFIG_SPL
	default UBOOT_CONFIG_SYS_ICACHE_OFF
	help
	  Do not enable instruction cache in SPL.

config UBOOT_CONFIG_SYS_DCACHE_OFF
	bool "Do not enable dcache"
	help
	  Do not enable data cache in U-Boot.

config UBOOT_CONFIG_SPL_SYS_DCACHE_OFF
	bool "Do not enable dcache in SPL"
	depends on UBOOT_CONFIG_SPL
	default UBOOT_CONFIG_SYS_DCACHE_OFF
	help
	  Do not enable data cache in SPL.

source "../../board/AndesTech/adp-ag101p/Kconfig"
source "../../board/AndesTech/adp-ae3xx/Kconfig"

endmenu
```

## open_uboot/config/arch/powerpc/Kconfig
```kconfig
menu "PowerPC architecture"
	depends on UBOOT_CONFIG_PPC

config UBOOT_CONFIG_SYS_ARCH
	default "powerpc"

choice
	prompt "CPU select"
	optional

config UBOOT_CONFIG_MPC83xx
	bool "MPC83xx"
	select UBOOT_CONFIG_CREATE_ARCH_SYMLINK
	select UBOOT_CONFIG_SYS_FSL_HAS_SEC
	select UBOOT_CONFIG_SYS_FSL_SEC_BE
	select UBOOT_CONFIG_SYS_FSL_SEC_COMPAT_2

config UBOOT_CONFIG_MPC85xx
	bool "MPC85xx"
	select UBOOT_CONFIG_CREATE_ARCH_SYMLINK
	select UBOOT_CONFIG_SYS_FSL_DDR
	select UBOOT_CONFIG_SYS_FSL_DDR_BE
	select UBOOT_CONFIG_BINMAN if OF_SEPARATE
	imply CMD_HASH
	imply CMD_IRQ
	imply USB_EHCI_HCD if USB

config UBOOT_CONFIG_MPC8xx
	bool "MPC8xx"
	select UBOOT_CONFIG_BOARD_EARLY_INIT_F
	imply CMD_REGINFO
	imply WDT_MPC8xx

endchoice

config UBOOT_CONFIG_HIGH_BATS
	bool "Enable high BAT registers"
	help
	  Enable BATs (block address translation registers) 4-7 on machines
	  that support them.

source "cpu/mpc83xx/Kconfig"
source "cpu/mpc85xx/Kconfig"
source "cpu/mpc8xx/Kconfig"
source "lib/Kconfig"

endmenu
```

## open_uboot/config/arch/powerpc/cpu/mpc83xx/arbiter/Kconfig
```kconfig
menu "Arbiter"

choice
	prompt "Pipeline depth"

config UBOOT_CONFIG_ACR_PIPE_DEP_UNSET
	bool "Don't set value"

config UBOOT_CONFIG_ACR_PIPE_DEP_1
	bool "1"

config UBOOT_CONFIG_ACR_PIPE_DEP_2
	bool "2"

config UBOOT_CONFIG_ACR_PIPE_DEP_3
	bool "3"

config UBOOT_CONFIG_ACR_PIPE_DEP_4
	bool "4"

endchoice

choice
	prompt "Repeat count"

config UBOOT_CONFIG_ACR_RPTCNT_UNSET
	bool "Don't set value"

config UBOOT_CONFIG_ACR_RPTCNT_1
	bool "1"

config UBOOT_CONFIG_ACR_RPTCNT_2
	bool "2"

config UBOOT_CONFIG_ACR_RPTCNT_3
	bool "3"

config UBOOT_CONFIG_ACR_RPTCNT_4
	bool "4"

config UBOOT_CONFIG_ACR_RPTCNT_5
	bool "5"

config UBOOT_CONFIG_ACR_RPTCNT_6
	bool "6"

config UBOOT_CONFIG_ACR_RPTCNT_7
	bool "7"

config UBOOT_CONFIG_ACR_RPTCNT_8
	bool "8"

endchoice

choice
	prompt "Address parking"

config UBOOT_CONFIG_ACR_APARK_UNSET
	bool "Don't set value"

config UBOOT_CONFIG_ACR_APARK_MASTER
	bool "Park to master"

config UBOOT_CONFIG_ACR_APARK_LAST
	bool "Park to last owner"

config UBOOT_CONFIG_ACR_APARK_DISABLE
	bool "Disabled"

endchoice

choice
	prompt "Parking master"

config UBOOT_CONFIG_ACR_PARKM_UNSET
	bool "Don't set value"

config UBOOT_CONFIG_ACR_PARKM_E300
	bool "e300 core"

config UBOOT_CONFIG_ACR_PARKM_TSEC_1_2
	bool "TSEC1, TSEC2"

config UBOOT_CONFIG_ACR_PARKM_USB_I2C1_BOOT
	bool "USB/I2C1_BOOT"

config UBOOT_CONFIG_ACR_PARKM_DMA_ESDHC_USB
	bool "DMA, ESDHC, USB"

config UBOOT_CONFIG_ACR_PARKM_PEX
	bool "PCI Express"

if UBOOT_CONFIG_MPC83XX_QUICC_ENGINE

config UBOOT_CONFIG_ACR_PARKM_ENC_CORE
	bool "Encryption core"

endif

endchoice

config UBOOT_CONFIG_ACR_PIPE_DEP
	hex
	default 0x0 if UBOOT_CONFIG_ACR_PIPE_DEP_UNSET
	default 0x0 if UBOOT_CONFIG_ACR_PIPE_DEP_1
	default 0x10000 if UBOOT_CONFIG_ACR_PIPE_DEP_2
	default 0x20000 if UBOOT_CONFIG_ACR_PIPE_DEP_3
	default 0x30000 if UBOOT_CONFIG_ACR_PIPE_DEP_4

config UBOOT_CONFIG_ACR_RPTCNT
	hex
	default 0x0 if UBOOT_CONFIG_ACR_RPTCNT_UNSET
	default 0x0 if UBOOT_CONFIG_ACR_RPTCNT_1
	default 0x100 if UBOOT_CONFIG_ACR_RPTCNT_2
	default 0x200 if UBOOT_CONFIG_ACR_RPTCNT_3
	default 0x300 if UBOOT_CONFIG_ACR_RPTCNT_4
	default 0x400 if UBOOT_CONFIG_ACR_RPTCNT_5
	default 0x500 if UBOOT_CONFIG_ACR_RPTCNT_6
	default 0x600 if UBOOT_CONFIG_ACR_RPTCNT_7
	default 0x700 if UBOOT_CONFIG_ACR_RPTCNT_8

config UBOOT_CONFIG_ACR_APARK
	hex
	default 0x0 if UBOOT_CONFIG_ACR_APARK_UNSET
	default 0x0 if UBOOT_CONFIG_ACR_APARK_MASTER
	default 0x10 if UBOOT_CONFIG_ACR_APARK_LAST
	default 0x20 if UBOOT_CONFIG_ACR_APARK_DISABLE

config UBOOT_CONFIG_ACR_PARKM
	hex
	default 0x0 if UBOOT_CONFIG_ACR_PARKM_UNSET
	default 0x0 if UBOOT_CONFIG_ACR_PARKM_E300
	default 0x2 if UBOOT_CONFIG_ACR_PARKM_TSEC_1_2
	default 0x3 if UBOOT_CONFIG_ACR_PARKM_USB_I2C1_BOOT
	default 0x4 if UBOOT_CONFIG_ACR_PARKM_DMA_ESDHC_USB
	default 0x5 if UBOOT_CONFIG_ACR_PARKM_PEX
	default 0x5 if UBOOT_CONFIG_ACR_PARKM_ENC_CORE

endmenu
```
