## open_uboot/config/board/ronetix/imx7-cm/Kconfig
```kconfig
if UBOOT_CONFIG_TARGET_IMX7_CM

config UBOOT_CONFIG_SYS_BOARD
	default "imx7-cm"

config UBOOT_CONFIG_SYS_VENDOR
	default "ronetix"

config UBOOT_CONFIG_SYS_SOC
	default "mx7"

config UBOOT_CONFIG_SYS_CONFIG_NAME
	default "imx7-cm"

endif
```

## open_uboot/config/board/ronetix/imx8mq-cm/Kconfig
```kconfig
if UBOOT_CONFIG_TARGET_IMX8MQ_CM

config UBOOT_CONFIG_SYS_BOARD
	default "imx8mq-cm"

config UBOOT_CONFIG_SYS_VENDOR
	default "ronetix"

config UBOOT_CONFIG_SYS_CONFIG_NAME
	default "imx8mq_cm"

config UBOOT_CONFIG_IMX_CONFIG
	default "board/ronetix/imx8mq-cm/imximage-8mq-lpddr4.cfg"

endif
```

## open_uboot/config/board/ronetix/pm9261/Kconfig
```kconfig
if UBOOT_CONFIG_TARGET_PM9261

config UBOOT_CONFIG_SYS_BOARD
	default "pm9261"

config UBOOT_CONFIG_SYS_VENDOR
	default "ronetix"

config UBOOT_CONFIG_SYS_CONFIG_NAME
	default "pm9261"

endif
```

## open_uboot/config/board/ronetix/pm9g45/Kconfig
```kconfig
if UBOOT_CONFIG_TARGET_PM9G45

config UBOOT_CONFIG_SYS_BOARD
	default "pm9g45"

config UBOOT_CONFIG_SYS_VENDOR
	default "ronetix"

config UBOOT_CONFIG_SYS_CONFIG_NAME
	default "pm9g45"

endif
```

## open_uboot/config/board/samsung/arndale/Kconfig
```kconfig
if UBOOT_CONFIG_TARGET_ARNDALE

config UBOOT_CONFIG_SYS_BOARD
	default "arndale"

config UBOOT_CONFIG_SYS_VENDOR
	default "samsung"

config UBOOT_CONFIG_SYS_CONFIG_NAME
	default "arndale"

endif
```

## open_uboot/config/board/samsung/espresso7420/Kconfig
```kconfig
if UBOOT_CONFIG_TARGET_ESPRESSO7420

config UBOOT_CONFIG_EXYNOS7420
	def_bool y

config UBOOT_CONFIG_SYS_BOARD
	default "espresso7420"
	help
	  Espresso7420 is a development/evaluation board for Exynos7420 SoC.
	  It includes multiple onboard compoments (EMMC/Codec) and various
	  interconnects (USB/HDMI).

config UBOOT_CONFIG_SYS_VENDOR
	default "samsung"

config UBOOT_CONFIG_SYS_CONFIG_NAME
	default "espresso7420"

endif
```

## open_uboot/config/board/samsung/goni/Kconfig
```kconfig
if UBOOT_CONFIG_TARGET_S5P_GONI

config UBOOT_CONFIG_SYS_BOARD
	default "goni"

config UBOOT_CONFIG_SYS_VENDOR
	default "samsung"

config UBOOT_CONFIG_SYS_SOC
	default "s5pc1xx"

config UBOOT_CONFIG_SYS_CONFIG_NAME
	default "s5p_goni"

endif
```

## open_uboot/config/board/samsung/trats/Kconfig
```kconfig
if UBOOT_CONFIG_TARGET_TRATS

config UBOOT_CONFIG_SYS_BOARD
	default "trats"

config UBOOT_CONFIG_SYS_VENDOR
	default "samsung"

config UBOOT_CONFIG_SYS_CONFIG_NAME
	default "trats"

endif
```

## open_uboot/config/board/sfr/nb4_ser/Kconfig
```kconfig
if UBOOT_CONFIG_BOARD_SFR_NB4_SER

config UBOOT_CONFIG_SYS_BOARD
	default "nb4_ser"

config UBOOT_CONFIG_SYS_VENDOR
	default "sfr"

config UBOOT_CONFIG_SYS_CONFIG_NAME
	default "sfr_nb4_ser"

endif
```

## open_uboot/config/board/siemens/capricorn/Kconfig
```kconfig
if UBOOT_CONFIG_TARGET_GIEDI

config UBOOT_CONFIG_SYS_BOARD
	default "capricorn"

config UBOOT_CONFIG_SYS_VENDOR
	default "siemens"

config UBOOT_CONFIG_SYS_CONFIG_NAME
	default "giedi"

config UBOOT_CONFIG_IMX_CONFIG
	default "board/siemens/capricorn/imximage.cfg"
endif

if UBOOT_CONFIG_TARGET_DENEB

config UBOOT_CONFIG_SYS_BOARD
	default "capricorn"

config UBOOT_CONFIG_SYS_VENDOR
	default "siemens"

config UBOOT_CONFIG_SYS_CONFIG_NAME
	default "deneb"

config UBOOT_CONFIG_IMX_CONFIG
	default "board/siemens/capricorn/imximage.cfg"

endif
```

## open_uboot/config/board/siemens/draco/Kconfig
```kconfig
if UBOOT_CONFIG_TARGET_DRACO

config UBOOT_CONFIG_SYS_BOARD
	default "draco"

config UBOOT_CONFIG_SYS_VENDOR
	default "siemens"

config UBOOT_CONFIG_SYS_SOC
	default "am33xx"

config UBOOT_CONFIG_SYS_CONFIG_NAME
	default "draco"

endif

if UBOOT_CONFIG_TARGET_THUBAN

config UBOOT_CONFIG_SYS_BOARD
	default "draco"

config UBOOT_CONFIG_SYS_VENDOR
	default "siemens"

config UBOOT_CONFIG_SYS_SOC
	default "am33xx"

config UBOOT_CONFIG_SYS_CONFIG_NAME
	default "thuban"

endif

if UBOOT_CONFIG_TARGET_RASTABAN

config UBOOT_CONFIG_SYS_BOARD
	default "draco"

config UBOOT_CONFIG_SYS_VENDOR
	default "siemens"

config UBOOT_CONFIG_SYS_SOC
	default "am33xx"

config UBOOT_CONFIG_SYS_CONFIG_NAME
	default "rastaban"

endif

if UBOOT_CONFIG_TARGET_ETAMIN

config UBOOT_CONFIG_SYS_BOARD
        default "draco"

config UBOOT_CONFIG_SYS_VENDOR
        default "siemens"

config UBOOT_CONFIG_SYS_SOC
        default "am33xx"

config UBOOT_CONFIG_SYS_CONFIG_NAME
        default "etamin"

endif
```

## open_uboot/config/board/siemens/iot2050/Kconfig
```kconfig
# SPDX-License-Identifier: GPL-2.0+
#
# Copyright (c) Siemens AG, 2018-2021
#
# Authors:
#   Le Jin <le.jin@siemens.com>
#   Jan Kiszka <jan.kiszka@siemens.com>

config UBOOT_CONFIG_TARGET_IOT2050_A53
	bool "IOT2050 running on A53"
	select UBOOT_CONFIG_ARM64
	select UBOOT_CONFIG_SOC_K3_AM6
	select UBOOT_CONFIG_BOARD_LATE_INIT
	select UBOOT_CONFIG_SYS_DISABLE_DCACHE_OPS
	select UBOOT_CONFIG_BINMAN

if UBOOT_CONFIG_TARGET_IOT2050_A53

config UBOOT_CONFIG_SYS_BOARD
	default "iot2050"

config UBOOT_CONFIG_SYS_VENDOR
	default "siemens"

config UBOOT_CONFIG_SYS_CONFIG_NAME
	default "iot2050"

config UBOOT_CONFIG_IOT2050_BOOT_SWITCH
	bool "Disable eMMC boot via USER button (Advanced version only)"
	default y

endif
```

## open_uboot/config/board/siemens/taurus/Kconfig
```kconfig
if UBOOT_CONFIG_TARGET_TAURUS

config UBOOT_CONFIG_SYS_BOARD
	default "taurus"

config UBOOT_CONFIG_SYS_VENDOR
	default "siemens"

config UBOOT_CONFIG_SYS_CONFIG_NAME
	default "taurus"

choice
	prompt "Board Type AXM/TAURUS"
	default UBOOT_CONFIG_BOARD_AXM

config UBOOT_CONFIG_BOARD_AXM
	bool "AXM board type"
	help
	  Select this, if you want to build for AXM board.

config UBOOT_CONFIG_BOARD_TAURUS
	bool "TAURUS board type"
	help
	  Select this, if you want to build for TAURUS board.

endchoice

endif
```

## open_uboot/config/board/sifive/unmatched/Kconfig
```kconfig
if UBOOT_CONFIG_TARGET_SIFIVE_UNMATCHED

config UBOOT_CONFIG_SYS_BOARD
	default "unmatched"

config UBOOT_CONFIG_SYS_VENDOR
	default "sifive"

config UBOOT_CONFIG_SYS_CPU
	default "fu740"

config UBOOT_CONFIG_SYS_CONFIG_NAME
	default "sifive-unmatched"

config UBOOT_CONFIG_SYS_TEXT_BASE
	default 0x80200000 if UBOOT_CONFIG_SPL
	default 0x80000000 if ! UBOOT_CONFIG_RISCV_SMODE
	default 0x80200000 if UBOOT_CONFIG_RISCV_SMODE

config UBOOT_CONFIG_SPL_TEXT_BASE
	default 0x08000000

config UBOOT_CONFIG_SPL_OPENSBI_LOAD_ADDR
	default 0x80000000

config UBOOT_CONFIG_BOARD_SPECIFIC_OPTIONS # dummy
	def_bool y
	select UBOOT_CONFIG_SIFIVE_FU740
	select UBOOT_CONFIG_ENV_IS_IN_SPI_FLASH
	select UBOOT_CONFIG_SUPPORT_SPL
	select UBOOT_CONFIG_RESET_SIFIVE
	select UBOOT_CONFIG_BINMAN
	imply CMD_DHCP
	imply CMD_EXT2
	imply CMD_EXT4
	imply CMD_FAT
	imply CMD_FS_GENERIC
	imply CMD_GPT
	imply PARTITION_TYPE_GUID
	imply CMD_NET
	imply CMD_PING
	imply CMD_SF
	imply DOS_PARTITION
	imply EFI_PARTITION
	imply IP_DYN
	imply ISO_PARTITION
	imply PHY_LIB
	imply PHY_MSCC
	imply SYSRESET
	imply SYSRESET_GPIO
	imply CMD_I2C

endif
```

## open_uboot/config/board/socionext/developerbox/Kconfig
```kconfig
if UBOOT_CONFIG_ARCH_SYNQUACER

choice
	prompt "SC2A11 Cortex-A53 MPCore 24cores"
	optional

config UBOOT_CONFIG_TARGET_DEVELOPERBOX
	bool "Socionext DeveloperBox"
	select UBOOT_CONFIG_PCI
	select UBOOT_CONFIG_PCIE_ECAM_SYNQUACER
	select UBOOT_CONFIG_SYS_DISABLE_DCACHE_OPS
	select UBOOT_CONFIG_OF_BOARD_SETUP
	help
	 Choose this option if you build the U-Boot for the DeveloperBox
	 96boards Enterprise Edition.
	 This board will booted from SCP firmware and it enables SMMU, thus
	 the dcache is updated automatically when DMA operation is executed.
endchoice

config UBOOT_CONFIG_SYS_SOC
	default "sc2a11"

if UBOOT_CONFIG_TARGET_DEVELOPERBOX

config UBOOT_CONFIG_SYS_BOARD
	default "developerbox"

config UBOOT_CONFIG_SYS_VENDOR
	default "socionext"

config UBOOT_CONFIG_SYS_CONFIG_NAME
	default "synquacer"

endif
endif
```

## open_uboot/config/board/socrates/Kconfig
```kconfig
if UBOOT_CONFIG_TARGET_SOCRATES

config UBOOT_CONFIG_SYS_BOARD
	default "socrates"

config UBOOT_CONFIG_SYS_CONFIG_NAME
	default "socrates"

endif
```

## open_uboot/config/board/softing/vining_2000/Kconfig
```kconfig
if UBOOT_CONFIG_TARGET_SOFTING_VINING_2000

config UBOOT_CONFIG_SYS_BOARD
	default "vining_2000"

config UBOOT_CONFIG_SYS_VENDOR
	default "softing"

config UBOOT_CONFIG_SYS_CONFIG_NAME
	default "vining_2000"

config UBOOT_CONFIG_IMX_CONFIG
	default "board/softing/vining_2000/imximage.cfg"

endif
```

## open_uboot/config/board/solidrun/mx6cuboxi/Kconfig
```kconfig
if UBOOT_CONFIG_TARGET_MX6CUBOXI

config UBOOT_CONFIG_SYS_BOARD
	default "mx6cuboxi"

config UBOOT_CONFIG_SYS_VENDOR
	default "solidrun"

config UBOOT_CONFIG_SYS_CONFIG_NAME
	default "mx6cuboxi"

endif
```

## open_uboot/config/board/st/stih410-b2260/Kconfig
```kconfig
if UBOOT_CONFIG_TARGET_STIH410_B2260

config UBOOT_CONFIG_SYS_BOARD
	string
	default "stih410-b2260"

config UBOOT_CONFIG_SYS_VENDOR
	string
	default "st"

config UBOOT_CONFIG_SYS_SOC
	string
	default "stih410"

config UBOOT_CONFIG_SYS_CONFIG_NAME
	string
	default "stih410-b2260"

endif
```

## open_uboot/config/board/st/stm32f429-evaluation/Kconfig
```kconfig
if UBOOT_CONFIG_TARGET_STM32F429_EVALUATION

config UBOOT_CONFIG_SYS_BOARD
	string
	default "stm32f429-evaluation"

config UBOOT_CONFIG_SYS_VENDOR
	string
	default "st"

config UBOOT_CONFIG_SYS_SOC
	string
	default "stm32f4"

config UBOOT_CONFIG_SYS_CONFIG_NAME
	string
	default "stm32f429-evaluation"

endif
```

## open_uboot/config/board/st/stm32f746-disco/Kconfig
```kconfig
if UBOOT_CONFIG_TARGET_STM32F746_DISCO

config UBOOT_CONFIG_SYS_BOARD
	string
	default "stm32f746-disco"

config UBOOT_CONFIG_SYS_VENDOR
	string
	default "st"

config UBOOT_CONFIG_SYS_SOC
	string
	default "stm32f7"

config UBOOT_CONFIG_SYS_CONFIG_NAME
	string
	default "stm32f746-disco"

endif
```

## open_uboot/config/board/st/stm32h743-eval/Kconfig
```kconfig
if UBOOT_CONFIG_TARGET_STM32H743_EVAL

config UBOOT_CONFIG_SYS_BOARD
	string
	default "stm32h743-eval"

config UBOOT_CONFIG_SYS_VENDOR
	string
	default "st"

config UBOOT_CONFIG_SYS_SOC
	string
	default "stm32h7"

config UBOOT_CONFIG_SYS_CONFIG_NAME
	string
	default "stm32h743-eval"

endif
```

## open_uboot/config/board/st/stm32mp1/Kconfig
```kconfig
if UBOOT_CONFIG_TARGET_ST_STM32MP15x

config UBOOT_CONFIG_SYS_BOARD
	default "stm32mp1"

config UBOOT_CONFIG_SYS_VENDOR
	default "st"

config UBOOT_CONFIG_SYS_CONFIG_NAME
	default "stm32mp15_st_common"

source "../../../board/st/common/Kconfig"
endif
```

## open_uboot/config/board/ste/stemmy/Kconfig
```kconfig
if UBOOT_CONFIG_TARGET_STEMMY

config UBOOT_CONFIG_SYS_BOARD
	default "stemmy"

config UBOOT_CONFIG_SYS_VENDOR
	default "ste"

config UBOOT_CONFIG_SYS_CONFIG_NAME
	default "stemmy"

endif
```

## open_uboot/config/board/storopack/smegw01/Kconfig
```kconfig
if UBOOT_CONFIG_TARGET_SMEGW01

config UBOOT_CONFIG_SYS_BOARD
	default "smegw01"

config UBOOT_CONFIG_SYS_VENDOR
	default "storopack"

config UBOOT_CONFIG_SYS_CONFIG_NAME
	default "smegw01"

config UBOOT_CONFIG_IMX_CONFIG
	default "board/storopack/smegw01/imximage.cfg"

endif
```
