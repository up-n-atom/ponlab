## open_uboot/config/board/keymile/km83xx/Kconfig
```kconfig
menu "KM 83xx Options"
	depends on UBOOT_CONFIG_MPC83xx

config UBOOT_CONFIG_KM_ENABLE_FULL_DM_DTS_SUPPORT
	bool "enable full DM/DTS support for KM 83xx boards"
	default y
	select UBOOT_CONFIG_CMD_DM
	select UBOOT_CONFIG_DM
	select UBOOT_CONFIG_DM_ETH
	select UBOOT_CONFIG_DM_MDIO
	select UBOOT_CONFIG_DM_SERIAL
	select UBOOT_CONFIG_OF_CONTROL
	select UBOOT_CONFIG_PINCTRL
	select UBOOT_CONFIG_PINCTRL_QE
	select UBOOT_CONFIG_PHYLIB
endmenu

config UBOOT_CONFIG_SYS_MEMTEST_START
	default 0x00100000

config UBOOT_CONFIG_SYS_MEMTEST_END
	default 0x00f00000

if UBOOT_CONFIG_TARGET_KMETER1

config UBOOT_CONFIG_SYS_BOARD
	default "km83xx"

config UBOOT_CONFIG_SYS_VENDOR
	default "keymile"

config UBOOT_CONFIG_SYS_CONFIG_NAME
	default "kmeter1"

config UBOOT_CONFIG_BOARD_SPECIFIC_OPTIONS # dummy
	def_bool y
	select UBOOT_CONFIG_ARCH_MPC8360
	imply CMD_CRAMFS
	imply CMD_DIAG
	imply FS_CRAMFS

endif

if UBOOT_CONFIG_TARGET_KMCOGE5NE

config UBOOT_CONFIG_SYS_BOARD
	default "km83xx"

config UBOOT_CONFIG_SYS_VENDOR
	default "keymile"

config UBOOT_CONFIG_SYS_CONFIG_NAME
	default "kmcoge5ne"

config UBOOT_CONFIG_BOARD_SPECIFIC_OPTIONS # dummy
	def_bool y
	select UBOOT_CONFIG_ARCH_MPC8360
	imply CMD_CRAMFS
	imply CMD_DIAG
	imply FS_CRAMFS

endif

if UBOOT_CONFIG_TARGET_KMTEGR1

config UBOOT_CONFIG_SYS_BOARD
	default "km83xx"

config UBOOT_CONFIG_SYS_VENDOR
	default "keymile"

config UBOOT_CONFIG_SYS_CONFIG_NAME
	default "kmtegr1"

config UBOOT_CONFIG_BOARD_SPECIFIC_OPTIONS # dummy
	def_bool y
	select UBOOT_CONFIG_ARCH_MPC8309
	imply CMD_CRAMFS
	imply FS_CRAMFS

endif

if UBOOT_CONFIG_TARGET_TUXX1

config UBOOT_CONFIG_SYS_BOARD
	default "km83xx"

config UBOOT_CONFIG_SYS_VENDOR
	default "keymile"

config UBOOT_CONFIG_SYS_CONFIG_NAME
	default "tuxx1"

config UBOOT_CONFIG_BOARD_SPECIFIC_OPTIONS # dummy
	def_bool y
	select UBOOT_CONFIG_ARCH_MPC832X
	imply CMD_CRAMFS
	imply FS_CRAMFS

endif

if UBOOT_CONFIG_TARGET_KMSUPX5

config UBOOT_CONFIG_SYS_BOARD
	default "km83xx"

config UBOOT_CONFIG_SYS_VENDOR
	default "keymile"

config UBOOT_CONFIG_SYS_CONFIG_NAME
	default "kmsupx5"

config UBOOT_CONFIG_BOARD_SPECIFIC_OPTIONS # dummy
	def_bool y
	select UBOOT_CONFIG_ARCH_MPC832X
	imply CMD_CRAMFS
	imply FS_CRAMFS

endif

if UBOOT_CONFIG_TARGET_TUGE1

config UBOOT_CONFIG_SYS_BOARD
	default "km83xx"

config UBOOT_CONFIG_SYS_VENDOR
	default "keymile"

config UBOOT_CONFIG_SYS_CONFIG_NAME
	default "tuge1"

config UBOOT_CONFIG_BOARD_SPECIFIC_OPTIONS # dummy
	def_bool y
	select UBOOT_CONFIG_ARCH_MPC832X
	imply CMD_CRAMFS
	imply FS_CRAMFS

endif

if UBOOT_CONFIG_TARGET_KMOPTI2

config UBOOT_CONFIG_SYS_BOARD
	default "km83xx"

config UBOOT_CONFIG_SYS_VENDOR
	default "keymile"

config UBOOT_CONFIG_SYS_CONFIG_NAME
	default "kmopti2"

config UBOOT_CONFIG_BOARD_SPECIFIC_OPTIONS # dummy
	def_bool y
	select UBOOT_CONFIG_ARCH_MPC832X
	imply CMD_CRAMFS
	imply FS_CRAMFS

endif

if UBOOT_CONFIG_TARGET_KMTEPR2

config UBOOT_CONFIG_SYS_BOARD
	default "km83xx"

config UBOOT_CONFIG_SYS_VENDOR
	default "keymile"

config UBOOT_CONFIG_SYS_CONFIG_NAME
	default "kmtepr2"

config UBOOT_CONFIG_BOARD_SPECIFIC_OPTIONS # dummy
	def_bool y
	select UBOOT_CONFIG_ARCH_MPC832X
	imply CMD_CRAMFS
	imply FS_CRAMFS

endif
```
