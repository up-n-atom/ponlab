## open_uboot/config/board/freescale/t102xrdb/Kconfig
```kconfig
if UBOOT_CONFIG_TARGET_T1023RDB || UBOOT_CONFIG_TARGET_T1024RDB

config UBOOT_CONFIG_SYS_BOARD
	default "t102xrdb"

config UBOOT_CONFIG_SYS_VENDOR
	default "freescale"

config UBOOT_CONFIG_SYS_CONFIG_NAME
	default "T102xRDB"

source "../../../board/freescale/common/Kconfig"

endif
```

## open_uboot/config/board/freescale/t104xrdb/Kconfig
```kconfig
if UBOOT_CONFIG_TARGET_T1040RDB || UBOOT_CONFIG_TARGET_T1040D4RDB || \
	TARGET_T1042RDB || UBOOT_CONFIG_TARGET_T1042D4RDB || \
	TARGET_T1042RDB_PI

config UBOOT_CONFIG_SYS_BOARD
	default "t104xrdb"

config UBOOT_CONFIG_SYS_VENDOR
	default "freescale"

config UBOOT_CONFIG_SYS_CONFIG_NAME
	default "T104xRDB"

source "../../../board/freescale/common/Kconfig"

endif
```

## open_uboot/config/board/freescale/t208xqds/Kconfig
```kconfig
if UBOOT_CONFIG_TARGET_T2080QDS

config UBOOT_CONFIG_SYS_BOARD
	default "t208xqds"

config UBOOT_CONFIG_SYS_VENDOR
	default "freescale"

config UBOOT_CONFIG_SYS_CONFIG_NAME
	default "T208xQDS"

source "../../../board/freescale/common/Kconfig"

endif
```

## open_uboot/config/board/freescale/vf610twr/Kconfig
```kconfig
if UBOOT_CONFIG_TARGET_VF610TWR

config UBOOT_CONFIG_SYS_BOARD
	default "vf610twr"

config UBOOT_CONFIG_SYS_VENDOR
	default "freescale"

config UBOOT_CONFIG_SYS_CONFIG_NAME
	default "vf610twr"

config UBOOT_CONFIG_IMX_CONFIG
	default "board/freescale/vf610twr/imximage.cfg"

endif
```

## open_uboot/config/board/friendlyarm/Kconfig
```kconfig
choice
	prompt "LCD backlight control"
	optional
	default UBOOT_CONFIG_S5P4418_ONEWIRE

config UBOOT_CONFIG_S5P4418_ONEWIRE
	bool "I2C / 1-Wire"
	help
	  This enables LCD-Backlight control for FriendlyARM LCD-panels.
	  I2C is used if available, otherwise 1-Wire is used.

config UBOOT_CONFIG_PWM_NX
	bool "PWM"
	help
	  This enables LCD-Backlight control via PWM.
endchoice

config UBOOT_CONFIG_ROOT_DEV
	int "ROOT_DEV"
	help
	  Environment variable rootdev is set to this value if env. var. firstboot
	  does not exist. Otherwise rootdev is set to the MMC boot device. rootdev
	  determines (together with env. var. bootpart) where the OS (linux) is
	  booted from.

config UBOOT_CONFIG_BOOT_PART
	int "BOOT_PART"
	help
	  Environment variable bootpart is set to this value. bootpart determines
	  (together with env. var. rootdev) where the OS (linux) is booted from.

config UBOOT_CONFIG_ROOT_PART
	int "ROOT_PART"
	help
	  Environment variable rootpart is set to this value.

source "nanopi2/Kconfig"
```

## open_uboot/config/board/gateworks/venice/Kconfig
```kconfig
if UBOOT_CONFIG_TARGET_IMX8MM_VENICE

config UBOOT_CONFIG_SYS_BOARD
	default "venice"

config UBOOT_CONFIG_SYS_VENDOR
	default "gateworks"

config UBOOT_CONFIG_SYS_CONFIG_NAME
	default "imx8mm_venice"

config UBOOT_CONFIG_IMX_CONFIG
	default "board/gateworks/venice/imximage-8mm-lpddr4.cfg"
endif
```

## open_uboot/config/board/gdsys/mpc8308/Kconfig
```kconfig
if UBOOT_CONFIG_TARGET_GAZERBEAM

config UBOOT_CONFIG_GDSYS_LEGACY_OSD_CMDS
	bool
	help
	  Use the 'osdw', 'osdp', and 'osdsize' legacy commands required by
	  gdsys devices.

config UBOOT_CONFIG_GDSYS_LEGACY_DRIVERS
	bool
	help
	  Enable the gdsys legacy drivers under board/gdsys/common. If this
	  option is not set, all relevant DM drivers must be configured for the
	  device in question.

config UBOOT_CONFIG_SYS_FPGA0_BASE
	hex
	default UBOOT_CONFIG_E0600000
	help
	  The base address of the first FPGA's register map.

config UBOOT_CONFIG_SYS_FPGA0_SIZE
	hex
	default 1
	help
	  The base address of the first FPGA's register map.

config UBOOT_CONFIG_SYS_FPGA1_BASE
	hex
	help
	  The base address of the second FPGA's register map.

config UBOOT_CONFIG_SYS_FPGA1_SIZE
	hex
	help
	  The base address of the second FPGA's register map.

config UBOOT_CONFIG_SYS_BOARD
	default "mpc8308"

config UBOOT_CONFIG_SYS_VENDOR
	default "gdsys"

config UBOOT_CONFIG_SYS_CONFIG_NAME
	default "gazerbeam"

config UBOOT_CONFIG_SYS_FPGA1_BASE
	default UBOOT_CONFIG_E0700000

config UBOOT_CONFIG_SYS_FPGA1_SIZE
	default 1

config UBOOT_CONFIG_GDSYS_LEGACY_OSD_CMDS
	default y

choice
	prompt "FPGA flavor selection"

config UBOOT_CONFIG_SYS_FPGA_FLAVOR_LEGACY
	bool "Legacy flavor"
	help
	  This enables support for the gdsys pre-Gazerbeam FPGA memory layout.

config UBOOT_CONFIG_SYS_FPGA_FLAVOR_GAZERBEAM
	bool "Gazerbeam flavor"
	help
	  This enables support for the gdsys FPGA memory layout of the
	  Gazerbeam board.

endchoice

config UBOOT_CONFIG_EXTENDED_FEATURES
	bool "FPGA extended features"
	depends on UBOOT_CONFIG_GDSYS_LEGACY_DRIVERS
	help
	  Enable support for the extended features field of the IHS FPGA.

config UBOOT_CONFIG_CMD_IOLOOP
	bool "Enable 'ioloop' and 'ioreflect' commands"
	help
	  These commands provide FPGA tests.

endif
```

## open_uboot/config/board/ge/b1x5v2/Kconfig
```kconfig
if UBOOT_CONFIG_TARGET_GE_B1X5V2

config UBOOT_CONFIG_SYS_BOARD
	default "b1x5v2"

config UBOOT_CONFIG_SYS_VENDOR
	default "ge"

config UBOOT_CONFIG_SYS_CONFIG_NAME
	default "ge_b1x5v2"

source "../../../board/ge/common/Kconfig"

endif
```

## open_uboot/config/board/ge/bx50v3/Kconfig
```kconfig
if UBOOT_CONFIG_TARGET_GE_BX50V3

config UBOOT_CONFIG_IMX_CONFIG
	default "board/ge/bx50v3/bx50v3.cfg"

config UBOOT_CONFIG_SYS_BOARD
	default "bx50v3"

config UBOOT_CONFIG_SYS_VENDOR
	default "ge"

config UBOOT_CONFIG_SYS_SOC
	default "mx6"

config UBOOT_CONFIG_SYS_CONFIG_NAME
	default "ge_bx50v3"

source "../../../board/ge/common/Kconfig"

endif
```

## open_uboot/config/board/ge/common/Kconfig
```kconfig
config UBOOT_CONFIG_GE_VPD
	bool "Enable GE VPD Support"
	default y

config UBOOT_CONFIG_GE_RTC
	bool "Enable GE RTC Support"
	default y
```

## open_uboot/config/board/ge/mx53ppd/Kconfig
```kconfig
if UBOOT_CONFIG_TARGET_MX53PPD

config UBOOT_CONFIG_SYS_BOARD
	default "mx53ppd"

config UBOOT_CONFIG_SYS_VENDOR
	default "ge"

config UBOOT_CONFIG_SYS_SOC
	default "mx5"

config UBOOT_CONFIG_SYS_CONFIG_NAME
	default "mx53ppd"

config UBOOT_CONFIG_IMX_CONFIG
	default "board/ge/mx53ppd/imximage.cfg"

source "../../../board/ge/common/Kconfig"

endif
```

## open_uboot/config/board/google/chromebook_samus/Kconfig
```kconfig
if UBOOT_CONFIG_TARGET_CHROMEBOOK_SAMUS || UBOOT_CONFIG_TARGET_CHROMEBOOK_SAMUS_TPL

config UBOOT_CONFIG_SYS_BOARD
	default "chromebook_samus"

config UBOOT_CONFIG_SYS_VENDOR
	default "google"

config UBOOT_CONFIG_SYS_SOC
	default "broadwell"

config UBOOT_CONFIG_SYS_CONFIG_NAME
	default "chromebook_samus" if UBOOT_CONFIG_TARGET_CHROMEBOOK_SAMUS
	default "chromebook_samus" if UBOOT_CONFIG_TARGET_CHROMEBOOK_SAMUS_TPL

config UBOOT_CONFIG_SYS_TEXT_BASE
	default 0xffe00000

config UBOOT_CONFIG_BOARD_SPECIFIC_OPTIONS # dummy
	def_bool y
	select UBOOT_CONFIG_X86_RESET_VECTOR
	select UBOOT_CONFIG_USE_EARLY_BOARD_INIT
	select UBOOT_CONFIG_INTEL_BROADWELL
	select UBOOT_CONFIG_HAVE_INTEL_ME
	select UBOOT_CONFIG_BOARD_ROMSIZE_KB_8192
	select UBOOT_CONFIG_SPI_FLASH_WINBOND

config UBOOT_CONFIG_PCIE_ECAM_BASE
	default 0xf0000000

config UBOOT_CONFIG_EARLY_POST_CROS_EC
	bool "Enable early post to Chrome OS EC"
	default y

config UBOOT_CONFIG_SYS_CAR_ADDR
	hex
	default 0xff7c0000

config UBOOT_CONFIG_SYS_CAR_SIZE
	hex
	default 0x40000

endif

if UBOOT_CONFIG_TARGET_CHROMEBOOK_SAMUS_TPL

config UBOOT_CONFIG_BOARD_SPECIFIC_OPTIONS_TPL # dummy
	def_bool y
	select UBOOT_CONFIG_SPL
	select UBOOT_CONFIG_TPL

endif
```

## open_uboot/config/board/google/gru/Kconfig
```kconfig
if UBOOT_CONFIG_TARGET_CHROMEBOOK_BOB

config UBOOT_CONFIG_SYS_BOARD
	default "gru"

config UBOOT_CONFIG_SYS_VENDOR
	default "google"

config UBOOT_CONFIG_SYS_CONFIG_NAME
	default "gru"

config UBOOT_CONFIG_BOARD_SPECIFIC_OPTIONS # dummy
	def_bool y

endif
```

## open_uboot/config/board/google/veyron/Kconfig
```kconfig
if UBOOT_CONFIG_TARGET_CHROMEBOOK_JERRY

config UBOOT_CONFIG_SYS_BOARD
	default "veyron"

config UBOOT_CONFIG_SYS_VENDOR
	default "google"

config UBOOT_CONFIG_SYS_CONFIG_NAME
	default "veyron"

config UBOOT_CONFIG_BOARD_SPECIFIC_OPTIONS # dummy
	def_bool y

endif

if UBOOT_CONFIG_TARGET_CHROMEBIT_MICKEY

config UBOOT_CONFIG_SYS_BOARD
	default "veyron"

config UBOOT_CONFIG_SYS_VENDOR
	default "google"

config UBOOT_CONFIG_SYS_CONFIG_NAME
	default "veyron"

config UBOOT_CONFIG_BOARD_SPECIFIC_OPTIONS # dummy
	def_bool y

endif

if UBOOT_CONFIG_TARGET_CHROMEBOOK_MINNIE

config UBOOT_CONFIG_SYS_BOARD
	default "veyron"

config UBOOT_CONFIG_SYS_VENDOR
	default "google"

config UBOOT_CONFIG_SYS_CONFIG_NAME
	default "veyron"

config UBOOT_CONFIG_BOARD_SPECIFIC_OPTIONS # dummy
	def_bool y

endif

if UBOOT_CONFIG_TARGET_CHROMEBOOK_SPEEDY

config UBOOT_CONFIG_SYS_BOARD
	default "veyron"

config UBOOT_CONFIG_SYS_VENDOR
	default "google"

config UBOOT_CONFIG_SYS_CONFIG_NAME
	default "veyron"

config UBOOT_CONFIG_BOARD_SPECIFIC_OPTIONS # dummy
	def_bool y

endif
```

## open_uboot/config/board/hardkernel/odroid_go2/Kconfig
```kconfig
if UBOOT_CONFIG_TARGET_ODROID_GO2

config UBOOT_CONFIG_SYS_BOARD
	default "odroid_go2"

config UBOOT_CONFIG_SYS_VENDOR
	default "hardkernel"

config UBOOT_CONFIG_SYS_CONFIG_NAME
	default "odroid_go2"

config UBOOT_CONFIG_BOARD_SPECIFIC_OPTIONS # dummy
	def_bool y

endif
```

## open_uboot/config/board/hisilicon/hikey/Kconfig
```kconfig
if UBOOT_CONFIG_TARGET_HIKEY

config UBOOT_CONFIG_SYS_BOARD
	default "hikey"

config UBOOT_CONFIG_SYS_VENDOR
	default "hisilicon"

config UBOOT_CONFIG_SYS_SOC
	default "hi6220"

config UBOOT_CONFIG_SYS_CONFIG_NAME
	default "hikey"

endif
```

## open_uboot/config/board/hisilicon/poplar/Kconfig
```kconfig
if UBOOT_CONFIG_TARGET_POPLAR

config UBOOT_CONFIG_SYS_BOARD
	default "poplar"

config UBOOT_CONFIG_SYS_VENDOR
	default "hisilicon"

config UBOOT_CONFIG_SYS_SOC
	default "hi3798cv200"

config UBOOT_CONFIG_SYS_CONFIG_NAME
	default "poplar"

endif
```

## open_uboot/config/board/huawei/hg556a/Kconfig
```kconfig
if UBOOT_CONFIG_BOARD_HUAWEI_HG556A

config UBOOT_CONFIG_SYS_BOARD
	default "hg556a"

config UBOOT_CONFIG_SYS_VENDOR
	default "huawei"

config UBOOT_CONFIG_SYS_CONFIG_NAME
	default "huawei_hg556a"

endif
```

## open_uboot/config/board/ids/ids8313/Kconfig
```kconfig
if UBOOT_CONFIG_TARGET_IDS8313

config UBOOT_CONFIG_SYS_BOARD
	default "ids8313"

config UBOOT_CONFIG_SYS_VENDOR
	default "ids"

config UBOOT_CONFIG_SYS_CONFIG_NAME
	default "ids8313"

endif
```

## open_uboot/config/board/imgtec/ci20/Kconfig
```kconfig
if UBOOT_CONFIG_TARGET_JZ4780_CI20

config UBOOT_CONFIG_SYS_BOARD
	default "ci20"

config UBOOT_CONFIG_SYS_VENDOR
	default "imgtec"

config UBOOT_CONFIG_SYS_CONFIG_NAME
	default "ci20"

config UBOOT_CONFIG_SYS_TEXT_BASE
	default 0x80000000

endif
```

## open_uboot/config/board/intel/cougarcanyon2/Kconfig
```kconfig
if UBOOT_CONFIG_TARGET_COUGARCANYON2

config UBOOT_CONFIG_SYS_BOARD
	default "cougarcanyon2"

config UBOOT_CONFIG_SYS_VENDOR
	default "intel"

config UBOOT_CONFIG_SYS_SOC
	default "ivybridge"

config UBOOT_CONFIG_SYS_CONFIG_NAME
	default "cougarcanyon2"

config UBOOT_CONFIG_SYS_TEXT_BASE
	default 0xffe00000

config UBOOT_CONFIG_BOARD_SPECIFIC_OPTIONS # dummy
	def_bool y
	select UBOOT_CONFIG_X86_RESET_VECTOR
	select UBOOT_CONFIG_NORTHBRIDGE_INTEL_IVYBRIDGE
	select UBOOT_CONFIG_HAVE_FSP
	select UBOOT_CONFIG_BOARD_ROMSIZE_KB_2048
	select UBOOT_CONFIG_BOARD_EARLY_INIT_F
	select UBOOT_CONFIG_SPI_FLASH_WINBOND

endif
```

## open_uboot/config/board/intel/crownbay/Kconfig
```kconfig
if UBOOT_CONFIG_TARGET_CROWNBAY

config UBOOT_CONFIG_SYS_BOARD
	default "crownbay"

config UBOOT_CONFIG_SYS_VENDOR
	default "intel"

config UBOOT_CONFIG_SYS_SOC
	default "queensbay"

config UBOOT_CONFIG_SYS_CONFIG_NAME
	default "crownbay"

config UBOOT_CONFIG_SYS_TEXT_BASE
	default 0xfff00000

config UBOOT_CONFIG_BOARD_SPECIFIC_OPTIONS # dummy
	def_bool y
	select UBOOT_CONFIG_X86_RESET_VECTOR
	select UBOOT_CONFIG_INTEL_QUEENSBAY
	select UBOOT_CONFIG_BOARD_ROMSIZE_KB_1024
	select UBOOT_CONFIG_BOARD_EARLY_INIT_F
	select UBOOT_CONFIG_SPI_FLASH_SST

endif
```

## open_uboot/config/board/isee/igep003x/Kconfig
```kconfig
if UBOOT_CONFIG_TARGET_AM335X_IGEP003X

config UBOOT_CONFIG_SYS_BOARD
	default "igep003x"

config UBOOT_CONFIG_SYS_VENDOR
	default "isee"

config UBOOT_CONFIG_SYS_SOC
	default "am33xx"

config UBOOT_CONFIG_SYS_CONFIG_NAME
	default "am335x_igep003x"

endif
```

## open_uboot/config/board/keymile/Kconfig
```kconfig
# SPDX-License-Identifier: GPL-2.0+
#
# Copyright (C) 2019, Pascal Linder <pascal.linder@edu.hefr.ch>

config UBOOT_CONFIG_VENDOR_KM
	bool
	help
	  Selected by any KM board to have additional configurations.

if UBOOT_CONFIG_VENDOR_KM

menu "KM Board Setup"

config UBOOT_CONFIG_KM_PNVRAM
	hex "Pseudo RAM"
	default 0x80000
	depends on !UBOOT_CONFIG_ARCH_SOCFPGA
	help
	  Start address of the pseudo non-volatile RAM for application.

config UBOOT_CONFIG_KM_PHRAM
	hex "Physical RAM"
	default 0x17F000 if UBOOT_CONFIG_ARM && !UBOOT_CONFIG_ARCH_LS1021A
	default 0x100000 if UBOOT_CONFIG_PPC || UBOOT_CONFIG_ARCH_LS1021A
	depends on !UBOOT_CONFIG_ARCH_SOCFPGA
	help
	  Start address of the physical RAM, which is the mounted /var folder.

config UBOOT_CONFIG_KM_RESERVED_PRAM
	hex "Reserved RAM"
	default 0x801000 if UBOOT_CONFIG_ARCH_KIRKWOOD
	default 0x0 if UBOOT_CONFIG_MPC83xx
	default 0x1000 if UBOOT_CONFIG_MPC85xx || UBOOT_CONFIG_ARCH_LS1021A
	depends on !UBOOT_CONFIG_ARCH_SOCFPGA
	help
	  Reserved physical RAM area at the end of memory for special purposes.

config UBOOT_CONFIG_KM_CRAMFS_ADDR
	hex "CRAMFS Address"
	default 0x83000000 if UBOOT_CONFIG_ARCH_LS1021A
	default 0x3000000
	depends on !UBOOT_CONFIG_ARCH_SOCFPGA
	help
	  Start address of the CRAMFS containing the Linux kernel.

config UBOOT_CONFIG_KM_KERNEL_ADDR
	hex "Kernel Load Address"
	default 0x82000000 if UBOOT_CONFIG_ARCH_LS1021A
	default 0x2000000
	help
	  Address where to load Linux kernel in RAM.

config UBOOT_CONFIG_KM_FDT_ADDR
	hex "FDT Load Address"
	default 0x82FC0000 if UBOOT_CONFIG_ARCH_LS1021A
	default 0x2FC0000
	help
	  Address where to load flattened device tree in RAM.

config UBOOT_CONFIG_SYS_PAX_BASE
	hex "PAX IFC Base Address"
	default 0x78000000
	depends on UBOOT_CONFIG_ARCH_LS1021A
	help
	  IFC Base Address for PAXx FPGA.

config UBOOT_CONFIG_SYS_CLIPS_BASE
	hex "CLIPS IFC Base Address"
	default 0x78000000
	depends on UBOOT_CONFIG_ARCH_LS1021A
	help
	  IFC Base Address for CLIPS FPGA.

config UBOOT_CONFIG_KM_CONSOLE_TTY
	string "KM Console"
	default "ttyS0"
	help
	  TTY console to use on board.

config UBOOT_CONFIG_KM_DEF_NETDEV
	string "Default Netdevice"
	default "eth0"
	help
	  Default netdevice for debug interface

config UBOOT_CONFIG_KM_COMMON_ETH_INIT
	bool "Common Ethernet Initialization"
	default y if UBOOT_CONFIG_ARCH_KIRKWOOD || UBOOT_CONFIG_MPC83xx
	default n if UBOOT_CONFIG_MPC85xx || UBOOT_CONFIG_ARCH_SOCFPGA || UBOOT_CONFIG_ARCH_LS1021A
	help
	  Use the Ethernet initialization implemented in common code that
	  detects if a Piggy board is present.

config UBOOT_CONFIG_PIGGY_MAC_ADDRESS_OFFSET
	int "Piggy Address Offset"
	default 0
	help
	  MAC address offset for the Piggy board.

config UBOOT_CONFIG_KM_MVEXTSW_ADDR
	hex "Marvell Switch Address"
	depends on UBOOT_CONFIG_MV88E6352_SWITCH
	default 0x10
	help
	  Address of external Marvell switch.

config UBOOT_CONFIG_KM_IVM_BUS
	int "IVM I2C Bus"
	default 0 if UBOOT_CONFIG_ARCH_SOCFPGA
	default 1 if UBOOT_CONFIG_ARCH_KIRKWOOD || UBOOT_CONFIG_MPC85xx || UBOOT_CONFIG_ARCH_LS1021A
	default 2 if UBOOT_CONFIG_MPC83xx
	help
	  Identifier number of I2C bus, where the inventory EEPROM is connected to.

config UBOOT_CONFIG_SYS_IVM_EEPROM_ADR
	hex "IVM I2C Address"
	default 0x50
	help
	  I2C address of the EEPROM containing the inventory.

config UBOOT_CONFIG_SYS_IVM_EEPROM_MAX_LEN
	hex "IVM Length"
	default 0x400
	help
	  Maximum length of inventory in EEPROM.

config UBOOT_CONFIG_SYS_IVM_EEPROM_PAGE_LEN
	hex "IVM Page Size"
	default 0x100
	help
	  Page size of inventory in EEPROM.

source "km83xx/Kconfig"
source "kmcent2/Kconfig"
source "km_arm/Kconfig"
source "pg-wcom-ls102xa/Kconfig"

endmenu

endif
```
