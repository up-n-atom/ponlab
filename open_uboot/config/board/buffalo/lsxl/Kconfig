## open_uboot/config/board/buffalo/lsxl/Kconfig
```kconfig
if UBOOT_CONFIG_TARGET_LSXL

config UBOOT_CONFIG_SYS_BOARD
	default "lsxl"

config UBOOT_CONFIG_SYS_VENDOR
	default "buffalo"

config UBOOT_CONFIG_SYS_CONFIG_NAME
	default "lsxl"

endif
```

## open_uboot/config/board/cavium/thunderx/Kconfig
```kconfig
if UBOOT_CONFIG_TARGET_THUNDERX_88XX

config UBOOT_CONFIG_SYS_CPU
	string
	default "armv8"

config UBOOT_CONFIG_SYS_BOARD
	string
	default "thunderx"

config UBOOT_CONFIG_SYS_VENDOR
	string
	default "cavium"

config UBOOT_CONFIG_SYS_CONFIG_NAME
	string
	default "thunderx_88xx"

config UBOOT_CONFIG_CMD_ATF
	bool "Enable ATF query commands"
	default y
	help
	  Enable vendor specific ATF query commands such as SPI and SD/MMC
	  devices access, low level environment query, boot device layout
	  and node count.

endif
```

## open_uboot/config/board/chipspark/popmetal_rk3288/Kconfig
```kconfig
if UBOOT_CONFIG_TARGET_POPMETAL_RK3288

config UBOOT_CONFIG_SYS_BOARD
	default "popmetal_rk3288"

config UBOOT_CONFIG_SYS_VENDOR
	default "chipspark"

config UBOOT_CONFIG_SYS_CONFIG_NAME
	default "popmetal_rk3288"

config UBOOT_CONFIG_BOARD_SPECIFIC_OPTIONS # dummy
	def_bool y

endif
```

## open_uboot/config/board/cloudengines/pogo_e02/Kconfig
```kconfig
if UBOOT_CONFIG_TARGET_POGO_E02

config UBOOT_CONFIG_SYS_BOARD
	default "pogo_e02"

config UBOOT_CONFIG_SYS_VENDOR
	default "cloudengines"

config UBOOT_CONFIG_SYS_CONFIG_NAME
	default "pogo_e02"

endif
```

## open_uboot/config/board/compal/paz00/Kconfig
```kconfig
if UBOOT_CONFIG_TARGET_PAZ00

config UBOOT_CONFIG_SYS_BOARD
	default "paz00"

config UBOOT_CONFIG_SYS_VENDOR
	default "compal"

config UBOOT_CONFIG_SYS_CONFIG_NAME
	default "paz00"

endif
```

## open_uboot/config/board/compulab/cm_t335/Kconfig
```kconfig
if UBOOT_CONFIG_TARGET_CM_T335

config UBOOT_CONFIG_SYS_BOARD
	default "cm_t335"

config UBOOT_CONFIG_SYS_VENDOR
	default "compulab"

config UBOOT_CONFIG_SYS_SOC
	default "am33xx"

config UBOOT_CONFIG_SYS_CONFIG_NAME
	default "cm_t335"

endif
```

## open_uboot/config/board/compulab/cm_t43/Kconfig
```kconfig
if UBOOT_CONFIG_TARGET_CM_T43

config UBOOT_CONFIG_SYS_BOARD
	default "cm_t43"

config UBOOT_CONFIG_SYS_VENDOR
	default "compulab"

config UBOOT_CONFIG_SYS_SOC
	default "am33xx"

config UBOOT_CONFIG_SYS_CONFIG_NAME
	default "cm_t43"

endif
```

## open_uboot/config/board/compulab/imx8mm-cl-iot-gate/Kconfig
```kconfig
if UBOOT_CONFIG_TARGET_IMX8MM_CL_IOT_GATE || UBOOT_CONFIG_TARGET_IMX8MM_CL_IOT_GATE_OPTEE

config UBOOT_CONFIG_SYS_BOARD
	default "imx8mm-cl-iot-gate"

config UBOOT_CONFIG_SYS_VENDOR
	default "compulab"

config UBOOT_CONFIG_SYS_CONFIG_NAME
	default "imx8mm-cl-iot-gate"

config UBOOT_CONFIG_IMX_CONFIG
	default "board/compulab/imx8mm-cl-iot-gate/imximage-8mm-lpddr4.cfg"

endif
```

## open_uboot/config/board/compulab/trimslice/Kconfig
```kconfig
if UBOOT_CONFIG_TARGET_TRIMSLICE

config UBOOT_CONFIG_SYS_BOARD
	default "trimslice"

config UBOOT_CONFIG_SYS_VENDOR
	default "compulab"

config UBOOT_CONFIG_SYS_CONFIG_NAME
	default "trimslice"

endif
```

## open_uboot/config/board/coreboot/coreboot/Kconfig
```kconfig
if UBOOT_CONFIG_VENDOR_COREBOOT

config UBOOT_CONFIG_SYS_BOARD
	default "coreboot"

config UBOOT_CONFIG_SYS_VENDOR
	default "coreboot"

config UBOOT_CONFIG_SYS_SOC
	default "coreboot"

config UBOOT_CONFIG_SYS_TEXT_BASE
	default 0x01110000

config UBOOT_CONFIG_BOARD_SPECIFIC_OPTIONS # dummy
	def_bool y
	select UBOOT_CONFIG_BOARD_EARLY_INIT_R

config UBOOT_CONFIG_SYS_CAR_ADDR
	hex "Board specific Cache-As-RAM (CAR) address"
	default 0x01920000
	help
	  This option specifies the board specific Cache-As-RAM (CAR) address.

config UBOOT_CONFIG_SYS_CAR_SIZE
	hex "Board specific Cache-As-RAM (CAR) size"
	default 0x4000
	help
	  This option specifies the board specific Cache-As-RAM (CAR) size.

endif  # CONFIG_VENDOR_COREBOOT

if UBOOT_CONFIG_TARGET_COREBOOT

config UBOOT_CONFIG_SYS_CONFIG_NAME
	default "coreboot"

endif
```

## open_uboot/config/board/d-link/dns325/Kconfig
```kconfig
if UBOOT_CONFIG_TARGET_DNS325

config UBOOT_CONFIG_SYS_BOARD
	default "dns325"

config UBOOT_CONFIG_SYS_VENDOR
	default "d-link"

config UBOOT_CONFIG_SYS_CONFIG_NAME
	default "dns325"

endif
```

## open_uboot/config/board/ea/ea-lpc3250devkitv2/Kconfig
```kconfig
if UBOOT_CONFIG_TARGET_EA_LPC3250DEVKITV2

config UBOOT_CONFIG_SYS_BOARD
	default "ea-lpc3250devkitv2"

config UBOOT_CONFIG_SYS_VENDOR
	default "ea"

config UBOOT_CONFIG_SYS_SOC
	default "lpc32xx"

config UBOOT_CONFIG_SYS_CONFIG_NAME
	default "ea-lpc3250devkitv2"

endif
```

## open_uboot/config/board/ea/mx7ulp_com/Kconfig
```kconfig
if UBOOT_CONFIG_TARGET_MX7ULP_COM

config UBOOT_CONFIG_SYS_BOARD
	default "mx7ulp_com"

config UBOOT_CONFIG_SYS_VENDOR
	default "ea"

config UBOOT_CONFIG_SYS_CONFIG_NAME
	default "mx7ulp_com"

config UBOOT_CONFIG_IMX_CONFIG
	default "board/ea/mx7ulp_com/imximage.cfg"

endif
```

## open_uboot/config/board/eets/pdu001/Kconfig
```kconfig
# Copyright (C) 2018 EETS GmbH - http://www.eets.ch/
#
# SPDX-License-Identifier: GPL-2.0+
#

if UBOOT_CONFIG_TARGET_PDU001

config UBOOT_CONFIG_SYS_BOARD
	default "pdu001"

config UBOOT_CONFIG_SYS_VENDOR
	default "eets"

config UBOOT_CONFIG_SYS_SOC
	default "am33xx"

config UBOOT_CONFIG_SYS_CONFIG_NAME
	default "pdu001"

choice
	prompt "State of Run LED"
	default UBOOT_CONFIG_RUN_LED_RED
	help
	  The PDU001 has a bi-color (red/green) LED labeled 'Run' which
	  can be used to indicate the operating state of the board. By
	  default it will be lit red by U-Boot. Later in the start-up
	  process it can be changed to green (or heartbeat or anything else)
	  by the kernel or some other software.

config UBOOT_CONFIG_RUN_LED_RED
	bool
	prompt "Red"
	help
	  Lit Run LED red.

config UBOOT_CONFIG_RUN_LED_GREEN
	bool
	prompt "Green"
	help
	  Lit Run LED green.

config UBOOT_CONFIG_RUN_LED_OFF
	bool
	prompt "Off"
	help
	  Do not lit Run LED.

endchoice

endif
```

## open_uboot/config/board/egnite/ethernut5/Kconfig
```kconfig
if UBOOT_CONFIG_TARGET_ETHERNUT5

config UBOOT_CONFIG_SYS_BOARD
	default "ethernut5"

config UBOOT_CONFIG_SYS_VENDOR
	default "egnite"

config UBOOT_CONFIG_SYS_CONFIG_NAME
	default "ethernut5"

endif
```

## open_uboot/config/board/emulation/qemu-arm/Kconfig
```kconfig
if UBOOT_CONFIG_TARGET_QEMU_ARM_32BIT || UBOOT_CONFIG_TARGET_QEMU_ARM_64BIT

config UBOOT_CONFIG_SYS_TEXT_BASE
	default 0x00000000

config UBOOT_CONFIG_BOARD_SPECIFIC_OPTIONS # dummy
	def_bool y
	select UBOOT_CONFIG_CMD_QFW
	select UBOOT_CONFIG_QFW_MMIO
	imply VIRTIO_MMIO
	imply VIRTIO_PCI
	imply VIRTIO_NET
	imply VIRTIO_BLK

endif

if UBOOT_CONFIG_TARGET_QEMU_ARM_64BIT && !UBOOT_CONFIG_TFABOOT
config UBOOT_CONFIG_BOARD_SPECIFIC_OPTIONS
	imply SYS_MTDPARTS_RUNTIME
	imply SET_DFU_ALT_INFO

source "../../../board/emulation/common/Kconfig"
endif
```

## open_uboot/config/board/emulation/qemu-ppce500/Kconfig
```kconfig
if UBOOT_CONFIG_TARGET_QEMU_PPCE500

config UBOOT_CONFIG_SYS_BOARD
	default "qemu-ppce500"

config UBOOT_CONFIG_SYS_VENDOR
	default "emulation"

config UBOOT_CONFIG_SYS_CONFIG_NAME
	default "qemu-ppce500"

config UBOOT_CONFIG_PLATFORM_BUS_MAP_ADDR
	hex
	default 0xf0000000
	help
	  The QEMU platform bus base mapped address in the virtual memory space.

endif
```

## open_uboot/config/board/emulation/qemu-x86/Kconfig
```kconfig
if UBOOT_CONFIG_TARGET_QEMU_X86 || UBOOT_CONFIG_TARGET_QEMU_X86_64

config UBOOT_CONFIG_SYS_BOARD
	default "qemu-x86"

config UBOOT_CONFIG_SYS_VENDOR
	default "emulation"

config UBOOT_CONFIG_SYS_SOC
	default "qemu"

config UBOOT_CONFIG_SYS_CONFIG_NAME
	default "qemu-x86"

config UBOOT_CONFIG_SYS_TEXT_BASE
	default 0xfff00000 if ! UBOOT_CONFIG_SUPPORT_SPL
	default 0x01110000 if UBOOT_CONFIG_SUPPORT_SPL

config UBOOT_CONFIG_BOARD_SPECIFIC_OPTIONS # dummy
	def_bool y
	select UBOOT_CONFIG_X86_RESET_VECTOR
	select UBOOT_CONFIG_QEMU
	select UBOOT_CONFIG_QFW_PIO
	select UBOOT_CONFIG_BOARD_ROMSIZE_KB_1024
	imply VIRTIO_PCI
	imply VIRTIO_NET
	imply VIRTIO_BLK

endif
```

## open_uboot/config/board/engicam/common/Kconfig
```kconfig
config UBOOT_CONFIG_IMX6_ENGICAM_COMMON
	bool "Engicam i.MX6 Common code"
	depends on UBOOT_CONFIG_SPL && UBOOT_CONFIG_MX6
	default y if UBOOT_CONFIG_TARGET_MX6Q_ENGICAM || UBOOT_CONFIG_TARGET_MX6UL_ENGICAM
	help
	  Common SPL and U-Boot proper code for Engicam i.MX6 targets.

	  Enable it in board Kconfig if it uses i.MX6 variant Engicam boards.
```

## open_uboot/config/board/engicam/imx6q/Kconfig
```kconfig
if UBOOT_CONFIG_TARGET_MX6Q_ENGICAM

config UBOOT_CONFIG_SYS_BOARD
	default "imx6q"

config UBOOT_CONFIG_SYS_VENDOR
	default "engicam"

config UBOOT_CONFIG_SYS_CONFIG_NAME
	default "imx6-engicam"

source "../../../board/engicam/common/Kconfig"

endif
```

## open_uboot/config/board/engicam/imx6ul/Kconfig
```kconfig
if UBOOT_CONFIG_TARGET_MX6UL_ENGICAM

config UBOOT_CONFIG_SYS_BOARD
	default "imx6ul"

config UBOOT_CONFIG_SYS_VENDOR
	default "engicam"

config UBOOT_CONFIG_SYS_CONFIG_NAME
	default "imx6-engicam"

source "../../../board/engicam/common/Kconfig"

endif
```

## open_uboot/config/board/engicam/px30_core/Kconfig
```kconfig
if UBOOT_CONFIG_TARGET_PX30_CORE

config UBOOT_CONFIG_SYS_BOARD
	default "px30_core"

config UBOOT_CONFIG_SYS_VENDOR
	default "engicam"

config UBOOT_CONFIG_SYS_CONFIG_NAME
	default "px30_core"

config UBOOT_CONFIG_BOARD_SPECIFIC_OPTIONS # dummy
	def_bool y
	select UBOOT_CONFIG_RAM_PX30_DDR4 

endif
```

## open_uboot/config/board/engicam/stm32mp1/Kconfig
```kconfig
if UBOOT_CONFIG_TARGET_ICORE_STM32MP1 || UBOOT_CONFIG_TARGET_MICROGEA_STM32MP1

config UBOOT_CONFIG_SYS_BOARD
	default "stm32mp1"

config UBOOT_CONFIG_SYS_VENDOR
	default "engicam"

config UBOOT_CONFIG_SYS_CONFIG_NAME
	default "stm32mp15_common"

endif
```

## open_uboot/config/board/esd/meesc/Kconfig
```kconfig
if UBOOT_CONFIG_TARGET_MEESC

config UBOOT_CONFIG_SYS_BOARD
	default "meesc"

config UBOOT_CONFIG_SYS_VENDOR
	default "esd"

config UBOOT_CONFIG_SYS_CONFIG_NAME
	default "meesc"

endif
```

## open_uboot/config/board/firefly/firefly-rk3288/Kconfig
```kconfig
if UBOOT_CONFIG_TARGET_FIREFLY_RK3288

config UBOOT_CONFIG_SYS_BOARD
	default "firefly-rk3288"

config UBOOT_CONFIG_SYS_VENDOR
	default "firefly"

config UBOOT_CONFIG_SYS_CONFIG_NAME
	default "firefly-rk3288"

config UBOOT_CONFIG_BOARD_SPECIFIC_OPTIONS # dummy
	def_bool y

endif
```
