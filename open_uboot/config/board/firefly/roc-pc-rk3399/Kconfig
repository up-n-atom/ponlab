## open_uboot/config/board/firefly/roc-pc-rk3399/Kconfig
```kconfig
if UBOOT_CONFIG_TARGET_ROC_PC_RK3399

config UBOOT_CONFIG_SYS_BOARD
        default "roc-pc-rk3399"

config UBOOT_CONFIG_SYS_VENDOR
        default "firefly"

config UBOOT_CONFIG_SYS_CONFIG_NAME
        default "roc-pc-rk3399"

config UBOOT_CONFIG_BOARD_SPECIFIC_OPTIONS # dummy
        def_bool y

endif
```

## open_uboot/config/board/freescale/corenet_ds/Kconfig
```kconfig
if UBOOT_CONFIG_TARGET_P3041DS

config UBOOT_CONFIG_SYS_BOARD
	default "corenet_ds"

config UBOOT_CONFIG_SYS_VENDOR
	default "freescale"

config UBOOT_CONFIG_SYS_CONFIG_NAME
	default "P3041DS"

source "../../../board/freescale/common/Kconfig"

endif

if UBOOT_CONFIG_TARGET_P4080DS

config UBOOT_CONFIG_SYS_BOARD
	default "corenet_ds"

config UBOOT_CONFIG_SYS_VENDOR
	default "freescale"

config UBOOT_CONFIG_SYS_CONFIG_NAME
	default "P4080DS"

source "../../../board/freescale/common/Kconfig"

endif

if UBOOT_CONFIG_TARGET_P5040DS

config UBOOT_CONFIG_SYS_BOARD
	default "corenet_ds"

config UBOOT_CONFIG_SYS_VENDOR
	default "freescale"

config UBOOT_CONFIG_SYS_CONFIG_NAME
	default "P5040DS"

source "../../../board/freescale/common/Kconfig"

endif
```

## open_uboot/config/board/freescale/imx8mm_evk/Kconfig
```kconfig
if UBOOT_CONFIG_TARGET_IMX8MM_EVK

config UBOOT_CONFIG_SYS_BOARD
	default "imx8mm_evk"

config UBOOT_CONFIG_SYS_VENDOR
	default "freescale"

config UBOOT_CONFIG_SYS_CONFIG_NAME
	default "imx8mm_evk"

config UBOOT_CONFIG_IMX_CONFIG
	default "board/freescale/imx8mm_evk/imximage-8mm-lpddr4.cfg"

endif
```

## open_uboot/config/board/freescale/imx8mn_evk/Kconfig
```kconfig
if UBOOT_CONFIG_TARGET_IMX8MN_EVK || UBOOT_CONFIG_TARGET_IMX8MN_DDR4_EVK

config UBOOT_CONFIG_SYS_BOARD
	default "imx8mn_evk"

config UBOOT_CONFIG_SYS_VENDOR
	default "freescale"

config UBOOT_CONFIG_SYS_CONFIG_NAME
	default "imx8mn_evk"

config UBOOT_CONFIG_IMX8MN_LOW_DRIVE_MODE
	bool "Enable the low drive mode of iMX8MN on EVK board"

config UBOOT_CONFIG_IMX_CONFIG
	default "board/freescale/imx8mn_evk/imximage-8mn-ddr4.cfg"

source "../../../board/freescale/common/Kconfig"

endif
```

## open_uboot/config/board/freescale/imx8qm_mek/Kconfig
```kconfig
if UBOOT_CONFIG_TARGET_IMX8QM_MEK

config UBOOT_CONFIG_SYS_BOARD
	default "imx8qm_mek"

config UBOOT_CONFIG_SYS_VENDOR
	default "freescale"

config UBOOT_CONFIG_SYS_CONFIG_NAME
	default "imx8qm_mek"

config UBOOT_CONFIG_IMX_CONFIG
	default "board/freescale/imx8qm_mek/imximage.cfg"

source "../../../board/freescale/common/Kconfig"

endif
```

## open_uboot/config/board/freescale/imxrt1020-evk/Kconfig
```kconfig
if UBOOT_CONFIG_TARGET_IMXRT1020_EVK

config UBOOT_CONFIG_SYS_BOARD
	string
	default "imxrt1020-evk"

config UBOOT_CONFIG_SYS_VENDOR
	string
	default "freescale"

config UBOOT_CONFIG_SYS_SOC
	string
	default "imxrt1020"

config UBOOT_CONFIG_SYS_CONFIG_NAME
	string
	default "imxrt1020-evk"

config UBOOT_CONFIG_IMX_CONFIG
	default "board/freescale/imxrt1020-evk/imximage.cfg"

endif
```

## open_uboot/config/board/freescale/ls1021aqds/Kconfig
```kconfig
if UBOOT_CONFIG_TARGET_LS1021AQDS

config UBOOT_CONFIG_SYS_BOARD
	default "ls1021aqds"

config UBOOT_CONFIG_SYS_VENDOR
	default "freescale"

config UBOOT_CONFIG_SYS_SOC
	default "ls102xa"

config UBOOT_CONFIG_SYS_CONFIG_NAME
	default "ls1021aqds"

source "../../../board/freescale/common/Kconfig"

endif
```

## open_uboot/config/board/freescale/ls1021atsn/Kconfig
```kconfig
# SPDX-License-Identifier: GPL-2.0
if UBOOT_CONFIG_TARGET_LS1021ATSN

config UBOOT_CONFIG_SYS_BOARD
	default "ls1021atsn"

config UBOOT_CONFIG_SYS_VENDOR
	default "freescale"

config UBOOT_CONFIG_SYS_SOC
	default "ls102xa"

config UBOOT_CONFIG_SYS_CONFIG_NAME
	default "ls1021atsn"

source "../../../board/freescale/common/Kconfig"

endif
```

## open_uboot/config/board/freescale/ls1046ardb/Kconfig
```kconfig
if UBOOT_CONFIG_TARGET_LS1046ARDB

config UBOOT_CONFIG_SYS_BOARD
	default "ls1046ardb"

config UBOOT_CONFIG_SYS_VENDOR
	default "freescale"

config UBOOT_CONFIG_SYS_SOC
	default "fsl-layerscape"

config UBOOT_CONFIG_SYS_CONFIG_NAME
	default "ls1046ardb"

if UBOOT_CONFIG_FSL_LS_PPA
config UBOOT_CONFIG_SYS_LS_PPA_FW_ADDR
	hex "PPA Firmware Addr"
	default 0x40400000 if UBOOT_CONFIG_SYS_LS_PPA_FW_IN_XIP && UBOOT_CONFIG_QSPI_BOOT
	default 0x400000 if UBOOT_CONFIG_SYS_LS_PPA_FW_IN_MMC || UBOOT_CONFIG_SYS_LS_PPA_FW_IN_NAND

if UBOOT_CONFIG_CHAIN_OF_TRUST
config UBOOT_CONFIG_SYS_LS_PPA_ESBC_ADDR
	hex "PPA Firmware HDR Addr"
	default 0x40680000 if UBOOT_CONFIG_SYS_LS_PPA_FW_IN_XIP && UBOOT_CONFIG_QSPI_BOOT
	default 0x680000 if UBOOT_CONFIG_SYS_LS_PPA_FW_IN_MMC || UBOOT_CONFIG_SYS_LS_PPA_FW_IN_NAND
endif
endif

source "../../../board/freescale/common/Kconfig"
endif
```

## open_uboot/config/board/freescale/ls2080ardb/Kconfig
```kconfig
if UBOOT_CONFIG_TARGET_LS2080ARDB || UBOOT_CONFIG_TARGET_LS2081ARDB

config UBOOT_CONFIG_SYS_BOARD
	default "ls2080ardb"

config UBOOT_CONFIG_SYS_VENDOR
	default "freescale"

config UBOOT_CONFIG_SYS_SOC
	default "fsl-layerscape"

config UBOOT_CONFIG_SYS_CONFIG_NAME
	default "ls2080ardb"

source "../../../board/freescale/common/Kconfig"

if UBOOT_CONFIG_FSL_LS_PPA
config UBOOT_CONFIG_SYS_LS_PPA_FW_ADDR
	hex "PPA Firmware Addr"
	default 0x20400000 if UBOOT_CONFIG_SYS_LS_PPA_FW_IN_XIP && UBOOT_CONFIG_QSPI_BOOT
	default 0x580400000 if UBOOT_CONFIG_SYS_LS_PPA_FW_IN_XIP
	default 0x400000 if UBOOT_CONFIG_SYS_LS_PPA_FW_IN_MMC || UBOOT_CONFIG_SYS_LS_PPA_FW_IN_NAND

if UBOOT_CONFIG_CHAIN_OF_TRUST
config UBOOT_CONFIG_SYS_LS_PPA_ESBC_ADDR
	hex "PPA Firmware HDR Addr"
	default 0x20680000 if UBOOT_CONFIG_SYS_LS_PPA_FW_IN_XIP && UBOOT_CONFIG_QSPI_BOOT
	default 0x580680000 if UBOOT_CONFIG_SYS_LS_PPA_FW_IN_XIP
	default 0x680000 if UBOOT_CONFIG_SYS_LS_PPA_FW_IN_MMC || UBOOT_CONFIG_SYS_LS_PPA_FW_IN_NAND
endif
endif

source "../../../board/freescale/common/Kconfig"

endif
```

## open_uboot/config/board/freescale/m5253demo/Kconfig
```kconfig
if UBOOT_CONFIG_TARGET_M5253DEMO

config UBOOT_CONFIG_SYS_CPU
	default "mcf52x2"

config UBOOT_CONFIG_SYS_BOARD
	default "m5253demo"

config UBOOT_CONFIG_SYS_VENDOR
	default "freescale"

config UBOOT_CONFIG_SYS_CONFIG_NAME
	default "M5253DEMO"

endif
```

## open_uboot/config/board/freescale/m5373evb/Kconfig
```kconfig
if UBOOT_CONFIG_TARGET_M5373EVB

config UBOOT_CONFIG_SYS_CPU
	default "mcf532x"

config UBOOT_CONFIG_SYS_BOARD
	default "m5373evb"

config UBOOT_CONFIG_SYS_VENDOR
	default "freescale"

config UBOOT_CONFIG_SYS_CONFIG_NAME
	default "M5373EVB"

endif
```

## open_uboot/config/board/freescale/mpc837xerdb/Kconfig
```kconfig
if UBOOT_CONFIG_TARGET_MPC837XERDB

config UBOOT_CONFIG_SYS_BOARD
	default "mpc837xerdb"

config UBOOT_CONFIG_SYS_VENDOR
	default "freescale"

config UBOOT_CONFIG_SYS_CONFIG_NAME
	default "MPC837XERDB"

endif
```

## open_uboot/config/board/freescale/mpc8548cds/Kconfig
```kconfig
if UBOOT_CONFIG_TARGET_MPC8548CDS

config UBOOT_CONFIG_SYS_BOARD
	default "mpc8548cds"

config UBOOT_CONFIG_SYS_VENDOR
	default "freescale"

config UBOOT_CONFIG_SYS_CONFIG_NAME
	default "MPC8548CDS"

endif
```

## open_uboot/config/board/freescale/mx51evk/Kconfig
```kconfig
if UBOOT_CONFIG_TARGET_MX51EVK

config UBOOT_CONFIG_SYS_BOARD
	default "mx51evk"

config UBOOT_CONFIG_SYS_VENDOR
	default "freescale"

config UBOOT_CONFIG_SYS_SOC
	default "mx5"

config UBOOT_CONFIG_SYS_CONFIG_NAME
	default "mx51evk"

config UBOOT_CONFIG_IMX_CONFIG
	default "board/freescale/mx51evk/imximage.cfg"

endif
```

## open_uboot/config/board/freescale/mx6sabreauto/Kconfig
```kconfig
if UBOOT_CONFIG_TARGET_MX6SABREAUTO

config UBOOT_CONFIG_SYS_BOARD
	default "mx6sabreauto"

config UBOOT_CONFIG_SYS_VENDOR
	default "freescale"

config UBOOT_CONFIG_SYS_CONFIG_NAME
	default "mx6sabreauto"

endif
```

## open_uboot/config/board/freescale/mx6slevk/Kconfig
```kconfig
if UBOOT_CONFIG_TARGET_MX6SLEVK

config UBOOT_CONFIG_SYS_BOARD
	default "mx6slevk"

config UBOOT_CONFIG_SYS_VENDOR
	default "freescale"

config UBOOT_CONFIG_SYS_CONFIG_NAME
	default "mx6slevk"

config UBOOT_CONFIG_IMX_CONFIG
	default "board/freescale/mx6slevk/imximage.cfg"

endif
```

## open_uboot/config/board/freescale/mx6sllevk/Kconfig
```kconfig
if UBOOT_CONFIG_TARGET_MX6SLLEVK

config UBOOT_CONFIG_SYS_BOARD
	default "mx6sllevk"

config UBOOT_CONFIG_SYS_VENDOR
	default "freescale"

config UBOOT_CONFIG_SYS_CONFIG_NAME
	default "mx6sllevk"

config UBOOT_CONFIG_IMX_CONFIG
	default "board/freescale/mx6sllevk/imximage.cfg"

endif
```

## open_uboot/config/board/freescale/mx6sxsabreauto/Kconfig
```kconfig
if UBOOT_CONFIG_TARGET_MX6SXSABREAUTO

config UBOOT_CONFIG_SYS_BOARD
	default "mx6sxsabreauto"

config UBOOT_CONFIG_SYS_VENDOR
	default "freescale"

config UBOOT_CONFIG_SYS_CONFIG_NAME
	default "mx6sxsabreauto"

config UBOOT_CONFIG_IMX_CONFIG
	default "board/freescale/mx6sxsabreauto/imximage.cfg"

endif
```

## open_uboot/config/board/freescale/mx6sxsabresd/Kconfig
```kconfig
if UBOOT_CONFIG_TARGET_MX6SXSABRESD

config UBOOT_CONFIG_SYS_BOARD
	default "mx6sxsabresd"

config UBOOT_CONFIG_SYS_VENDOR
	default "freescale"

config UBOOT_CONFIG_SYS_CONFIG_NAME
	default "mx6sxsabresd"

config UBOOT_CONFIG_IMX_CONFIG
	default "board/freescale/mx6sxsabresd/imximage.cfg"

endif
```

## open_uboot/config/board/freescale/mx6ul_14x14_evk/Kconfig
```kconfig
if UBOOT_CONFIG_TARGET_MX6UL_14X14_EVK || UBOOT_CONFIG_TARGET_MX6UL_9X9_EVK

config UBOOT_CONFIG_SYS_BOARD
	default "mx6ul_14x14_evk"

config UBOOT_CONFIG_SYS_VENDOR
	default "freescale"

config UBOOT_CONFIG_SYS_CONFIG_NAME
	default "mx6ul_14x14_evk"

endif
```

## open_uboot/config/board/freescale/mx6ullevk/Kconfig
```kconfig
if UBOOT_CONFIG_TARGET_MX6ULL_14X14_EVK

config UBOOT_CONFIG_SYS_BOARD
	default "mx6ullevk"

config UBOOT_CONFIG_SYS_VENDOR
	default "freescale"

config UBOOT_CONFIG_SYS_CONFIG_NAME
	default "mx6ullevk"

config UBOOT_CONFIG_IMX_CONFIG
	default "board/freescale/mx6ullevk/imximage.cfg"

endif
```

## open_uboot/config/board/freescale/mx7ulp_evk/Kconfig
```kconfig
if UBOOT_CONFIG_TARGET_MX7ULP_EVK

config UBOOT_CONFIG_SYS_BOARD
	default "mx7ulp_evk"

config UBOOT_CONFIG_SYS_VENDOR
	default "freescale"

config UBOOT_CONFIG_SYS_CONFIG_NAME
	default "mx7ulp_evk"

config UBOOT_CONFIG_IMX_CONFIG
	default "board/freescale/mx7ulp_evk/imximage.cfg"

endif
```

## open_uboot/config/board/freescale/p1010rdb/Kconfig
```kconfig
if UBOOT_CONFIG_TARGET_P1010RDB_PA || UBOOT_CONFIG_TARGET_P1010RDB_PB

config UBOOT_CONFIG_SYS_BOARD
	default "p1010rdb"

config UBOOT_CONFIG_SYS_VENDOR
	default "freescale"

config UBOOT_CONFIG_SYS_CONFIG_NAME
	default "P1010RDB"

source "../../../board/freescale/common/Kconfig"

endif
```

## open_uboot/config/board/freescale/p2041rdb/Kconfig
```kconfig
if UBOOT_CONFIG_TARGET_P2041RDB

config UBOOT_CONFIG_SYS_BOARD
	default "p2041rdb"

config UBOOT_CONFIG_SYS_VENDOR
	default "freescale"

config UBOOT_CONFIG_SYS_CONFIG_NAME
	default "P2041RDB"

source "../../../board/freescale/common/Kconfig"

endif
```
