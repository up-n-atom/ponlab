## open_uboot/config/board/synopsys/iot_devkit/Kconfig
```kconfig
if UBOOT_CONFIG_TARGET_IOT_DEVKIT

config UBOOT_CONFIG_SYS_BOARD
	default "iot_devkit"

config UBOOT_CONFIG_SYS_VENDOR
	default "synopsys"

config UBOOT_CONFIG_SYS_CONFIG_NAME
	default "iot_devkit"

endif
```

## open_uboot/config/board/tbs/tbs2910/Kconfig
```kconfig
if UBOOT_CONFIG_TARGET_TBS2910

config UBOOT_CONFIG_SYS_BOARD
	default "tbs2910"

config UBOOT_CONFIG_SYS_VENDOR
	default "tbs"

config UBOOT_CONFIG_SYS_CONFIG_NAME
	default "tbs2910"

config UBOOT_CONFIG_IMX_CONFIG
	default "board/tbs/tbs2910/tbs2910.cfg"

endif
```

## open_uboot/config/board/tcl/sl50/Kconfig
```kconfig
if UBOOT_CONFIG_TARGET_AM335X_SL50

config UBOOT_CONFIG_SYS_BOARD
	default "sl50"

config UBOOT_CONFIG_SYS_VENDOR
	default "tcl"

config UBOOT_CONFIG_SYS_SOC
	default "am33xx"

config UBOOT_CONFIG_SYS_CONFIG_NAME
	default "am335x_sl50"

endif
```

## open_uboot/config/board/technexion/pico-imx6/Kconfig
```kconfig
if UBOOT_CONFIG_TARGET_PICO_IMX6

config UBOOT_CONFIG_SYS_BOARD
	default "pico-imx6"

config UBOOT_CONFIG_SYS_VENDOR
	default "technexion"

config UBOOT_CONFIG_SYS_SOC
	default "mx6"

config UBOOT_CONFIG_SYS_CONFIG_NAME
	default "pico-imx6"

endif
```

## open_uboot/config/board/technexion/pico-imx6ul/Kconfig
```kconfig
if UBOOT_CONFIG_TARGET_PICO_IMX6UL

config UBOOT_CONFIG_SYS_BOARD
	default "pico-imx6ul"

config UBOOT_CONFIG_SYS_VENDOR
	default "technexion"

config UBOOT_CONFIG_SYS_SOC
	default "mx6"

config UBOOT_CONFIG_SYS_CONFIG_NAME
	default "pico-imx6ul"

endif
```

## open_uboot/config/board/technexion/pico-imx8mq/Kconfig
```kconfig
if UBOOT_CONFIG_TARGET_PICO_IMX8MQ

config UBOOT_CONFIG_SYS_BOARD
	default "pico-imx8mq"

config UBOOT_CONFIG_SYS_VENDOR
	default "technexion"

config UBOOT_CONFIG_SYS_CONFIG_NAME
	default "pico-imx8mq"

config UBOOT_CONFIG_IMX_CONFIG
	default "arch/arm/mach-imx/imx8m/imximage.cfg"

endif
```

## open_uboot/config/board/ti/am335x/Kconfig
```kconfig
if UBOOT_CONFIG_TARGET_AM335X_EVM

config UBOOT_CONFIG_SYS_BOARD
	default "am335x"

config UBOOT_CONFIG_SYS_VENDOR
	default "ti"

config UBOOT_CONFIG_SYS_SOC
	default "am33xx"

config UBOOT_CONFIG_SYS_CONFIG_NAME
	default "am335x_evm"

config UBOOT_CONFIG_NOR
	bool "Support for NOR flash"
	help
	  The AM335x SoC supports having a NOR flash connected to the GPMC.
	  In practice this is seen as a NOR flash module connected to the
	  "memory cape" for the BeagleBone family.

source "../../../board/ti/common/Kconfig"

endif
```

## open_uboot/config/board/ti/am43xx/Kconfig
```kconfig
if UBOOT_CONFIG_TARGET_AM43XX_EVM

config UBOOT_CONFIG_SYS_BOARD
	default "am43xx"

config UBOOT_CONFIG_SYS_VENDOR
	default "ti"

config UBOOT_CONFIG_SYS_SOC
	default "am33xx"

config UBOOT_CONFIG_SYS_CONFIG_NAME
	default "am43xx_evm"

source "../../../board/ti/common/Kconfig"

endif
```

## open_uboot/config/board/ti/beagle/Kconfig
```kconfig
if UBOOT_CONFIG_TARGET_OMAP3_BEAGLE

config UBOOT_CONFIG_SYS_BOARD
	default "beagle"

config UBOOT_CONFIG_SYS_VENDOR
	default "ti"

config UBOOT_CONFIG_SYS_CONFIG_NAME
	default "omap3_beagle"

endif
```

## open_uboot/config/board/ti/evm/Kconfig
```kconfig
if UBOOT_CONFIG_TARGET_OMAP3_EVM

config UBOOT_CONFIG_SYS_BOARD
	default "evm"

config UBOOT_CONFIG_SYS_VENDOR
	default "ti"

config UBOOT_CONFIG_SYS_CONFIG_NAME
	default "omap3_evm"

endif
```

## open_uboot/config/board/ti/ks2_evm/Kconfig
```kconfig
if UBOOT_CONFIG_TARGET_K2E_EVM

config UBOOT_CONFIG_SYS_BOARD
	default "ks2_evm"

config UBOOT_CONFIG_SYS_VENDOR
	default "ti"

config UBOOT_CONFIG_SYS_CONFIG_NAME
	default "k2e_evm"

endif

if UBOOT_CONFIG_TARGET_K2HK_EVM

config UBOOT_CONFIG_SYS_BOARD
	default "ks2_evm"

config UBOOT_CONFIG_SYS_VENDOR
	default "ti"

config UBOOT_CONFIG_SYS_CONFIG_NAME
	default "k2hk_evm"

endif

if UBOOT_CONFIG_TARGET_K2L_EVM

config UBOOT_CONFIG_SYS_BOARD
	default "ks2_evm"

config UBOOT_CONFIG_SYS_VENDOR
	default "ti"

config UBOOT_CONFIG_SYS_CONFIG_NAME
	default "k2l_evm"

endif

if UBOOT_CONFIG_TARGET_K2G_EVM

config UBOOT_CONFIG_SYS_BOARD
	default "ks2_evm"

config UBOOT_CONFIG_SYS_VENDOR
	default "ti"

config UBOOT_CONFIG_SYS_CONFIG_NAME
	default "k2g_evm"

endif

source "../../../board/ti/common/Kconfig"
```

## open_uboot/config/board/ti/omap5_uevm/Kconfig
```kconfig
if UBOOT_CONFIG_TARGET_OMAP5_UEVM

config UBOOT_CONFIG_SYS_BOARD
	default "omap5_uevm"

config UBOOT_CONFIG_SYS_VENDOR
	default "ti"

config UBOOT_CONFIG_SYS_CONFIG_NAME
	default "omap5_uevm"

endif
```

## open_uboot/config/board/ti/panda/Kconfig
```kconfig
if UBOOT_CONFIG_TARGET_OMAP4_PANDA

config UBOOT_CONFIG_SYS_BOARD
	default "panda"

config UBOOT_CONFIG_SYS_VENDOR
	default "ti"

config UBOOT_CONFIG_SYS_CONFIG_NAME
	default "omap4_panda"

endif
```

## open_uboot/config/board/ti/sdp4430/Kconfig
```kconfig
if UBOOT_CONFIG_TARGET_OMAP4_SDP4430

config UBOOT_CONFIG_SYS_BOARD
	default "sdp4430"

config UBOOT_CONFIG_SYS_VENDOR
	default "ti"

config UBOOT_CONFIG_SYS_CONFIG_NAME
	default "omap4_sdp4430"

config UBOOT_CONFIG_CMD_BAT
	bool "Enable board-specific battery command"

endif
```

## open_uboot/config/board/ti/ti816x/Kconfig
```kconfig
if UBOOT_CONFIG_TARGET_TI816X_EVM

config UBOOT_CONFIG_SYS_BOARD
	default "ti816x"

config UBOOT_CONFIG_SYS_VENDOR
	default "ti"

config UBOOT_CONFIG_SYS_SOC
	default "am33xx"

config UBOOT_CONFIG_SYS_CONFIG_NAME
	default "ti816x_evm"

endif
```

## open_uboot/config/board/timll/devkit3250/Kconfig
```kconfig
if UBOOT_CONFIG_TARGET_DEVKIT3250

config UBOOT_CONFIG_SYS_BOARD
	default "devkit3250"

config UBOOT_CONFIG_SYS_VENDOR
	default "timll"

config UBOOT_CONFIG_SYS_CONFIG_NAME
	default "devkit3250"

endif
```

## open_uboot/config/board/toradex/apalis-tk1/Kconfig
```kconfig
if UBOOT_CONFIG_TARGET_APALIS_TK1

config UBOOT_CONFIG_SYS_BOARD
	default "apalis-tk1"

config UBOOT_CONFIG_SYS_VENDOR
	default "toradex"

config UBOOT_CONFIG_SYS_CONFIG_NAME
	default "apalis-tk1"

config UBOOT_CONFIG_TDX_CFG_BLOCK
	default y

config UBOOT_CONFIG_TDX_HAVE_MMC
	default y

config UBOOT_CONFIG_TDX_CFG_BLOCK_DEV
	default "0"

config UBOOT_CONFIG_TDX_CFG_BLOCK_PART
	default "1"

# Toradex config block in eMMC, at the end of 1st "boot sector"
config UBOOT_CONFIG_TDX_CFG_BLOCK_OFFSET
	default "-512"

config UBOOT_CONFIG_APALIS_TK1_PCIE_EVALBOARD_INIT
	bool "Apalis Evaluation Board PCIe Initialisation"
	help
	  Bring up the Apalis PCIe port with the PCIe switch as found on the
	  Apalis Evaluation board. Note that by default the PCIe port is also
	  left disabled in the device tree which needs changing as well for this
	  to actually work.

source "../../../board/toradex/common/Kconfig"

endif
```

## open_uboot/config/board/toradex/colibri-imx6ull/Kconfig
```kconfig
if UBOOT_CONFIG_TARGET_COLIBRI_IMX6ULL

choice
	prompt "Colibri iMX6ULL variant"
	optional

config UBOOT_CONFIG_TARGET_COLIBRI_IMX6ULL_NAND
	bool "Support Colibri iMX6ULL 256MB / 512MB (raw NAND) modules"
	imply NAND_MXS
	help
	  Choose this option if you build for a Toradex Colibri iMX6ULL
	  256MB or 512MB module which do have raw NAND on-module.

config UBOOT_CONFIG_TARGET_COLIBRI_IMX6ULL_EMMC
	bool "Support Colibri iMX6ULL 1GB (eMMC) modules"
	help
	  Choose this option if you build for a Toradex Colibri iMX6ULL
	  1GB module which does have eMMC on-module.

endchoice

config UBOOT_CONFIG_SYS_BOARD
	default "colibri-imx6ull"

config UBOOT_CONFIG_SYS_VENDOR
	default "toradex"

config UBOOT_CONFIG_SYS_CONFIG_NAME
	default "colibri-imx6ull-tezi-recovery" if (!UBOOT_CONFIG_TARGET_COLIBRI_IMX6ULL_NAND && !UBOOT_CONFIG_TARGET_COLIBRI_IMX6ULL_EMMC)

config UBOOT_CONFIG_TDX_CFG_BLOCK
	default y

if UBOOT_CONFIG_TARGET_COLIBRI_IMX6ULL_NAND

config UBOOT_CONFIG_SYS_CONFIG_NAME
	default "colibri-imx6ull"

config UBOOT_CONFIG_TDX_HAVE_NAND
	default y

config UBOOT_CONFIG_TDX_CFG_BLOCK_OFFSET
	default "2048"

config UBOOT_CONFIG_TDX_CFG_BLOCK_OFFSET2
	default "133120"

endif

if UBOOT_CONFIG_TARGET_COLIBRI_IMX6ULL_EMMC

config UBOOT_CONFIG_SYS_CONFIG_NAME
	default "colibri-imx6ull"

config UBOOT_CONFIG_TDX_HAVE_MMC
	default y

config UBOOT_CONFIG_TDX_CFG_BLOCK_DEV
	default "0"

config UBOOT_CONFIG_TDX_CFG_BLOCK_PART
	default "1"

# Toradex config block in eMMC, at the end of 1st "boot sector"
config UBOOT_CONFIG_TDX_CFG_BLOCK_OFFSET
	default "-512"

endif

config UBOOT_CONFIG_TDX_CFG_BLOCK_2ND_ETHADDR
	default y

config UBOOT_CONFIG_IMX_CONFIG
	default "board/toradex/colibri-imx6ull/imximage.cfg"

source "../../../board/toradex/common/Kconfig"

endif
```

## open_uboot/config/board/toradex/colibri_imx6/Kconfig
```kconfig
if UBOOT_CONFIG_TARGET_COLIBRI_IMX6

config UBOOT_CONFIG_SYS_BOARD
	default "colibri_imx6"

config UBOOT_CONFIG_SYS_CONFIG_NAME
	default "colibri_imx6"

config UBOOT_CONFIG_SYS_CPU
	default "armv7"

config UBOOT_CONFIG_SYS_SOC
	default "mx6"

config UBOOT_CONFIG_SYS_VENDOR
	default "toradex"

config UBOOT_CONFIG_TDX_CFG_BLOCK
	default y

config UBOOT_CONFIG_TDX_HAVE_MMC
	default y

config UBOOT_CONFIG_TDX_CFG_BLOCK_DEV
	default "0"

config UBOOT_CONFIG_TDX_CFG_BLOCK_PART
	default "1"

# Toradex config block in eMMC, at the end of 1st "boot sector"
config UBOOT_CONFIG_TDX_CFG_BLOCK_OFFSET
	default "-512"

config UBOOT_CONFIG_TDX_CMD_IMX_MFGR
	bool "Enable factory testing commands for Toradex iMX 6 modules"
	help
	  This adds the commands
	    pf0100_otp_prog - Program the OTP fuses on the PMIC PF0100
	  If executed on already fused modules it doesn't change any fuse setting.
	default y

source "../../../board/toradex/common/Kconfig"

endif
```

## open_uboot/config/board/toradex/colibri_pxa270/Kconfig
```kconfig
if UBOOT_CONFIG_TARGET_COLIBRI_PXA270

config UBOOT_CONFIG_SYS_BOARD
	default "colibri_pxa270"

config UBOOT_CONFIG_SYS_VENDOR
	default "toradex"

config UBOOT_CONFIG_SYS_CONFIG_NAME
	default "colibri_pxa270"

config UBOOT_CONFIG_TDX_CFG_BLOCK
	default y

config UBOOT_CONFIG_TDX_HAVE_NOR
	default y

config UBOOT_CONFIG_TDX_CFG_BLOCK_OFFSET
	default "262144"

source "../../../board/toradex/common/Kconfig"

endif
```

## open_uboot/config/board/toradex/colibri_t20/Kconfig
```kconfig
if UBOOT_CONFIG_TARGET_COLIBRI_T20

config UBOOT_CONFIG_SYS_BOARD
	default "colibri_t20"

config UBOOT_CONFIG_SYS_VENDOR
	default "toradex"

config UBOOT_CONFIG_SYS_CONFIG_NAME
	default "colibri_t20"

config UBOOT_CONFIG_TDX_CFG_BLOCK
	default y

config UBOOT_CONFIG_TDX_HAVE_NAND
	default y

config UBOOT_CONFIG_TDX_CFG_BLOCK_OFFSET
	default "3145728"

source "../../../board/toradex/common/Kconfig"

endif
```

## open_uboot/config/board/toradex/colibri_t30/Kconfig
```kconfig
if UBOOT_CONFIG_TARGET_COLIBRI_T30

config UBOOT_CONFIG_SYS_BOARD
	default "colibri_t30"

config UBOOT_CONFIG_SYS_VENDOR
	default "toradex"

config UBOOT_CONFIG_SYS_CONFIG_NAME
	default "colibri_t30"

config UBOOT_CONFIG_TDX_CFG_BLOCK
	default y

config UBOOT_CONFIG_TDX_HAVE_MMC
	default y

config UBOOT_CONFIG_TDX_CFG_BLOCK_DEV
	default "0"

config UBOOT_CONFIG_TDX_CFG_BLOCK_PART
	default "1"

# Toradex config block in eMMC, at the end of 1st "boot sector"
config UBOOT_CONFIG_TDX_CFG_BLOCK_OFFSET
	default "-512"

source "../../../board/toradex/common/Kconfig"

endif
```

## open_uboot/config/board/toradex/colibri_vf/Kconfig
```kconfig
if UBOOT_CONFIG_TARGET_COLIBRI_VF

config UBOOT_CONFIG_SYS_BOARD
	default "colibri_vf"

config UBOOT_CONFIG_SYS_VENDOR
	default "toradex"

config UBOOT_CONFIG_SYS_CONFIG_NAME
	default "colibri_vf"

config UBOOT_CONFIG_TDX_CFG_BLOCK
	default y

config UBOOT_CONFIG_TDX_HAVE_NAND
	default y

config UBOOT_CONFIG_TDX_CFG_BLOCK_OFFSET
	default "2048"

config UBOOT_CONFIG_TDX_CFG_BLOCK_2ND_ETHADDR
	default y

config UBOOT_CONFIG_IMX_CONFIG
	default "board/toradex/colibri_vf/imximage.cfg"

source "../../../board/toradex/common/Kconfig"

endif
```

## open_uboot/config/board/toradex/verdin-imx8mm/Kconfig
```kconfig
if UBOOT_CONFIG_TARGET_VERDIN_IMX8MM

config UBOOT_CONFIG_SYS_BOARD
	default "verdin-imx8mm"

config UBOOT_CONFIG_SYS_VENDOR
	default "toradex"

config UBOOT_CONFIG_SYS_CONFIG_NAME
	default "verdin-imx8mm"

config UBOOT_CONFIG_TDX_CFG_BLOCK
	default y

config UBOOT_CONFIG_TDX_CFG_BLOCK_EXTRA
	default y

config UBOOT_CONFIG_TDX_HAVE_MMC
	default y

config UBOOT_CONFIG_TDX_HAVE_EEPROM_EXTRA
	default y

config UBOOT_CONFIG_TDX_CFG_BLOCK_DEV
	default "0"

config UBOOT_CONFIG_TDX_CFG_BLOCK_PART
	default "1"

# Toradex config block in eMMC, at the end of 1st "boot sector"
config UBOOT_CONFIG_TDX_CFG_BLOCK_OFFSET
	default "-512"

config UBOOT_CONFIG_IMX_CONFIG
	default "board/toradex/verdin-imx8mm/imximage.cfg"

source "../../../board/toradex/common/Kconfig"

endif
```

## open_uboot/config/board/tplink/wdr4300/Kconfig
```kconfig
if UBOOT_CONFIG_BOARD_TPLINK_WDR4300

config UBOOT_CONFIG_SYS_VENDOR
	default "tplink"

config UBOOT_CONFIG_SYS_SOC
	default "ath79"

config UBOOT_CONFIG_SYS_BOARD
	default "wdr4300"

config UBOOT_CONFIG_SYS_CONFIG_NAME
	default "tplink_wdr4300"

config UBOOT_CONFIG_SYS_TEXT_BASE
	default 0xa1000000

config UBOOT_CONFIG_SYS_DCACHE_SIZE
	default 32768

config UBOOT_CONFIG_SYS_DCACHE_LINE_SIZE
	default 32

config UBOOT_CONFIG_SYS_ICACHE_SIZE
	default 65536

config UBOOT_CONFIG_SYS_ICACHE_LINE_SIZE
	default 32

endif
```
