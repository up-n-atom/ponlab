## open_uboot/config/board/Marvell/sheevaplug/Kconfig
```kconfig
if UBOOT_CONFIG_TARGET_SHEEVAPLUG

config UBOOT_CONFIG_SYS_BOARD
	default "sheevaplug"

config UBOOT_CONFIG_SYS_VENDOR
	default "Marvell"

config UBOOT_CONFIG_SYS_CONFIG_NAME
	default "sheevaplug"

endif
```

## open_uboot/config/board/Seagate/dockstar/Kconfig
```kconfig
if UBOOT_CONFIG_TARGET_DOCKSTAR

config UBOOT_CONFIG_SYS_BOARD
	default "dockstar"

config UBOOT_CONFIG_SYS_VENDOR
	default "Seagate"

config UBOOT_CONFIG_SYS_CONFIG_NAME
	default "dockstar"

endif
```

## open_uboot/config/board/Synology/ds109/Kconfig
```kconfig
if UBOOT_CONFIG_TARGET_DS109

config UBOOT_CONFIG_SYS_BOARD
	default "ds109"

config UBOOT_CONFIG_SYS_VENDOR
	default "Synology"

config UBOOT_CONFIG_SYS_CONFIG_NAME
	default "ds109"

endif
```

## open_uboot/config/board/abilis/tb100/Kconfig
```kconfig
if UBOOT_CONFIG_TARGET_TB100

config UBOOT_CONFIG_SYS_CPU
	default "arc700"

config UBOOT_CONFIG_SYS_BOARD
	default "tb100"

config UBOOT_CONFIG_SYS_VENDOR
	default "abilis"

config UBOOT_CONFIG_SYS_CONFIG_NAME
	default "tb100"

endif
```

## open_uboot/config/board/advantech/imx8qm_rom7720_a1/Kconfig
```kconfig
if UBOOT_CONFIG_TARGET_IMX8QM_ROM7720_A1

config UBOOT_CONFIG_SYS_BOARD
	default "imx8qm_rom7720_a1"

config UBOOT_CONFIG_SYS_VENDOR
	default "advantech"

config UBOOT_CONFIG_SYS_CONFIG_NAME
	default "imx8qm_rom7720"

config UBOOT_CONFIG_IMX_CONFIG
	default "board/advantech/imx8qm_rom7720_a1/imximage.cfg"

source "../../../board/freescale/common/Kconfig"

endif
```

## open_uboot/config/board/advantech/som-db5800-som-6867/Kconfig
```kconfig
if UBOOT_CONFIG_TARGET_SOM_DB5800_SOM_6867

config UBOOT_CONFIG_SYS_BOARD
	default "som-db5800-som-6867"

config UBOOT_CONFIG_SYS_VENDOR
	default "advantech"

config UBOOT_CONFIG_SYS_SOC
	default "baytrail"

config UBOOT_CONFIG_SYS_CONFIG_NAME
	default "som-db5800-som-6867"

config UBOOT_CONFIG_SYS_TEXT_BASE
	default 0xfff00000

config UBOOT_CONFIG_BOARD_SPECIFIC_OPTIONS # dummy
	def_bool y
	select UBOOT_CONFIG_X86_RESET_VECTOR
	select UBOOT_CONFIG_INTEL_BAYTRAIL
	select UBOOT_CONFIG_BOARD_ROMSIZE_KB_8192
	select UBOOT_CONFIG_BOARD_EARLY_INIT_F
	select UBOOT_CONFIG_SPI_FLASH_MACRONIX

config UBOOT_CONFIG_PCIE_ECAM_BASE
	default 0xe0000000

endif
```

## open_uboot/config/board/altera/arria10-socdk/Kconfig
```kconfig
if UBOOT_CONFIG_TARGET_SOCFPGA_ARRIA10_SOCDK

config UBOOT_CONFIG_SYS_CPU
	default "armv7"

config UBOOT_CONFIG_SYS_BOARD
	default "socfpga_arria10"

config UBOOT_CONFIG_SYS_VENDOR
	default "altera"

config UBOOT_CONFIG_SYS_SOC
	default "socfpga_arria10"

config UBOOT_CONFIG_SYS_CONFIG_NAME
	default "socfpga_arria10"

endif
```

## open_uboot/config/board/amarula/vyasa-rk3288/Kconfig
```kconfig
if UBOOT_CONFIG_TARGET_VYASA_RK3288

config UBOOT_CONFIG_SYS_BOARD
	default "vyasa-rk3288"

config UBOOT_CONFIG_SYS_VENDOR
	default "amarula"

config UBOOT_CONFIG_SYS_CONFIG_NAME
	default "vyasa-rk3288"

endif
```

## open_uboot/config/board/armadeus/opos6uldev/Kconfig
```kconfig
if UBOOT_CONFIG_TARGET_OPOS6ULDEV

config UBOOT_CONFIG_SYS_BOARD
	default "opos6uldev"

config UBOOT_CONFIG_SYS_VENDOR
	default "armadeus"

config UBOOT_CONFIG_SYS_CONFIG_NAME
	default "opos6uldev"

endif
```

## open_uboot/config/board/armltd/total_compute/Kconfig
```kconfig
if UBOOT_CONFIG_TARGET_TOTAL_COMPUTE

config UBOOT_CONFIG_SYS_BOARD
	default "total_compute"

config UBOOT_CONFIG_SYS_VENDOR
	default "armltd"

config UBOOT_CONFIG_SYS_CONFIG_NAME
	default "total_compute"

endif
```

## open_uboot/config/board/aspeed/evb_ast2600/Kconfig
```kconfig
if UBOOT_CONFIG_TARGET_EVB_AST2600

config UBOOT_CONFIG_SYS_BOARD
	default "evb_ast2600"

config UBOOT_CONFIG_SYS_VENDOR
	default "aspeed"

config UBOOT_CONFIG_SYS_CONFIG_NAME
	default "evb_ast2600"

endif
```

## open_uboot/config/board/atmel/at91sam9261ek/Kconfig
```kconfig
if UBOOT_CONFIG_TARGET_AT91SAM9261EK

config UBOOT_CONFIG_SYS_BOARD
	default "at91sam9261ek"

config UBOOT_CONFIG_SYS_VENDOR
	default "atmel"

config UBOOT_CONFIG_SYS_CONFIG_NAME
	default "at91sam9261ek"

endif
```

## open_uboot/config/board/atmel/at91sam9rlek/Kconfig
```kconfig
if UBOOT_CONFIG_TARGET_AT91SAM9RLEK

config UBOOT_CONFIG_SYS_BOARD
	default "at91sam9rlek"

config UBOOT_CONFIG_SYS_VENDOR
	default "atmel"

config UBOOT_CONFIG_SYS_CONFIG_NAME
	default "at91sam9rlek"

endif
```

## open_uboot/config/board/atmel/sam9x60ek/Kconfig
```kconfig
if UBOOT_CONFIG_TARGET_SAM9X60EK

config UBOOT_CONFIG_SYS_BOARD
	default "sam9x60ek"

config UBOOT_CONFIG_SYS_VENDOR
	default "atmel"

config UBOOT_CONFIG_SYS_CONFIG_NAME
	default "sam9x60ek"

endif
```

## open_uboot/config/board/atmel/sama5d27_som1_ek/Kconfig
```kconfig
if UBOOT_CONFIG_TARGET_SAMA5D27_SOM1_EK

config UBOOT_CONFIG_SYS_BOARD
	default "sama5d27_som1_ek"

config UBOOT_CONFIG_SYS_VENDOR
	default "atmel"

config UBOOT_CONFIG_SYS_SOC
	default "at91"

config UBOOT_CONFIG_SYS_CONFIG_NAME
	default "sama5d27_som1_ek"

endif
```

## open_uboot/config/board/atmel/sama5d27_wlsom1_ek/Kconfig
```kconfig
if UBOOT_CONFIG_TARGET_SAMA5D27_WLSOM1_EK

config UBOOT_CONFIG_SYS_BOARD
	default "sama5d27_wlsom1_ek"

config UBOOT_CONFIG_SYS_VENDOR
	default "atmel"

config UBOOT_CONFIG_SYS_SOC
	default "at91"

config UBOOT_CONFIG_SYS_CONFIG_NAME
	default "sama5d27_wlsom1_ek"

endif
```

## open_uboot/config/board/atmel/sama5d3xek/Kconfig
```kconfig
if UBOOT_CONFIG_TARGET_SAMA5D3XEK

config UBOOT_CONFIG_SYS_BOARD
	default "sama5d3xek"

config UBOOT_CONFIG_SYS_VENDOR
	default "atmel"

config UBOOT_CONFIG_SYS_CONFIG_NAME
	default "sama5d3xek"

endif
```

## open_uboot/config/board/atmel/sama5d4ek/Kconfig
```kconfig
if UBOOT_CONFIG_TARGET_SAMA5D4EK

config UBOOT_CONFIG_SYS_BOARD
	default "sama5d4ek"

config UBOOT_CONFIG_SYS_VENDOR
	default "atmel"

config UBOOT_CONFIG_SYS_CONFIG_NAME
	default "sama5d4ek"

endif
```

## open_uboot/config/board/atmel/sama7g5ek/Kconfig
```kconfig
if UBOOT_CONFIG_TARGET_SAMA7G5EK

config UBOOT_CONFIG_SYS_BOARD
	default "sama7g5ek"

config UBOOT_CONFIG_SYS_VENDOR
	default "atmel"

config UBOOT_CONFIG_SYS_SOC
	default "at91"

config UBOOT_CONFIG_SYS_CONFIG_NAME
	default "sama7g5ek"

endif
```

## open_uboot/config/board/avionic-design/medcom-wide/Kconfig
```kconfig
if UBOOT_CONFIG_TARGET_MEDCOM_WIDE

config UBOOT_CONFIG_SYS_BOARD
	default "medcom-wide"

config UBOOT_CONFIG_SYS_VENDOR
	default "avionic-design"

config UBOOT_CONFIG_SYS_CONFIG_NAME
	default "medcom-wide"

endif
```

## open_uboot/config/board/avionic-design/plutux/Kconfig
```kconfig
if UBOOT_CONFIG_TARGET_PLUTUX

config UBOOT_CONFIG_SYS_BOARD
	default "plutux"

config UBOOT_CONFIG_SYS_VENDOR
	default "avionic-design"

config UBOOT_CONFIG_SYS_CONFIG_NAME
	default "plutux"

endif
```

## open_uboot/config/board/avionic-design/tec/Kconfig
```kconfig
if UBOOT_CONFIG_TARGET_TEC

config UBOOT_CONFIG_SYS_BOARD
	default "tec"

config UBOOT_CONFIG_SYS_VENDOR
	default "avionic-design"

config UBOOT_CONFIG_SYS_CONFIG_NAME
	default "tec"

endif
```

## open_uboot/config/board/beacon/beacon-rzg2m/Kconfig
```kconfig
if UBOOT_CONFIG_TARGET_BEACON_RZG2M

config UBOOT_CONFIG_SYS_SOC
	default "rmobile"

config UBOOT_CONFIG_SYS_BOARD
	default "beacon-rzg2m"

config UBOOT_CONFIG_SYS_VENDOR
	default "beacon"

config UBOOT_CONFIG_SYS_CONFIG_NAME
	default "beacon-rzg2m"

endif
```

## open_uboot/config/board/broadcom/bcm963158/Kconfig
```kconfig
if UBOOT_CONFIG_TARGET_BCM963158

config UBOOT_CONFIG_SYS_VENDOR
	default "broadcom"

config UBOOT_CONFIG_SYS_BOARD
	default "bcm963158"

config UBOOT_CONFIG_SYS_CONFIG_NAME
	default "broadcom_bcm963158"

endif

config UBOOT_CONFIG_TARGET_BCM963158
	bool "Support Broadcom bcm963158"
	depends on UBOOT_CONFIG_ARCH_BCM63158
	select UBOOT_CONFIG_ARM64
```

## open_uboot/config/board/broadcom/bcm968360bg/Kconfig
```kconfig
if UBOOT_CONFIG_ARCH_BCM68360

config UBOOT_CONFIG_SYS_VENDOR
	default "broadcom"

config UBOOT_CONFIG_SYS_BOARD
	default "bcm968360bg"

config UBOOT_CONFIG_SYS_CONFIG_NAME
	default "broadcom_bcm968360bg"

endif

config UBOOT_CONFIG_TARGET_BCM968360BG
	bool "Support Broadcom bcm968360bg"
	depends on UBOOT_CONFIG_ARCH_BCM68360
	select UBOOT_CONFIG_ARM64
```
