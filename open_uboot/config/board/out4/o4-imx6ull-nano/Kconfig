## open_uboot/config/board/out4/o4-imx6ull-nano/Kconfig
```kconfig
if UBOOT_CONFIG_TARGET_O4_IMX6ULL_NANO

config UBOOT_CONFIG_SYS_BOARD
	default "o4-imx6ull-nano"

config UBOOT_CONFIG_SYS_VENDOR
	default "out4"

config UBOOT_CONFIG_SYS_CONFIG_NAME
	default "o4-imx6ull-nano"

choice
	prompt "Memory model"
	default UBOOT_CONFIG_K4B4G1646D_BCMA
	help
	    Memory type setup.

	    Please choose correct memory model here.

config UBOOT_CONFIG_K4B4G1646D_BCMA
	bool "K4B4G1646D-BCMA 256Mx16 (512 MiB/chip)"
	help
	    Samsung DDR3 SDRAM
	    K4B4G1646D-BCMA

config UBOOT_CONFIG_MT41K256M16HA_125E
	bool "MT41K256M16HA-125:E 256Mx16 (512 MiB/chip)"
	help
	    Micron DDR3L SDRAM
	    MT41K256M16HA-125:E

endchoice

choice
	prompt "Mainboard model"
	default UBOOT_CONFIG_O4_IMX_NANO
	help
	    Mainboard setup.

	    Please choose correct main board model here.

config UBOOT_CONFIG_O4_IMX_NANO
	bool "O4-iMX-NANO"
	help
	    A baseboard for EV-iMX280-NANO module:
	    https://out4.ru/products/board/18-o4-imx-nano.html

config UBOOT_CONFIG_EV_IMX280_NANO_X_MB
	bool "EV-IMX280-NANO-X-MB"
	help
	    A simple baseboard for EV-iMX280-NANO module:
	    http://evodbg.net/products/mx28-eval-kits/14-ev-imx280-nano-x-mb.html

endchoice

config UBOOT_CONFIG_IMX_CONFIG
	default "board/out4/o4-imx6ull-nano/K4B4G1646D-BCMA.cfg" if UBOOT_CONFIG_K4B4G1646D_BCMA
	default "board/out4/o4-imx6ull-nano/MT41K256M16HA-125E.cfg" if UBOOT_CONFIG_MT41K256M16HA_125E

config UBOOT_CONFIG_DEFAULT_DEVICE_TREE
	default "o4-imx-nano" if UBOOT_CONFIG_O4_IMX_NANO
	default "ev-imx280-nano-x-mb" if UBOOT_CONFIG_EV_IMX280_NANO_X_MB

endif
```

## open_uboot/config/board/phytec/pcl063/Kconfig
```kconfig
if UBOOT_CONFIG_TARGET_PCL063

config UBOOT_CONFIG_SYS_BOARD
	default "pcl063"

config UBOOT_CONFIG_SYS_VENDOR
	default "phytec"

config UBOOT_CONFIG_SYS_CONFIG_NAME
	default "pcl063"

endif

if UBOOT_CONFIG_TARGET_PCL063_ULL

config UBOOT_CONFIG_SYS_BOARD
	default "pcl063"

config UBOOT_CONFIG_SYS_VENDOR
	default "phytec"

config UBOOT_CONFIG_SYS_CONFIG_NAME
	default "pcl063_ull"

endif
```

## open_uboot/config/board/phytec/pcm052/Kconfig
```kconfig
if UBOOT_CONFIG_TARGET_PCM052

config UBOOT_CONFIG_SYS_BOARD
	default "pcm052"

config UBOOT_CONFIG_SYS_VENDOR
	default "phytec"

config UBOOT_CONFIG_SYS_CONFIG_NAME
	default "pcm052"

config UBOOT_CONFIG_PCM052_DDR_SIZE
	int
	default 256

config UBOOT_CONFIG_IMX_CONFIG
	default "board/phytec/pcm052/imximage.cfg"

endif

if UBOOT_CONFIG_TARGET_BK4R1

config UBOOT_CONFIG_SYS_BOARD
	default "pcm052"

config UBOOT_CONFIG_SYS_VENDOR
	default "phytec"

config UBOOT_CONFIG_SYS_CONFIG_NAME
	default "bk4r1"

config UBOOT_CONFIG_PCM052_DDR_SIZE
	int
	default 512

config UBOOT_CONFIG_IMX_CONFIG
	default "board/phytec/pcm052/imximage.cfg"

endif
```

## open_uboot/config/board/phytec/pcm058/Kconfig
```kconfig
if UBOOT_CONFIG_TARGET_PCM058

config UBOOT_CONFIG_SYS_BOARD
	default "pcm058"

config UBOOT_CONFIG_SYS_VENDOR
	default "phytec"

config UBOOT_CONFIG_SYS_CONFIG_NAME
	default "pcm058"

endif
```

## open_uboot/config/board/phytec/phycore_am335x_r2/Kconfig
```kconfig
if UBOOT_CONFIG_TARGET_PHYCORE_AM335X_R2

config UBOOT_CONFIG_SYS_BOARD
	default "phycore_am335x_r2"

config UBOOT_CONFIG_SYS_VENDOR
	default "phytec"

config UBOOT_CONFIG_SYS_SOC
	default "am33xx"

config UBOOT_CONFIG_SYS_CONFIG_NAME
	default "phycore_am335x_r2"

endif
```

## open_uboot/config/board/phytium/durian/Kconfig
```kconfig
if UBOOT_CONFIG_TARGET_DURIAN

config UBOOT_CONFIG_SYS_BOARD
	default "durian"

config UBOOT_CONFIG_SYS_VENDOR
	default "phytium"

config UBOOT_CONFIG_SYS_CONFIG_NAME
	default "durian"

endif
```

## open_uboot/config/board/pine64/rockpro64_rk3399/Kconfig
```kconfig
if UBOOT_CONFIG_TARGET_ROCKPRO64_RK3399

config UBOOT_CONFIG_SYS_BOARD
	default "rockpro64_rk3399"

config UBOOT_CONFIG_SYS_VENDOR
	default "pine64"

config UBOOT_CONFIG_SYS_CONFIG_NAME
	default "rockpro64_rk3399"

config UBOOT_CONFIG_BOARD_SPECIFIC_OPTIONS # dummy
	def_bool y

endif
```

## open_uboot/config/board/qca/ap143/Kconfig
```kconfig
if UBOOT_CONFIG_TARGET_AP143

config UBOOT_CONFIG_SYS_VENDOR
	default "qca"

config UBOOT_CONFIG_SYS_BOARD
	default "ap143"

config UBOOT_CONFIG_SYS_CONFIG_NAME
	default "ap143"

config UBOOT_CONFIG_SYS_TEXT_BASE
	default 0x9f000000

config UBOOT_CONFIG_SYS_DCACHE_SIZE
	default 32768

config UBOOT_CONFIG_SYS_DCACHE_LINE_SIZE
	default 32

config UBOOT_CONFIG_SYS_ICACHE_SIZE
	default 65536

config UBOOT_CONFIG_SYS_ICACHE_LINE_SIZE
	default 32

endif
```

## open_uboot/config/board/qca/ap152/Kconfig
```kconfig
if UBOOT_CONFIG_TARGET_AP152

config UBOOT_CONFIG_SYS_VENDOR
	default "qca"

config UBOOT_CONFIG_SYS_BOARD
	default "ap152"

config UBOOT_CONFIG_SYS_CONFIG_NAME
	default "ap152"

config UBOOT_CONFIG_SYS_TEXT_BASE
	default 0x9f000000

endif
```

## open_uboot/config/board/qualcomm/dragonboard410c/Kconfig
```kconfig
if UBOOT_CONFIG_TARGET_DRAGONBOARD410C

config UBOOT_CONFIG_SYS_BOARD
	default "dragonboard410c"

config UBOOT_CONFIG_SYS_VENDOR
	default "qualcomm"

config UBOOT_CONFIG_SYS_SOC
	default "apq8016"

config UBOOT_CONFIG_SYS_CONFIG_NAME
	default "dragonboard410c"

endif
```

## open_uboot/config/board/qualcomm/dragonboard820c/Kconfig
```kconfig
if UBOOT_CONFIG_TARGET_DRAGONBOARD820C

config UBOOT_CONFIG_SYS_BOARD
	default "dragonboard820c"

config UBOOT_CONFIG_SYS_VENDOR
	default "qualcomm"

config UBOOT_CONFIG_SYS_SOC
	default "apq8096"

config UBOOT_CONFIG_SYS_CONFIG_NAME
	default "dragonboard820c"

endif
```

## open_uboot/config/board/raidsonic/ib62x0/Kconfig
```kconfig
if UBOOT_CONFIG_TARGET_IB62X0

config UBOOT_CONFIG_SYS_BOARD
	default "ib62x0"

config UBOOT_CONFIG_SYS_VENDOR
	default "raidsonic"

config UBOOT_CONFIG_SYS_CONFIG_NAME
	default "ib62x0"

endif
```

## open_uboot/config/board/raspberrypi/rpi/Kconfig
```kconfig
if UBOOT_CONFIG_SYS_BOARD = "rpi"

config UBOOT_CONFIG_RPI_EFI_NR_SPIN_PAGES
	int "Spin table page count"
	default 1
	help
	  Number of pages to reserve starting at page 0 for spin tables in the EFI
	  memory map

endif
```

## open_uboot/config/board/renesas/blanche/Kconfig
```kconfig
if UBOOT_CONFIG_TARGET_BLANCHE

config UBOOT_CONFIG_SYS_BOARD
	default "blanche"

config UBOOT_CONFIG_SYS_VENDOR
	default "renesas"

config UBOOT_CONFIG_SYS_CONFIG_NAME
	default "blanche"

endif
```

## open_uboot/config/board/renesas/condor/Kconfig
```kconfig
if UBOOT_CONFIG_TARGET_CONDOR

config UBOOT_CONFIG_SYS_SOC
	default "rmobile"

config UBOOT_CONFIG_SYS_BOARD
	default "condor"

config UBOOT_CONFIG_SYS_VENDOR
	default "renesas"

config UBOOT_CONFIG_SYS_CONFIG_NAME
	default "condor"

endif
```

## open_uboot/config/board/renesas/ebisu/Kconfig
```kconfig
if UBOOT_CONFIG_TARGET_EBISU

config UBOOT_CONFIG_SYS_SOC
	default "rmobile"

config UBOOT_CONFIG_SYS_BOARD
	default "ebisu"

config UBOOT_CONFIG_SYS_VENDOR
	default "renesas"

config UBOOT_CONFIG_SYS_CONFIG_NAME
	default "ebisu"

endif
```

## open_uboot/config/board/renesas/falcon/Kconfig
```kconfig
if UBOOT_CONFIG_TARGET_FALCON

config UBOOT_CONFIG_SYS_SOC
	default "rmobile"

config UBOOT_CONFIG_SYS_BOARD
	default "falcon"

config UBOOT_CONFIG_SYS_VENDOR
	default "renesas"

config UBOOT_CONFIG_SYS_CONFIG_NAME
	default "falcon"

endif
```

## open_uboot/config/board/renesas/grpeach/Kconfig
```kconfig
if UBOOT_CONFIG_TARGET_GRPEACH

config UBOOT_CONFIG_SYS_BOARD
	default "grpeach"

config UBOOT_CONFIG_SYS_VENDOR
	default "renesas"

config UBOOT_CONFIG_SYS_CONFIG_NAME
	default "grpeach"

endif
```

## open_uboot/config/board/renesas/koelsch/Kconfig
```kconfig
if UBOOT_CONFIG_TARGET_KOELSCH

config UBOOT_CONFIG_SYS_BOARD
	default "koelsch"

config UBOOT_CONFIG_SYS_VENDOR
	default "renesas"

config UBOOT_CONFIG_SYS_CONFIG_NAME
	default "koelsch"

endif
```

## open_uboot/config/board/renesas/porter/Kconfig
```kconfig
if UBOOT_CONFIG_TARGET_PORTER

config UBOOT_CONFIG_SYS_BOARD
	default "porter"

config UBOOT_CONFIG_SYS_VENDOR
	default "renesas"

config UBOOT_CONFIG_SYS_CONFIG_NAME
	default "porter"

endif
```

## open_uboot/config/board/renesas/salvator-x/Kconfig
```kconfig
if UBOOT_CONFIG_TARGET_SALVATOR_X

config UBOOT_CONFIG_SYS_SOC
	default "rmobile"

config UBOOT_CONFIG_SYS_BOARD
	default "salvator-x"

config UBOOT_CONFIG_SYS_VENDOR
	default "renesas"

config UBOOT_CONFIG_SYS_CONFIG_NAME
	default "salvator-x"

endif
```

## open_uboot/config/board/renesas/stout/Kconfig
```kconfig
if UBOOT_CONFIG_TARGET_STOUT

config UBOOT_CONFIG_SYS_BOARD
	default "stout"

config UBOOT_CONFIG_SYS_VENDOR
	default "renesas"

config UBOOT_CONFIG_SYS_CONFIG_NAME
	default "stout"

endif
```

## open_uboot/config/board/renesas/ulcb/Kconfig
```kconfig
if UBOOT_CONFIG_TARGET_ULCB

config UBOOT_CONFIG_SYS_SOC
	default "rmobile"

config UBOOT_CONFIG_SYS_BOARD
	default "ulcb"

config UBOOT_CONFIG_SYS_VENDOR
	default "renesas"

config UBOOT_CONFIG_SYS_CONFIG_NAME
	default "ulcb"

endif
```

## open_uboot/config/board/rockchip/kylin_rk3036/Kconfig
```kconfig
if UBOOT_CONFIG_TARGET_KYLIN_RK3036

config UBOOT_CONFIG_SYS_BOARD
	default "kylin_rk3036"

config UBOOT_CONFIG_SYS_VENDOR
	default "rockchip"

config UBOOT_CONFIG_SYS_CONFIG_NAME
	default "kylin_rk3036"

config UBOOT_CONFIG_BOARD_SPECIFIC_OPTIONS # dummy
	def_bool y

endif
```

## open_uboot/config/board/rockchip/sheep_rk3368/Kconfig
```kconfig
if UBOOT_CONFIG_TARGET_SHEEP

config UBOOT_CONFIG_SYS_BOARD
	default "sheep_rk3368"

config UBOOT_CONFIG_SYS_VENDOR
	default "rockchip"

config UBOOT_CONFIG_SYS_CONFIG_NAME
	default "sheep_rk3368"

config UBOOT_CONFIG_BOARD_SPECIFIC_OPTIONS # dummy
	def_bool y

endif
```
