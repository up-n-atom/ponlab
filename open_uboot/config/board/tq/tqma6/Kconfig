## open_uboot/config/drivers/hwspinlock/Kconfig
```kconfig
menu "Hardware Spinlock Support"

config UBOOT_CONFIG_DM_HWSPINLOCK
	bool "Enable U-Boot hardware spinlock support"
	help
	  This option enables U-Boot hardware spinlock support

config UBOOT_CONFIG_HWSPINLOCK_SANDBOX
	bool "Enable Hardware Spinlock support for Sandbox"
	depends on UBOOT_CONFIG_SANDBOX && UBOOT_CONFIG_DM_HWSPINLOCK
	help
	  Enable hardware spinlock support in Sandbox. This is a dummy device that
	  can be probed and support all the methods of HWSPINLOCK, but does not
	  really do anything.

config UBOOT_CONFIG_HWSPINLOCK_STM32
	bool "Enable Hardware Spinlock support for STM32"
	depends on UBOOT_CONFIG_ARCH_STM32MP && UBOOT_CONFIG_DM_HWSPINLOCK
	help
	  Enable hardware spinlock support in STM32MP. Hardware spinlocks are
	  hardware mutex which provide a synchronisation mechanism for the
	  various processors on the SoC.

endmenu
```

## open_uboot/config/drivers/iommu/Kconfig
```kconfig
#
# IOMMU devices
#

menu "IOMMU device drivers"

config UBOOT_CONFIG_IOMMU
	bool "Enable Driver Model for IOMMU drivers"
	depends on UBOOT_CONFIG_DM
	help
	  Enable driver model for IOMMU devices. An IOMMU maps device
	  virtiual memory addresses to physical addresses. Devices
	  that sit behind an IOMMU can typically only access physical
	  memory if the IOMMU has been programmed to allow access to
	  that memory.

config UBOOT_CONFIG_APPLE_DART
	bool "Apple DART support"
	depends on UBOOT_CONFIG_IOMMU && UBOOT_CONFIG_ARCH_APPLE
	default y
	help
	  Enable support for the DART on Apple SoCs.  The DART is Apple's
	  IOMMU implementation.  The driver performs the necessary
	  configuration to put the DART into bypass mode such that it can
	  be used transparently by U-Boot.

endmenu
```
