## open_uboot/config/board/tq/tqma6/Kconfig
```kconfig
if UBOOT_CONFIG_TARGET_TQMA6

config UBOOT_CONFIG_SYS_BOARD
	default "tqma6"

config UBOOT_CONFIG_SYS_VENDOR
	default "tq"

config UBOOT_CONFIG_SYS_CONFIG_NAME
	default "tqma6"

choice
	prompt "TQMa6 SoC variant"
	default UBOOT_CONFIG_TQMA6Q
	help
	  select the TQMa6 module variant. The variants differing in the used
	  i.MX6 CPU type and DRAM

config UBOOT_CONFIG_TQMA6Q
	bool "TQMa6Q / TQMa6D"
	depends on UBOOT_CONFIG_MX6Q
	help
	  select UBOOT_CONFIG_TQMa6Q / TQMa6D with i.MX6Q/D and 1GiB DRAM

config UBOOT_CONFIG_TQMA6DL
	bool "TQMa6DL"
	depends on UBOOT_CONFIG_MX6DL
	help
	  select UBOOT_CONFIG_TQMa6DL with i.MX6DL and 1GiB DRAM

config UBOOT_CONFIG_TQMA6S
	bool "TQMa6S"
	depends on UBOOT_CONFIG_MX6S
	help
	  select UBOOT_CONFIG_TQMa6S with i.MX6S and 512 MiB DRAM

endchoice

choice
	prompt "TQMa6 boot configuration"
	default UBOOT_CONFIG_TQMA6X_MMC_BOOT
	help
	  Configure boot device. This is also used to implement environment
	  location.

config UBOOT_CONFIG_TQMA6X_MMC_BOOT
	bool "MMC / SD Boot"
	help
	  Boot from eMMC / SD Card

config UBOOT_CONFIG_TQMA6X_SPI_BOOT
	bool "SPI NOR Boot"
	help
	  Boot from on board SPI NOR flash

endchoice

choice
	prompt "TQMa6 base board variant"
	default UBOOT_CONFIG_MBA6
	help
	  Select base board for TQMa6

config UBOOT_CONFIG_MBA6
	bool "TQMa6 on MBa6 Starterkit"
	select UBOOT_CONFIG_DM_ETH
	select UBOOT_CONFIG_USB
	select UBOOT_CONFIG_CMD_USB
	select UBOOT_CONFIG_USB_STORAGE
	select UBOOT_CONFIG_USB_HOST_ETHER
	select UBOOT_CONFIG_USB_ETHER_SMSC95XX
	select UBOOT_CONFIG_PHYLIB
	select UBOOT_CONFIG_PHY_MICREL
	select UBOOT_CONFIG_PHY_MICREL_KSZ90X1
	select UBOOT_CONFIG_MXC_UART
	help
	  Select the MBa6 starterkit. This features a GigE Phy, USB, SD-Card
	  etc.

config UBOOT_CONFIG_WRU4
	bool "OHB WRU-IV"
	help
	  Select the OHB Systems AG WRU-IV baseboard.

endchoice

config UBOOT_CONFIG_SYS_TEXT_BASE
	default 0x2fc00000 if UBOOT_CONFIG_TQMA6S
	default 0x4fc00000 if UBOOT_CONFIG_TQMA6Q || UBOOT_CONFIG_TQMA6DL

config UBOOT_CONFIG_IMX_CONFIG
	default "board/tq/tqma6/tqma6q.cfg" if UBOOT_CONFIG_TQMA6Q
	default "board/tq/tqma6/tqma6dl.cfg" if UBOOT_CONFIG_TQMA6DL
	default "board/tq/tqma6/tqma6s.cfg" if UBOOT_CONFIG_TQMA6S

endif
```

## open_uboot/config/board/vscom/baltos/Kconfig
```kconfig
if UBOOT_CONFIG_TARGET_AM335X_BALTOS

config UBOOT_CONFIG_SYS_BOARD
	default "baltos"

config UBOOT_CONFIG_SYS_VENDOR
	default "vscom"

config UBOOT_CONFIG_SYS_SOC
	default "am33xx"

config UBOOT_CONFIG_SYS_CONFIG_NAME
	default "baltos"

endif
```

## open_uboot/config/board/xen/xenguest_arm64/Kconfig
```kconfig
if UBOOT_CONFIG_TARGET_XENGUEST_ARM64

config UBOOT_CONFIG_SYS_BOARD
	default "xenguest_arm64"

config UBOOT_CONFIG_SYS_VENDOR
	default "xen"

config UBOOT_CONFIG_SYS_CONFIG_NAME
	default "xenguest_arm64"

endif
```

## open_uboot/config/board/zyxel/nsa310s/Kconfig
```kconfig
# SPDX-License-Identifier: GPL-2.0+
#
# Copyright (C) 2015
# Gerald Kerma <dreagle@doukki.net>
# Tony Dinh <mibodhi@gmail.com>

if UBOOT_CONFIG_TARGET_NSA310S

config UBOOT_CONFIG_SYS_BOARD
	default "nsa310s"

config UBOOT_CONFIG_SYS_VENDOR
	default "zyxel"

config UBOOT_CONFIG_SYS_CONFIG_NAME
	default "nsa310s"

endif
```

## open_uboot/config/disk/Kconfig
```kconfig
menu "Partition Types"

config UBOOT_CONFIG_PARTITIONS
	bool "Enable Partition Labels (disklabels) support"
	default y
	select UBOOT_CONFIG_SPL_SPRINTF if SPL
	select UBOOT_CONFIG_TPL_SPRINTF if TPL
	select UBOOT_CONFIG_SPL_STRTO if SPL
	select UBOOT_CONFIG_TPL_STRTO if TPL
	help
	  Partition Labels (disklabels) Supported:
	  Zero or more of the following:
	  - CONFIG_MAC_PARTITION   Apple's MacOS partition table.
	  - CONFIG_DOS_PARTITION   MS Dos partition table, traditional on the
	                           Intel architecture, USB sticks, etc.
	  - CONFIG_ISO_PARTITION   ISO partition table, used on CDROM etc.
	  - CONFIG_EFI_PARTITION   GPT partition table, common when EFI is the
	                           bootloader.  Note 2TB partition limit; see
	                           disk/part_efi.c
	  - CONFIG_MTD_PARTITIONS  Memory Technology Device partition table.
	  If IDE or SCSI support is enabled (CONFIG_CMD_IDE or CONFIG_SCSI)
	  you must configure support for at least one non-MTD partition type
	  as well.

config UBOOT_CONFIG_MAC_PARTITION
	bool "Enable Apple's MacOS partition table"
	depends on UBOOT_CONFIG_PARTITIONS
	help
	  Say Y here if you would like to use device under U-Boot which
	  were partitioned on a Macintosh.

config UBOOT_CONFIG_SPL_MAC_PARTITION
	bool "Enable Apple's MacOS partition table for SPL"
	depends on UBOOT_CONFIG_SPL && UBOOT_CONFIG_PARTITIONS
	default y if UBOOT_CONFIG_MAC_PARTITION

config UBOOT_CONFIG_DOS_PARTITION
	bool "Enable MS Dos partition table"
	depends on UBOOT_CONFIG_PARTITIONS
	default y if UBOOT_CONFIG_DISTRO_DEFAULTS
	default y if x86 || UBOOT_CONFIG_CMD_FAT || UBOOT_CONFIG_USB_STORAGE
	help
	  traditional on the Intel architecture, USB sticks, etc.

config UBOOT_CONFIG_SPL_DOS_PARTITION
	bool "Enable MS Dos partition table for SPL"
	depends on UBOOT_CONFIG_SPL && UBOOT_CONFIG_PARTITIONS
	default n if UBOOT_CONFIG_ARCH_SUNXI
	default y if UBOOT_CONFIG_DOS_PARTITION

config UBOOT_CONFIG_ISO_PARTITION
	bool "Enable ISO partition table"
	depends on UBOOT_CONFIG_PARTITIONS
	default y if UBOOT_CONFIG_DISTRO_DEFAULTS
	default y if UBOOT_CONFIG_MIPS || UBOOT_CONFIG_ARCH_TEGRA

config UBOOT_CONFIG_SPL_ISO_PARTITION
	bool "Enable ISO partition table for SPL"
	depends on UBOOT_CONFIG_SPL && UBOOT_CONFIG_PARTITIONS

config UBOOT_CONFIG_AMIGA_PARTITION
	bool "Enable AMIGA partition table"
	depends on UBOOT_CONFIG_PARTITIONS
	help
	  Say Y here if you would like to use device under U-Boot which
	  were partitioned under AmigaOS.

config UBOOT_CONFIG_SPL_AMIGA_PARTITION
	bool "Enable AMIGA partition table for SPL"
	depends on UBOOT_CONFIG_SPL && UBOOT_CONFIG_PARTITIONS
	default y if UBOOT_CONFIG_AMIGA_PARTITION

config UBOOT_CONFIG_EFI_PARTITION
	bool "Enable EFI GPT partition table"
	depends on UBOOT_CONFIG_PARTITIONS
	default y if UBOOT_CONFIG_DISTRO_DEFAULTS
	default y if UBOOT_CONFIG_ARCH_TEGRA
	select UBOOT_CONFIG_LIB_UUID
	help
	  Say Y here if you would like to use device under U-Boot which
	  were partitioned using EFI GPT.
	  common when EFI is the bootloader.  Note 2TB partition limit;
	  see disk/part_efi.c

config UBOOT_CONFIG_EFI_PARTITION_ENTRIES_NUMBERS
	int "Number of the EFI partition entries"
	depends on UBOOT_CONFIG_EFI_PARTITION
	default 56 if UBOOT_CONFIG_ARCH_SUNXI
	default 128
	help
	  Specify the number of partition entries in the GPT. This is
	  meant to allow less than the standard specifies for devices
	  that might need to place their first-stage bootloader in the
	  middle of a regular GPT.

	  If unsure, leave at 128 entries, which is the standard
	  number.

config UBOOT_CONFIG_EFI_PARTITION_ENTRIES_OFF
        int "Offset (in bytes) of the EFI partition entries"
	depends on UBOOT_CONFIG_EFI_PARTITION
	default 0
	help
	  Specify an earliest location (in bytes) where the partition
	  entries may be located. This is meant to allow "punching a
	  hole into a device" to create a gap for an SPL, its payload
	  and the U-Boot environment.

	  If unsure, leave at 0 (which will locate the partition
	  entries at the first possible LBA following the GPT header).

config UBOOT_CONFIG_SPL_EFI_PARTITION
	bool "Enable EFI GPT partition table for SPL"
	depends on  UBOOT_CONFIG_SPL && UBOOT_CONFIG_PARTITIONS
	default n if UBOOT_CONFIG_ARCH_SUNXI
	default y if UBOOT_CONFIG_EFI_PARTITION

config UBOOT_CONFIG_PARTITION_UUIDS
	bool "Enable support of UUID for partition"
	depends on UBOOT_CONFIG_PARTITIONS
	default y if UBOOT_CONFIG_DISTRO_DEFAULTS
	default y if UBOOT_CONFIG_EFI_PARTITION
	select UBOOT_CONFIG_LIB_UUID
	help
	  Activate the configuration of UUID for partition

config UBOOT_CONFIG_SPL_PARTITION_UUIDS
	bool "Enable support of UUID for partition in SPL"
	depends on UBOOT_CONFIG_SPL && UBOOT_CONFIG_PARTITIONS
	default y if UBOOT_CONFIG_SPL_EFI_PARTITION

config UBOOT_CONFIG_PARTITION_TYPE_GUID
	bool "Enable support of GUID for partition type"
	depends on UBOOT_CONFIG_PARTITIONS
	depends on UBOOT_CONFIG_EFI_PARTITION
	help
	  Activate the configuration of GUID type
	  for EFI partition

endmenu
```

## open_uboot/config/drivers/block/Kconfig
```kconfig
config UBOOT_CONFIG_BLK
	bool "Support block devices"
	depends on UBOOT_CONFIG_DM
	default y if UBOOT_CONFIG_DM_MMC || UBOOT_CONFIG_DM_USB
	help
	  Enable support for block devices, such as SCSI, MMC and USB
	  flash sticks. These provide a block-level interface which permits
	  reading, writing and (in some cases) erasing blocks. Block
	  devices often have a partition table which allows the device to
	  be partitioned into several areas, called 'partitions' in U-Boot.
	  A filesystem can be placed in each partition.

config UBOOT_CONFIG_HAVE_BLOCK_DEVICE
	bool "Enable Legacy Block Device"
	help
	  Some devices require block support whether or not DM is enabled

config UBOOT_CONFIG_SPL_BLK
	bool "Support block devices in SPL"
	depends on UBOOT_CONFIG_SPL_DM && UBOOT_CONFIG_BLK
	default y
	help
	  Enable support for block devices, such as SCSI, MMC and USB
	  flash sticks. These provide a block-level interface which permits
	  reading, writing and (in some cases) erasing blocks. Block
	  devices often have a partition table which allows the device to
	  be partitioned into several areas, called 'partitions' in U-Boot.
	  A filesystem can be placed in each partition.

config UBOOT_CONFIG_TPL_BLK
	bool "Support block devices in TPL"
	depends on UBOOT_CONFIG_TPL_DM && UBOOT_CONFIG_BLK
	default y
	help
	  Enable support for block devices, such as SCSI, MMC and USB
	  flash sticks. These provide a block-level interface which permits
	  reading, writing and (in some cases) erasing blocks. Block
	  devices often have a partition table which allows the device to
	  be partitioned into several areas, called 'partitions' in U-Boot.
	  A filesystem can be placed in each partition.

config UBOOT_CONFIG_BLOCK_CACHE
	bool "Use block device cache"
	depends on UBOOT_CONFIG_BLK
	default y
	help
	  This option enables a disk-block cache for all block devices.
	  This is most useful when accessing filesystems under U-Boot since
	  it will prevent repeated reads from directory structures and other
	  filesystem data structures.

config UBOOT_CONFIG_SPL_BLOCK_CACHE
	bool "Use block device cache in SPL"
	depends on UBOOT_CONFIG_SPL_BLK
	help
	  This option enables the disk-block cache in SPL

config UBOOT_CONFIG_TPL_BLOCK_CACHE
	bool "Use block device cache in TPL"
	depends on UBOOT_CONFIG_TPL_BLK
	help
	  This option enables the disk-block cache in TPL

config UBOOT_CONFIG_EFI_MEDIA
	bool "Support EFI media drivers"
	default y if UBOOT_CONFIG_EFI || UBOOT_CONFIG_SANDBOX
	help
	  Enable this to support media devices on top of UEFI. This enables
	  just the uclass so you also need a specific driver to make this do
	  anything.

	  For sandbox there is a test driver.

if UBOOT_CONFIG_EFI_MEDIA

config UBOOT_CONFIG_EFI_MEDIA_SANDBOX
	bool "Sandbox EFI media driver"
	depends on UBOOT_CONFIG_SANDBOX
	default y
	help
	  Enables a simple sandbox media driver, used for testing just the
	  EFI_MEDIA uclass. It does not do anything useful, since sandbox does
	  not actually support running on top of UEFI.

config UBOOT_CONFIG_EFI_MEDIA_BLK
	bool "EFI media block driver"
	depends on UBOOT_CONFIG_EFI_APP
	default y
	help
	  Enables a block driver for providing access to UEFI devices. This
	  allows use of block devices detected by the underlying UEFI
	  implementation. With this it is possible to use filesystems on these
	  devices, for example.

endif  # EFI_MEDIA

config UBOOT_CONFIG_IDE
	bool "Support IDE controllers"
	select UBOOT_CONFIG_HAVE_BLOCK_DEVICE
	help
	  Enables support for IDE (Integrated Drive Electronics) hard drives.
	  This allows access to raw blocks and filesystems on an IDE drive
	  from U-Boot. See also CMD_IDE which provides an 'ide' command for
	  performing various IDE operations.
```

## open_uboot/config/drivers/clk/analogbits/Kconfig
```kconfig
# SPDX-License-Identifier: GPL-2.0

config UBOOT_CONFIG_CLK_ANALOGBITS_WRPLL_CLN28HPC
	bool
```

## open_uboot/config/drivers/clk/meson/Kconfig
```kconfig
config UBOOT_CONFIG_CLK_MESON_GX
	bool "Enable clock support for Amlogic GX"
	depends on UBOOT_CONFIG_CLK && UBOOT_CONFIG_ARCH_MESON
	default UBOOT_CONFIG_MESON_GX
	help
	  Enable clock support for the Amlogic GX SoC family, such as
	  the S905, S905X/D and S912.

config UBOOT_CONFIG_CLK_MESON_AXG
	bool "Enable clock support for Amlogic AXG"
	depends on UBOOT_CONFIG_CLK && UBOOT_CONFIG_ARCH_MESON
	default UBOOT_CONFIG_MESON_AXG
	help
	  Enable clock support for the Amlogic AXG SoC family, such as
	  the A113X/D

config UBOOT_CONFIG_CLK_MESON_G12A
	bool "Enable clock support for Amlogic G12A"
	depends on UBOOT_CONFIG_CLK && UBOOT_CONFIG_ARCH_MESON
	default UBOOT_CONFIG_MESON_G12A
	help
	  Enable clock support for the Amlogic G12A SoC family, such as
	  the S905X/D2
```

## open_uboot/config/drivers/clk/mvebu/Kconfig
```kconfig
config UBOOT_CONFIG_CLK_MVEBU
	bool "MVEBU clock drivers"
	depends on UBOOT_CONFIG_CLK && UBOOT_CONFIG_ARCH_MVEBU
	help
	  Enable support for clock present on Marvell MVEBU SoCs.

config UBOOT_CONFIG_CLK_ARMADA_3720
	bool "Marvell Armada 3720 clock driver"
	depends on UBOOT_CONFIG_CLK_MVEBU && UBOOT_CONFIG_ARM64
	help
	  Enable this to support the clocks on Marvell Armada 3720 SoC.
```

## open_uboot/config/drivers/clk/uniphier/Kconfig
```kconfig
config UBOOT_CONFIG_CLK_UNIPHIER
	def_bool y
	depends on UBOOT_CONFIG_ARCH_UNIPHIER
	select UBOOT_CONFIG_CLK
	help
	  Support for clock controllers on UniPhier SoCs.
	  Say Y if you want to control clocks provided by System Control
	  block, Media I/O block, Peripheral Block.
```
