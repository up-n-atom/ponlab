## open_uboot/config/drivers/pinctrl/mtmips/Kconfig
```kconfig
config UBOOT_CONFIG_PINCTRL_MTMIPS
	depends on UBOOT_CONFIG_ARCH_MTMIPS
	bool

config UBOOT_CONFIG_PINCTRL_MT7620
	bool "MediaTek MT7620 pin control driver"
	select UBOOT_CONFIG_PINCTRL_MTMIPS
	depends on UBOOT_CONFIG_SOC_MT7620 && UBOOT_CONFIG_PINCTRL_GENERIC
	help
	  Support pin multiplexing control on MediaTek MT7620.
	  The driver is controlled by a device tree node which contains
	  the pin mux functions for each available pin groups.

config UBOOT_CONFIG_PINCTRL_MT7628
	bool "MediaTek MT7628 pin control driver"
	select UBOOT_CONFIG_PINCTRL_MTMIPS
	depends on UBOOT_CONFIG_SOC_MT7628 && UBOOT_CONFIG_PINCTRL_GENERIC
	help
	  Support pin multiplexing control on MediaTek MT7628.
	  The driver is controlled by a device tree node which contains
	  the pin mux functions for each available pin groups.
```
