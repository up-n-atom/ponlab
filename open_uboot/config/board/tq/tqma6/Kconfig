## open_uboot/config/drivers/net/mscc_eswitch/Kconfig
```kconfig
# SPDX-License-Identifier: GPL-2.0+
#
# Copyright (c) 2019 Microsemi Corporation

config UBOOT_CONFIG_MSCC_OCELOT_SWITCH
	bool "Ocelot switch driver"
	depends on UBOOT_CONFIG_DM_ETH && UBOOT_CONFIG_ARCH_MSCC
	select UBOOT_CONFIG_PHYLIB
	help
	  This driver supports the Ocelot network switch device.

config UBOOT_CONFIG_MSCC_LUTON_SWITCH
	bool "Luton switch driver"
	depends on UBOOT_CONFIG_DM_ETH && UBOOT_CONFIG_ARCH_MSCC
	select UBOOT_CONFIG_PHYLIB
	help
	  This driver supports the Luton network switch device.

config UBOOT_CONFIG_MSCC_JR2_SWITCH
	bool "Jaguar2 switch driver"
	depends on UBOOT_CONFIG_DM_ETH && UBOOT_CONFIG_ARCH_MSCC
	select UBOOT_CONFIG_PHYLIB
	help
	  This driver supports the Jaguar2 network switch device.

config UBOOT_CONFIG_MSCC_SERVALT_SWITCH
	bool "Servalt switch driver"
	depends on UBOOT_CONFIG_DM_ETH && UBOOT_CONFIG_ARCH_MSCC
	select UBOOT_CONFIG_PHYLIB
	help
	  This driver supports the Servalt network switch device.

config UBOOT_CONFIG_MSCC_SERVAL_SWITCH
	bool "Serval switch driver"
	depends on UBOOT_CONFIG_DM_ETH && UBOOT_CONFIG_ARCH_MSCC
	select UBOOT_CONFIG_PHYLIB
	help
	  This driver supports the Serval network switch device.

config UBOOT_CONFIG_MSCC_FELIX_SWITCH
	bool "Felix switch driver"
	depends on UBOOT_CONFIG_DM_DSA
	select UBOOT_CONFIG_FSL_ENETC
	help
	  This driver supports the Ethernet switch integrated in the
	  NXP LS1028A SoC.
```

## open_uboot/config/drivers/net/phy/Kconfig
```kconfig
config UBOOT_CONFIG_BITBANGMII
	bool "Bit-banged ethernet MII management channel support"

config UBOOT_CONFIG_MV88E6352_SWITCH
	bool "Marvell 88E6352 switch support"

menuconfig UBOOT_CONFIG_PHYLIB
	bool "Ethernet PHY (physical media interface) support"
	depends on UBOOT_CONFIG_NET
	help
	  Enable Ethernet PHY (physical media interface) support.

if UBOOT_CONFIG_PHYLIB

config UBOOT_CONFIG_PHY_ADDR_ENABLE
	bool "Limit phy address"
	default y if UBOOT_CONFIG_ARCH_SUNXI
	help
	  Select this if you want to control which phy address is used

if UBOOT_CONFIG_PHY_ADDR_ENABLE
config UBOOT_CONFIG_PHY_ADDR
	int "PHY address"
	default 1 if UBOOT_CONFIG_ARCH_SUNXI
	default 0
	help
	  The address of PHY on MII bus. Usually in range of 0 to 31.
endif

config UBOOT_CONFIG_B53_SWITCH
	bool "Broadcom BCM53xx (RoboSwitch) Ethernet switch PHY support."
	help
	  Enable support for Broadcom BCM53xx (RoboSwitch) Ethernet switches.
	  This currently supports BCM53125 and similar models.

if UBOOT_CONFIG_B53_SWITCH

config UBOOT_CONFIG_B53_CPU_PORT
	int "CPU port"
	default 8

config UBOOT_CONFIG_B53_PHY_PORTS
	hex "Bitmask of PHY ports"

endif # B53_SWITCH

config UBOOT_CONFIG_MV88E61XX_SWITCH
	bool "Marvell MV88E61xx Ethernet switch PHY support."

if UBOOT_CONFIG_MV88E61XX_SWITCH

config UBOOT_CONFIG_MV88E61XX_CPU_PORT
	int "CPU Port"

config UBOOT_CONFIG_MV88E61XX_PHY_PORTS
	hex "Bitmask of PHY Ports"

config UBOOT_CONFIG_MV88E61XX_FIXED_PORTS
	hex "Bitmask of PHYless serdes Ports"

endif # MV88E61XX_SWITCH

config UBOOT_CONFIG_PHYLIB_10G
	bool "Generic 10G PHY support"

menuconfig UBOOT_CONFIG_PHY_AQUANTIA
	bool "Aquantia Ethernet PHYs support"
	select UBOOT_CONFIG_PHY_GIGE
	select UBOOT_CONFIG_PHYLIB_10G

config UBOOT_CONFIG_PHY_AQUANTIA_UPLOAD_FW
	bool "Aquantia firmware loading support"
	depends on UBOOT_CONFIG_PHY_AQUANTIA
	help
		Aquantia PHYs use firmware which can be either loaded automatically
		from storage directly attached to the phy or loaded by the boot loader
		via MDIO commands.  The firmware is loaded from a file, specified by
		the PHY_AQUANTIA_FW_PART and PHY_AQUANTIA_FW_NAME options.

config UBOOT_CONFIG_PHY_AQUANTIA_FW_PART
	string "Aquantia firmware partition"
	depends on UBOOT_CONFIG_PHY_AQUANTIA_UPLOAD_FW
	help
		Partition containing the firmware file.

config UBOOT_CONFIG_PHY_AQUANTIA_FW_NAME
	string "Aquantia firmware filename"
	depends on UBOOT_CONFIG_PHY_AQUANTIA_UPLOAD_FW
	help
		Firmware filename.

config UBOOT_CONFIG_PHY_ATHEROS
	bool "Atheros Ethernet PHYs support"

config UBOOT_CONFIG_PHY_BROADCOM
	bool "Broadcom Ethernet PHYs support"

config UBOOT_CONFIG_PHY_CORTINA
	bool "Cortina Ethernet PHYs support"

config UBOOT_CONFIG_SYS_CORTINA_NO_FW_UPLOAD
	bool "Cortina firmware loading support"
	depends on UBOOT_CONFIG_PHY_CORTINA
	help
		Cortina phy has provision to store phy firmware in attached dedicated
		EEPROM. And boards designed with such EEPROM does not require firmware
		upload.

choice
	prompt "Location of the Cortina firmware"
	default UBOOT_CONFIG_SYS_CORTINA_FW_IN_NOR
	depends on UBOOT_CONFIG_PHY_CORTINA

config UBOOT_CONFIG_SYS_CORTINA_FW_IN_MMC
	bool "Cortina firmware in MMC"

config UBOOT_CONFIG_SYS_CORTINA_FW_IN_NAND
	bool "Cortina firmware in NAND flash"

config UBOOT_CONFIG_SYS_CORTINA_FW_IN_NOR
	bool "Cortina firmware in NOR flash"

config UBOOT_CONFIG_SYS_CORTINA_FW_IN_REMOTE
	bool "Cortina firmware in remote device"

config UBOOT_CONFIG_SYS_CORTINA_FW_IN_SPIFLASH
	bool "Cortina firmware in SPI flash"

endchoice

config UBOOT_CONFIG_CORTINA_FW_ADDR
	hex "Cortina Firmware Address"
	depends on UBOOT_CONFIG_PHY_CORTINA && !UBOOT_CONFIG_SYS_CORTINA_NO_FW_UPLOAD
	default 0x0

config UBOOT_CONFIG_CORTINA_FW_LENGTH
	hex "Cortina Firmware Length"
	depends on UBOOT_CONFIG_PHY_CORTINA && !UBOOT_CONFIG_SYS_CORTINA_NO_FW_UPLOAD
	default 0x40000

config UBOOT_CONFIG_PHY_CORTINA_ACCESS
	bool "Cortina Access Ethernet PHYs support"
	default y
	depends on UBOOT_CONFIG_CORTINA_NI_ENET
	help
		Cortina Access Ethernet PHYs init process

config UBOOT_CONFIG_PHY_DAVICOM
	bool "Davicom Ethernet PHYs support"

config UBOOT_CONFIG_PHY_ET1011C
	bool "LSI TruePHY ET1011C support"

config UBOOT_CONFIG_PHY_LXT
	bool "LXT971 Ethernet PHY support"

config UBOOT_CONFIG_PHY_MARVELL
	bool "Marvell Ethernet PHYs support"

config UBOOT_CONFIG_PHY_MESON_GXL
	bool "Amlogic Meson GXL Internal PHY support"

config UBOOT_CONFIG_PHY_MICREL
	bool "Micrel Ethernet PHYs support"
	help
	  Enable support for the GbE PHYs manufactured by Micrel (now
	  a part of Microchip). This includes drivers for the KSZ804, KSZ8031,
	  KSZ8051, KSZ8081, KSZ8895, KSZ886x and KSZ8721 (if "Micrel KSZ8xxx
	  family support" is selected) and the KSZ9021 and KSZ9031 (if "Micrel
	  KSZ90x1 family support" is selected).

if UBOOT_CONFIG_PHY_MICREL

config UBOOT_CONFIG_PHY_MICREL_KSZ9021
	bool
	select UBOOT_CONFIG_PHY_MICREL_KSZ90X1

config UBOOT_CONFIG_PHY_MICREL_KSZ9031
	bool
	select UBOOT_CONFIG_PHY_MICREL_KSZ90X1

config UBOOT_CONFIG_PHY_MICREL_KSZ90X1
	bool "Micrel KSZ90x1 family support"
	select UBOOT_CONFIG_PHY_GIGE
	help
	  Enable support for the Micrel KSZ9021 and KSZ9031 GbE PHYs. If
	  enabled, the extended register read/write for KSZ90x1 PHYs
	  is supported through the 'mdio' command and any RGMII signal
	  delays configured in the device tree will be applied to the
	  PHY during initialization.

config UBOOT_CONFIG_PHY_MICREL_KSZ8XXX
	bool "Micrel KSZ8xxx family support"
	help
	  Enable support for the 8000 series 10/100 PHYs manufactured by Micrel
	  (now a part of Microchip). This includes drivers for the KSZ804,
	  KSZ8031, KSZ8051, KSZ8081, KSZ8895, KSZ886x, and KSZ8721.

endif # PHY_MICREL

config UBOOT_CONFIG_PHY_MSCC
	bool "Microsemi Corp Ethernet PHYs support"

config UBOOT_CONFIG_PHY_NATSEMI
	bool "National Semiconductor Ethernet PHYs support"

config UBOOT_CONFIG_PHY_NXP_C45_TJA11XX
	tristate "NXP C45 TJA11XX PHYs"
	help
	  Enable support for NXP C45 TJA11XX PHYs.
	  Currently supports only the TJA1103 PHY.

config UBOOT_CONFIG_PHY_REALTEK
	bool "Realtek Ethernet PHYs support"

config UBOOT_CONFIG_RTL8211E_PINE64_GIGABIT_FIX
	bool "Fix gigabit throughput on some Pine64+ models"
	depends on UBOOT_CONFIG_PHY_REALTEK
	help
	  Configure the Realtek RTL8211E found on some Pine64+ models differently to
	  fix throughput on Gigabit links, turning off all internal delays in the
	  process. The settings that this touches are not documented in the CONFREG
	  section of the RTL8211E datasheet, but come from Realtek by way of the
	  Pine64 engineering team.

config UBOOT_CONFIG_RTL8211X_PHY_FORCE_MASTER
	bool "Ethernet PHY RTL8211x: force 1000BASE-T master mode"
	depends on UBOOT_CONFIG_PHY_REALTEK
	help
	  Force master mode for 1000BASE-T on RTl8211x PHYs (except for RTL8211F).
	  This can work around link stability and data corruption issues on gigabit
	  links which can occur in slave mode on certain PHYs, e.g. on the
	  RTL8211C(L).

	  Please note that two directly connected devices (i.e. via crossover cable)
	  will not be able to establish a link between each other if they both force
	  master mode. Multiple devices forcing master mode when connected by a
	  network switch do not pose a problem as the switch configures its affected
	  ports into slave mode.

	  This option only affects gigabit links. If you must establish a direct
	  connection between two devices which both force master mode, try forcing
	  the link speed to 100MBit/s.

	  If unsure, say N.

config UBOOT_CONFIG_RTL8211F_PHY_FORCE_EEE_RXC_ON
	bool "Ethernet PHY RTL8211F: do not stop receiving the xMII clock during LPI"
	depends on UBOOT_CONFIG_PHY_REALTEK
	help
	  The IEEE 802.3az-2010 (EEE) standard provides a protocol to coordinate
	  transitions to/from a lower power consumption level (Low Power Idle
	  mode) based on link utilization. When no packets are being
	  transmitted, the system goes to Low Power Idle mode to save power.

	  Under particular circumstances this setting can cause issues where
	  the PHY is unable to transmit or receive any packet when in LPI mode.
	  The problem is caused when the PHY is configured to stop receiving
	  the xMII clock while it is signaling LPI. For some PHYs the bit
	  configuring this behavior is set by the Linux kernel, causing the
	  issue in U-Boot on reboot if the PHY retains the register value.

	  Default n, which means that the PHY state is not changed. To work
	  around the issues, change this setting to y.

config UBOOT_CONFIG_RTL8201F_PHY_S700_RMII_TIMINGS
	bool "Ethernet PHY RTL8201F: adjust RMII Tx Interface timings"
	depends on UBOOT_CONFIG_PHY_REALTEK
	help
	  This provides an option to configure specific timing requirements (needed
	  for proper PHY operations) for the PHY module present on ACTION SEMI S700
	  based cubieboard7. Exact timing requiremnets seems to be SoC specific
	  (and it's undocumented) that comes from vendor code itself.

config UBOOT_CONFIG_PHY_SMSC
	bool  "Microchip(SMSC) Ethernet PHYs support"

config UBOOT_CONFIG_PHY_TERANETICS
	bool "Teranetics Ethernet PHYs support"

config UBOOT_CONFIG_PHY_TI
	bool "Texas Instruments Ethernet PHYs support"
	---help---
	  Adds PHY registration support for TI PHYs.

config UBOOT_CONFIG_PHY_TI_DP83867
	select UBOOT_CONFIG_PHY_TI
	bool "Texas Instruments Ethernet DP83867 PHY support"
	---help---
	  Adds support for the TI DP83867 1Gbit PHY.

config UBOOT_CONFIG_PHY_TI_GENERIC
	select UBOOT_CONFIG_PHY_TI
	bool "Texas Instruments Generic Ethernet PHYs support"
	---help---
	  Adds support for Generic TI PHYs that don't need special handling but
	  the PHY name is associated with a PHY ID.

config UBOOT_CONFIG_PHY_VITESSE
	bool "Vitesse Ethernet PHYs support"

config UBOOT_CONFIG_PHY_XILINX
	bool "Xilinx Ethernet PHYs support"

config UBOOT_CONFIG_PHY_XILINX_GMII2RGMII
	bool "Xilinx GMII to RGMII Ethernet PHYs support"
	depends on UBOOT_CONFIG_DM_ETH
	help
	  This adds support for Xilinx GMII to RGMII IP core. This IP acts
	  as bridge between MAC connected over GMII and external phy that
	  is connected over RGMII interface.

config UBOOT_CONFIG_PHY_FIXED
	bool "Fixed-Link PHY"
	depends on UBOOT_CONFIG_DM_ETH
	help
	  Fixed PHY is used for having a 'fixed-link' to another MAC with a direct
	  connection (MII, RGMII, ...).
	  There is nothing like autoneogation and so
	  on, the link is always up with fixed speed and fixed duplex-setting.
	  More information: doc/device-tree-bindings/net/fixed-link.txt

config UBOOT_CONFIG_PHY_NCSI
	bool "NC-SI based PHY"
	depends on UBOOT_CONFIG_DM_ETH

endif #PHYLIB
```

## open_uboot/config/drivers/nvme/Kconfig
```kconfig
# SPDX-License-Identifier: GPL-2.0+
#
# Copyright (C) 2017, Bin Meng <bmeng.cn@gmail.com>

config UBOOT_CONFIG_NVME
	bool "NVM Express device support"
	depends on UBOOT_CONFIG_BLK && UBOOT_CONFIG_PCI
	select UBOOT_CONFIG_HAVE_BLOCK_DEVICE
	help
	  This option enables support for NVM Express devices.
	  It supports basic functions of NVMe (read/write).
```

## open_uboot/config/drivers/pinctrl/broadcom/Kconfig
```kconfig
config UBOOT_CONFIG_PINCTRL_BCM283X
	depends on UBOOT_CONFIG_ARCH_BCM283X && UBOOT_CONFIG_PINCTRL_FULL && UBOOT_CONFIG_OF_CONTROL
	default y
	bool "Broadcom 283x family pin control driver"
	help
	   Support pin multiplexing and pin configuration control on
	   Broadcom's 283x family of SoCs.

config UBOOT_CONFIG_PINCTRL_BCM6838
	depends on UBOOT_CONFIG_ARCH_BMIPS && UBOOT_CONFIG_PINCTRL_FULL && UBOOT_CONFIG_OF_CONTROL
	default y
	bool "Broadcom 6838 family pin control driver"
	help
	   Support pin multiplexing and pin configuration control on
	   Broadcom's 6838 family of SoCs.
```

## open_uboot/config/drivers/pinctrl/exynos/Kconfig
```kconfig
config UBOOT_CONFIG_PINCTRL_EXYNOS
	bool

config UBOOT_CONFIG_PINCTRL_EXYNOS7420
	bool "Samsung Exynos7420 pinctrl driver"
	depends on UBOOT_CONFIG_ARCH_EXYNOS && UBOOT_CONFIG_PINCTRL_FULL
	select UBOOT_CONFIG_PINCTRL_EXYNOS
	help
	  Support pin multiplexing and pin configuration control on
	  Samsung's Exynos7420 SoC.

config UBOOT_CONFIG_PINCTRL_EXYNOS78x0
	bool "Samsung Exynos78x0 pinctrl driver"
	depends on UBOOT_CONFIG_ARCH_EXYNOS && UBOOT_CONFIG_PINCTRL_FULL
	select UBOOT_CONFIG_PINCTRL_EXYNOS
	help
	  Support pin multiplexing and pin configuration control on
	  Samsung's Exynos78x0 SoC.
```

## open_uboot/config/drivers/pinctrl/mscc/Kconfig
```kconfig
# SPDX-License-Identifier: (GPL-2.0+ OR MIT)

config UBOOT_CONFIG_PINCTRL_MSCC
	bool

config UBOOT_CONFIG_PINCTRL_MSCC_OCELOT
	depends on UBOOT_CONFIG_SOC_OCELOT && UBOOT_CONFIG_PINCTRL_FULL && UBOOT_CONFIG_OF_CONTROL
	select UBOOT_CONFIG_PINCTRL_MSCC
	default y
	bool "Microsemi ocelot family pin control driver"
	help
	   Support pin multiplexing and pin configuration control on
	   Microsemi ocelot SoCs.

config UBOOT_CONFIG_PINCTRL_MSCC_LUTON
	depends on UBOOT_CONFIG_SOC_LUTON && UBOOT_CONFIG_PINCTRL_FULL && UBOOT_CONFIG_OF_CONTROL
	select UBOOT_CONFIG_PINCTRL_MSCC
	default y
	bool "Microsemi luton family pin control driver"
	help
	   Support pin multiplexing and pin configuration control on
	   Microsemi luton SoCs.

config UBOOT_CONFIG_PINCTRL_MSCC_JR2
	depends on UBOOT_CONFIG_SOC_JR2 && UBOOT_CONFIG_PINCTRL_FULL && UBOOT_CONFIG_OF_CONTROL
	select UBOOT_CONFIG_PINCTRL_MSCC
	default y
	bool "Microsemi jr2 family pin control driver"
	help
	    Support pin multiplexing and pin configuration control on
	    Microsemi jr2 SoCs.

config UBOOT_CONFIG_PINCTRL_MSCC_SERVALT
	depends on UBOOT_CONFIG_SOC_SERVALT && UBOOT_CONFIG_PINCTRL_FULL && UBOOT_CONFIG_OF_CONTROL
	select UBOOT_CONFIG_PINCTRL_MSCC
	default y
	bool "Microsemi servalt family pin control driver"
	help
	    Support pin multiplexing and pin configuration control on
	    Microsemi servalt SoCs.

config UBOOT_CONFIG_PINCTRL_MSCC_SERVAL
	depends on UBOOT_CONFIG_SOC_SERVAL && UBOOT_CONFIG_PINCTRL_FULL && UBOOT_CONFIG_OF_CONTROL
	select UBOOT_CONFIG_PINCTRL_MSCC
	default y
	bool "Microsemi serval family pin control driver"
	help
	    Support pin multiplexing and pin configuration control on
	    Microsemi serval SoCs.
```
