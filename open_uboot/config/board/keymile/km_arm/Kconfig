## open_uboot/config/board/maxlinear/Kconfig
```kconfig
# SPDX-License-Identifier: GPL-2.0+
#
# Copyright (C) 2015, Bin Meng <bmeng.cn@gmail.com>

if UBOOT_CONFIG_VENDOR_MAXLINEAR

config UBOOT_CONFIG_TARGET_LIGHTNING_MOUNTAIN
	bool "Lightning Mountain"
	depends on UBOOT_CONFIG_LIGHTNING_MOUNTAIN_SOC
	help
	  This is the configuration for Lightning Mountain


source "lightning/Kconfig"

if UBOOT_CONFIG_VENDOR_MAXLINEAR
# common Kconfig options
menu "Common board settings"
config UBOOT_CONFIG_SPL_PAD_SIZE
	hex "The min size the SPL can be padded to"
	default "0x20000"
	depends on UBOOT_CONFIG_SPL
	help
	  The SPL needs to be padded and this
	  value as part of the U-boot deliverable binary

config UBOOT_CONFIG_COPIES_OF_RBE
	hex "Bootrom supports up to 4 RBE images"
	default "0x1"
	depends on UBOOT_CONFIG_SPL
	help
	  Multiple RBEs will be concatenated together in EMMC.
	  Single RBE per flash partition in NAND flash.

if UBOOT_CONFIG_COPIES_OF_RBE > 1
config UBOOT_CONFIG_BACKUP_RBE_OFFSET_IN_FLASH
	hex "Offset of second RBE in flash"
	default "0x0"
	depends on UBOOT_CONFIG_SPL && !UBOOT_CONFIG_BOOT_FROM_EMMC
	help
	  The absoulute offset of the second RBE in flash
endif

config UBOOT_CONFIG_RECOVERY_SPL_PAD_SIZE
	hex
	default 0x16000

# NOR Flash Board Configuration #
menu "SPI NOR Flash Device Configuration"
	depends on UBOOT_CONFIG_SERIAL_NOR_FLASH_INTEL_CHD

choice
	prompt "SPI NOR Flash Size(M)"
	depends on UBOOT_CONFIG_BOOT_FROM_SPI || UBOOT_CONFIG_BOOT_FROM_QSPI_NOR
	default UBOOT_CONFIG_SERIAL_NOR_FLASH_16M

config UBOOT_CONFIG_SERIAL_NOR_FLASH_16M
	bool "16M"

config UBOOT_CONFIG_SERIAL_NOR_FLASH_8M
	bool "8M"

config UBOOT_CONFIG_SERIAL_NOR_FLASH_4M
	bool "4M"

config UBOOT_CONFIG_SERIAL_NOR_FLASH_2M
	bool "2M"

config UBOOT_CONFIG__SERIAL_NOR_FLASH_1M
	bool "1M"

endchoice
endmenu # SPI NOR Device

# NAND Flash Board Configuration
menu "NAND Flash Device Configuration"
	depends on UBOOT_CONFIG_NAND_FLASH_MXL

config UBOOT_CONFIG_NAND_CS0
	bool "NAND FLASH ON CS0"
	default n
	depends on UBOOT_CONFIG_NAND_FLASH_MXL

choice
	prompt "NAND Flash Size(M)"
	depends on UBOOT_CONFIG_BOOT_FROM_NAND
	default UBOOT_CONFIG_NAND_FLASH_MXL_256M

config UBOOT_CONFIG_NAND_FLASH_MXL_8192M
	bool "8192M"

config UBOOT_CONFIG_NAND_FLASH_MXL_4096M
	bool "4096M"

config UBOOT_CONFIG_NAND_FLASH_MXL_2048M
	bool "2048M"

config UBOOT_CONFIG_NAND_FLASH_MXL_1024M
	bool "1024M"

config UBOOT_CONFIG_NAND_FLASH_MXL_512M
	bool "512M"

config UBOOT_CONFIG_NAND_FLASH_MXL_256M
	bool "256M"

config UBOOT_CONFIG_NAND_FLASH_MXL_128M
	bool "128M"

config UBOOT_CONFIG_NAND_FLASH_MXL_64M
	bool "64M"

config UBOOT_CONFIG_NAND_FLASH_MXL_32M
	bool "32M"

config UBOOT_CONFIG_NAND_FLASH_MXL_8M
	bool "8M"

config UBOOT_CONFIG_NAND_FLASH_MXL_4M
	bool "4M"

config UBOOT_CONFIG_NAND_FLASH_MXL_2M
	bool "2M"

endchoice #NAND Flash Size

config UBOOT_CONFIG_NAND_FLASH_SIZE
	int
	default "2" if (UBOOT_CONFIG_NAND_FLASH_MXL_2M )
	default "4" if (UBOOT_CONFIG_NAND_FLASH_MXL_4M )
	default "8" if (UBOOT_CONFIG_NAND_FLASH_MXL_8M )
	default "32" if (UBOOT_CONFIG_NAND_FLASH_MXL_32M )
	default "64" if (UBOOT_CONFIG_NAND_FLASH_MXL_64M )
	default "128" if (UBOOT_CONFIG_NAND_FLASH_MXL_128M )
	default "256" if (UBOOT_CONFIG_NAND_FLASH_MXL_256M )
	default "512" if (UBOOT_CONFIG_NAND_FLASH_MXL_512M )
	default "1024" if (UBOOT_CONFIG_NAND_FLASH_MXL_1024M )
	default "2048" if (UBOOT_CONFIG_NAND_FLASH_MXL_2048M )
	default "4096" if (UBOOT_CONFIG_NAND_FLASH_MXL_4096M )
	default "8192" if (UBOOT_CONFIG_NAND_FLASH_MXL_8192M )
	depends on UBOOT_CONFIG_NAND_FLASH_MXL

endmenu # NAND Device
endmenu # common board settings

# ENV variables used for MXL chips
menu "Common environment settings"
menu "Environment Settings"
config UBOOT_CONFIG_PREBOOT
	string "pre-boot command"
	default "echo; echo run \'flash_flash\' to bring up the kernel; echo;"

config UBOOT_CONFIG_BOOTDELAY
	int "BOOTDELAY(seconds)"
	default 5

config UBOOT_CONFIG_MAX_BOOT_COUNTER
	int "Maximum reboot retries"
	default 3

config UBOOT_CONFIG_LOADADDR
	hex
	default 0x8200000

config UBOOT_CONFIG_DTB_LOADADDR
	hex
	default 0x8000000

config UBOOT_CONFIG_ROOTFS_LOADADDR
	hex
	default 0x40000000

config UBOOT_CONFIG_BOOTCOMMAND
	string "bootcmd"
	default "sf probe; sf read 0x800000 0x100000 0x200000; bootm 0x800000" if (UBOOT_CONFIG_BOOT_FROM_SPI )

config UBOOT_CONFIG_BOOTARGS
	string "bootargs"

config UBOOT_CONFIG_NFS_ARGS
	string "NFS args"
	default "setenv bootargs ubi.mtd=system_sw,2048 root=/dev/nfs rw nfsroot=${serverip}:${rootpath}"

config UBOOT_CONFIG_RAMARGS
	string "ramargs"
	default "setenv bootargs root=/dev/ram rw init=/init"

config UBOOT_CONFIG_FLASHARGS
	string "flashargs"
	default "setenv bootargs rootfsname=/dev/mtdblock2 rootfstype=squashfs"

config UBOOT_CONFIG_ADDMISC
	string "addmisc"
	default "setenv bootargs ${bootargs} console=${console},${baudrate} ethaddr=${ethaddr} phym=${phym} mem=${mem} panic=1 mtdparts=${mtdparts}"

config UBOOT_CONFIG_LOAD_PARTITION_A
	string "load_part_a"
	default "run evalblock; mmc dev 0 0;mmc read ${kernel_loadaddr} ${kernel_a_block_start} ${kernel_a_block_size} ; mmc read ${dtb_loadaddr} ${dtb_a_block_start} ${dtb_a_block_size};" if (UBOOT_CONFIG_BOOT_FROM_EMMC )
	help
	   Command to load from the first partition

config UBOOT_CONFIG_LOAD_PARTITION_B
	string "load_part_b"
	default "run evalblock; mmc dev 0 0; mmc read ${kernel_loadaddr} ${kernel_b_block_start} ${kernel_b_block_size} ; mmc read ${dtb_loadaddr} ${dtb_b_block_start} ${dtb_b_block_size};" if (UBOOT_CONFIG_BOOT_FROM_EMMC )
	help
	   Command to load from the second partition

config UBOOT_CONFIG_MTDIDS
	string "mtdids"
	default "nand0=nand.0" if (UBOOT_CONFIG_BOOT_FROM_NAND )
	default "nor0=qspi.1" if (UBOOT_CONFIG_BOOT_FROM_QSPI_NOR )
	default "spi-nand0=spi0.1" if (UBOOT_CONFIG_BOOT_FROM_QSPI_NAND )

config UBOOT_CONFIG_MTDPARTS
	string "mtdparts"
	default "mtdparts=nand.0:1m(uboot),1m(tep_firmware),256k(ubootconfigA),256k(ubootconfigB),256k(gphyfirmware),1m(calibration),108m(system_sw),-(res)" if (UBOOT_CONFIG_BOOT_FROM_NAND )
	default "mtdparts=qspi.1:512k(uboot),1m(tep_firmware),256k(ubootconfig),256k(gphyfirmware),4m(kernel),6m(rootfs),-(res)" if (UBOOT_CONFIG_BOOT_FROM_QSPI_NOR )
	default "mtdparts=spi0.1:256k(rbe_a),512k(uboot_a),256k(rbe_b),512k(uboot_b),1m(tep_firmware_a),1m(tep_firmware_b),128m(extended_boot),64m(misc),16m(log),-(res)" if (UBOOT_CONFIG_BOOT_FROM_QSPI_NAND )

config UBOOT_CONFIG_ENV_SIZE
	hex ""
	default 0x40000

config UBOOT_CONFIG_FLASH_FLASH
	string "flash_flash"
	default "run "

config UBOOT_CONFIG_RESET_UBOOT_CONFIG
	string "reset-uboot-config"
	default "nand erase.part ubootconfigA; nand erase.part ubootconfigB" if UBOOT_CONFIG_BOOT_FROM_NAND
	default "mmc dev 0 0; mmc erase ${env_block_start} ${env_block_size}" if UBOOT_CONFIG_BOOT_FROM_EMMC

config UBOOT_CONFIG_RECOVER_PRIMARY_IMG
	string "Recovery of primary partitions"
	default ""

config UBOOT_CONFIG_RECOVER_BOOT_IMG
	string "Command to recover early boot images"
	default ""

config UBOOT_CONFIG_RECOVER_BOOT_ALL_IMG
	string "Command to recover early and late boot images"
	default ""

config UBOOT_CONFIG_SWITCH_PRIMARY
	string "switch to primary bank"
	default "setenv kernel_vol kernel_a; setenv rootfs_vol rootfs_a; setenv dtb_vol dtb_a" if UBOOT_CONFIG_BOOT_FROM_NAND

config UBOOT_CONFIG_SWITCH_SECONDARY
	string "switch to secondary bank"
	default "setenv kernel_vol kernel_b; setenv rootfs_vol rootfs_b; setenv dtb_vol dtb_b" if UBOOT_CONFIG_BOOT_FROM_NAND

config UBOOT_CONFIG_SWITCH_PARTITION
	string "switch between partitions a-b or b-a"
	default ""

config UBOOT_CONFIG_UPGRADE_FS_INIT
	string "Prepare upgrade FS for access"
	default "ubi part $misc && ubifsmount ubi1:$upgrade_volume"

config UBOOT_CONFIG_UBI_INIT
	string "ubi_init"
	default "ubi part data;setenv kernelA_vol_id 0;setenv rootfsA_vol_id 1; setenv firmwareA_vol_id 2;setenv kernelB_vol_id 3;setenv rootfsB_vol_id 4; setenv firmwareB_vol_id 5; setenv bootcoreA_vol_id 6; bootcoreB_vol_id 7; setenv setbank check_image${update_chk};run ${setbank}"

config UBOOT_CONFIG_UPDATE_UBOOT
	string "update_uboot"
	default "tftpboot ${loadaddr} ${tftppath}${u-boot} && setenv select_partition primary; upgrade ${loadaddr} ${filesize}"

config UBOOT_CONFIG_UPDATE_RBE
	string "update rbe binary"
	default "tftpboot ${loadaddr} ${tftppath}${rbe} && setenv select_partition primary; upgrade ${loadaddr} ${filesize}"

config UBOOT_CONFIG_UPDATE_BOOTLOADER
	string "update bootloader binary"
	default "tftpboot ${loadaddr} ${tftppath}${bootloader} && setenv select_partition primary; upgrade ${loadaddr} ${filesize}"

config UBOOT_CONFIG_UPDATE_FULLIMAGE
	string "update_fullimage"
	default "tftpboot ${loadaddr} ${tftppath}${fullimage};upgrade ${loadaddr} ${filesize}"

config UBOOT_CONFIG_UPDATE_FULLIMAGE_USB
	string "update_fullimage_usb"
	default "load usb ${usb_port_part} ${loadaddr} ${fullimage}; upgrade ${loadaddr} ${filesize}"
	depends on UBOOT_CONFIG_USB

config UBOOT_CONFIG_USB_PORT_PART
	string "usb_port_part"
	default "0:1"
	depends on UBOOT_CONFIG_USB

config UBOOT_CONFIG_UPDATE_KERNEL
	string "update_kernel"
	default "tftpboot ${loadaddr} ${tftppath}${bootfile};upgrade ${loadaddr} ${filesize}"

config UBOOT_CONFIG_UPDATE_DTB
	string "update_dtb"
	default "tftpboot ${loadaddr} ${tftppath}${dtb};upgrade ${loadaddr} ${filesize}"

config UBOOT_CONFIG_UPDATE_ROOTFS
	string "update_rootfs"
	default "tftpboot ${loadaddr} ${tftppath}${rootfs}; upgrade ${loadaddr} ${filesize}"

config UBOOT_CONFIG_NET_RAM
	string "net_ram"
	default "tftpboot ${loadaddr} ${tftppath}${bootfile}; run nfsargs addmisc; bootm ${loadaddr}"

config UBOOT_CONFIG_U_BOOT
	string "U-Boot binary name"
	default "u-boot.bin"

config UBOOT_CONFIG_RBE_BINARY
	string "RBE binary name"
	default "u-boot-spl.img"

config UBOOT_CONFIG_BOOTLOADER_BINARY
	string "Bootloader binary name"
	default "u-boot.lzimg"

config UBOOT_CONFIG_DTB
	string "DTB"
	default "dtb.img"

config UBOOT_CONFIG_ROOTFS
	string "RootFS image name"
	default "rootfs.img"

config UBOOT_CONFIG_FULLIMAGE
	string "fullimage image name"
	default "fullimage.img"

config UBOOT_CONFIG_TEP_FIRMWARE
	string "TEP firmware binary name"
	default "tep_fw.bin"

config UBOOT_CONFIG_UPDATE_TEP_FIRMWARE
	string "update_tep_firmware"
	default "tftpboot ${loadaddr} ${tftppath}${tep_firmware} && nand erase.part tep_firmware_a && nand write ${loadaddr} tep_firmware_a ${filesize}"

config UBOOT_CONFIG_DDR_BIN
	string "DDR tuning binary name"
	depends on UBOOT_CONFIG_DDR_TUNING_SEPARATE
	default "ddr-binary.img"

config UBOOT_CONFIG_UPDATE_DDR_BIN
	string "update ddr tuning binary"
	depends on UBOOT_CONFIG_DDR_TUNING_SEPARATE
	default "tftpboot ${loadaddr} ${tftppath}${ddr_binary} && upgrade ${loadaddr} ${filesize}"

config UBOOT_CONFIG_CHECK_IMAGE
	string "check_image"
	default "echo check image"

config UBOOT_CONFIG_BOOTFILE
	string "Kernel uImage name"
	default "uImage"

config UBOOT_CONFIG_ROOTFS_A_SIZE
	hex "RootFS Image A size"
	default 0x4000000

config UBOOT_CONFIG_ROOTFS_B_SIZE
	hex "RootFS Image B size"
	default 0x4000000

config UBOOT_CONFIG_UBOOT_PART_SIZE
	hex "Size of U-boot MTD partition"
	depends on UBOOT_CONFIG_NAND_FLASH_MXL
	default 0x80000

endmenu # Environment settings

menu "Network Settings"
config UBOOT_CONFIG_IP_ADDRESS
	string "IP address"
	default 172.168.1.1

config UBOOT_CONFIG_SERVER_IP_ADDRESS
	string "Server IP address"
	default 172.168.1.2

config UBOOT_CONFIG_ETHERNET_ADDRESS
	string "Ethernet Address"
	default "00:E0:92:00:01:40"

config UBOOT_CONFIG_ETHERNET_DEVICE
	string "Ethernet Interface"
	default "eth0"

endmenu # Network

if UBOOT_CONFIG_MMC
menu "MMC environment settings"
config UBOOT_CONFIG_FILESYSTEM_PART_A
	string "Name of primary ext4 partition"
	default "extended_boot_a"
	help
	  Partition name that is filesystem formatted
	  and also contains the later boot images.

config UBOOT_CONFIG_FILESYSTEM_PART_B
	string "Name of secondary ext4 partition"
	default "extended_boot_b"
	help
	  Partition name that is filesystem formatted
	  and also contains the later boot images.

config UBOOT_CONFIG_UPGRADE_PARTITION
	string "Upgrade partition name"
	default "upgrade_partition"
	help
	  Partition name of the upgrade partition.

config UBOOT_CONFIG_FILESYSTEM_IMG
	string "Empty ISO filesystem binary name"
	default "ext4.fs"

config UBOOT_CONFIG_TOTAL_GPT_PARTITION
	int "Number of partitions defined in GPT"
	help
	  The number of partitions defined in the GPT partition table.

config UBOOT_CONFIG_LGM_PART_LIST
	string "partition definition"
	help
	  MMC GPT configurations. This is in this format:
	  partition=name=<name1>,start=<start>,size=<size>;name=<name2>,size=<size2>;...
endmenu # mmc
endif

config UBOOT_CONFIG_EXTRA_ENV_DATA
	string "Extra Data"
	help
	  Extend extra environment data here.

endmenu

menu "UBOOT External DTB"
config UBOOT_CONFIG_MXL_OF_DTB_UBOOT_EXT
	bool "Enable external UBOOT DTB"
	depends on UBOOT_CONFIG_OF_SEPARATE && UBOOT_CONFIG_BOOT_FROM_EMMC && UBOOT_CONFIG_UBOOT_IN_USER_PART
	help
	  Uboot External DTB located in emmc user partition "uboot_dtb_a" && "uboot_dtb_b"

config UBOOT_CONFIG_MXL_OF_DTB_UBOOT_ADDR
	hex "DTB Address"
	default 0xD00000
	depends on UBOOT_CONFIG_MXL_OF_DTB_UBOOT_EXT

endmenu # UBOOT External DTB
endif # VENDOR_MAXLINEAR

endif
```

## open_uboot/config/board/mscc/jr2/Kconfig
```kconfig
# SPDX-License-Identifier: (GPL-2.0+ OR MIT)

config UBOOT_CONFIG_SYS_VENDOR
	default "mscc"

if UBOOT_CONFIG_SOC_JR2

config UBOOT_CONFIG_SYS_BOARD
	default "jr2"

config UBOOT_CONFIG_SYS_CONFIG_NAME
	default "jr2"

endif
```

## open_uboot/config/board/mscc/ocelot/Kconfig
```kconfig
# SPDX-License-Identifier: (GPL-2.0+ OR MIT)

config UBOOT_CONFIG_SYS_VENDOR
	default "mscc"

if UBOOT_CONFIG_SOC_OCELOT

config UBOOT_CONFIG_SYS_BOARD
	default "ocelot"

config UBOOT_CONFIG_SYS_CONFIG_NAME
	default "ocelot"

endif
```

## open_uboot/config/board/mscc/servalt/Kconfig
```kconfig
# SPDX-License-Identifier: (GPL-2.0+ OR MIT)

config UBOOT_CONFIG_SYS_VENDOR
	default "mscc"

if UBOOT_CONFIG_SOC_SERVALT

config UBOOT_CONFIG_SYS_BOARD
	default "servalt"

config UBOOT_CONFIG_SYS_CONFIG_NAME
	default "servalt"

endif
```

## open_uboot/config/board/myir/mys_6ulx/Kconfig
```kconfig
if UBOOT_CONFIG_TARGET_MYS_6ULX

config UBOOT_CONFIG_SYS_BOARD
	default "mys_6ulx"

config UBOOT_CONFIG_SYS_VENDOR
	default "myir"

config UBOOT_CONFIG_SYS_CONFIG_NAME
	default "mys_6ulx"

endif
```

## open_uboot/config/board/netgear/cg3100d/Kconfig
```kconfig
if UBOOT_CONFIG_BOARD_NETGEAR_CG3100D

config UBOOT_CONFIG_SYS_BOARD
	default "cg3100d"

config UBOOT_CONFIG_SYS_VENDOR
	default "netgear"

config UBOOT_CONFIG_SYS_CONFIG_NAME
	default "netgear_cg3100d"

endif
```

## open_uboot/config/board/nokia/rx51/Kconfig
```kconfig
if UBOOT_CONFIG_TARGET_NOKIA_RX51

config UBOOT_CONFIG_SYS_BOARD
	default "rx51"

config UBOOT_CONFIG_SYS_VENDOR
	default "nokia"

config UBOOT_CONFIG_SYS_CONFIG_NAME
	default "nokia_rx51"

endif
```

## open_uboot/config/board/novtech/meerkat96/Kconfig
```kconfig
if UBOOT_CONFIG_TARGET_MEERKAT96

config UBOOT_CONFIG_SYS_BOARD
	default "meerkat96"

config UBOOT_CONFIG_SYS_VENDOR
	default "novtech"

config UBOOT_CONFIG_SYS_CONFIG_NAME
	default "meerkat96"

config UBOOT_CONFIG_IMX_CONFIG
	default "board/novtech/meerkat96/imximage.cfg"

endif
```

## open_uboot/config/board/nvidia/beaver/Kconfig
```kconfig
if UBOOT_CONFIG_TARGET_BEAVER

config UBOOT_CONFIG_SYS_BOARD
	default "beaver"

config UBOOT_CONFIG_SYS_VENDOR
	default "nvidia"

config UBOOT_CONFIG_SYS_CONFIG_NAME
	default "beaver"

endif
```

## open_uboot/config/board/nvidia/cardhu/Kconfig
```kconfig
if UBOOT_CONFIG_TARGET_CARDHU

config UBOOT_CONFIG_SYS_BOARD
	default "cardhu"

config UBOOT_CONFIG_SYS_VENDOR
	default "nvidia"

config UBOOT_CONFIG_SYS_CONFIG_NAME
	default "cardhu"

endif
```
