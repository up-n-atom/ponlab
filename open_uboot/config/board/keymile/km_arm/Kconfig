## open_uboot/config/board/nvidia/dalmore/Kconfig
```kconfig
if UBOOT_CONFIG_TARGET_DALMORE

config UBOOT_CONFIG_SYS_BOARD
	default "dalmore"

config UBOOT_CONFIG_SYS_VENDOR
	default "nvidia"

config UBOOT_CONFIG_SYS_CONFIG_NAME
	default "dalmore"

endif
```

## open_uboot/config/board/nvidia/jetson-tk1/Kconfig
```kconfig
if UBOOT_CONFIG_TARGET_JETSON_TK1

config UBOOT_CONFIG_SYS_BOARD
	default "jetson-tk1"

config UBOOT_CONFIG_SYS_VENDOR
	default "nvidia"

config UBOOT_CONFIG_SYS_CONFIG_NAME
	default "jetson-tk1"

endif
```

## open_uboot/config/board/nvidia/p2371-0000/Kconfig
```kconfig
if UBOOT_CONFIG_TARGET_P2371_0000

config UBOOT_CONFIG_SYS_BOARD
	default "p2371-0000"

config UBOOT_CONFIG_SYS_VENDOR
	default "nvidia"

config UBOOT_CONFIG_SYS_CONFIG_NAME
	default "p2371-0000"

endif
```

## open_uboot/config/board/nvidia/p2371-2180/Kconfig
```kconfig
if UBOOT_CONFIG_TARGET_P2371_2180

config UBOOT_CONFIG_SYS_BOARD
	default "p2371-2180"

config UBOOT_CONFIG_SYS_VENDOR
	default "nvidia"

config UBOOT_CONFIG_SYS_CONFIG_NAME
	default "p2371-2180"

endif
```

## open_uboot/config/board/nvidia/p2571/Kconfig
```kconfig
if UBOOT_CONFIG_TARGET_P2571

config UBOOT_CONFIG_SYS_BOARD
	default "p2571"

config UBOOT_CONFIG_SYS_VENDOR
	default "nvidia"

config UBOOT_CONFIG_SYS_CONFIG_NAME
	default "p2571"

endif
```
