## open_uboot/config/board/keymile/km_arm/Kconfig
```kconfig
menu "KM ARM Options"
	depends on UBOOT_CONFIG_ARM

config UBOOT_CONFIG_KM_FPGA_CONFIG
	bool "FPGA Configuration"
	help
	  Include capability to change FPGA configuration.

config UBOOT_CONFIG_KM_FPGA_FORCE_CONFIG
	bool "FPGA reconfiguration"
	help
	  If yes we force to reconfigure the FPGA always

config UBOOT_CONFIG_KM_FPGA_NO_RESET
	bool "FPGA skip reset"
	help
	  If yes we skip triggering a reset of the FPGA

config UBOOT_CONFIG_KM_ENV_IS_IN_SPI_NOR
	bool "Environment in SPI NOR"
	help
	  Put the U-Boot environment in the SPI NOR flash.

config UBOOT_CONFIG_KM_PIGGY4_88E6061
	bool "Piggy via Switch 88E6061"
	help
	  The Piggy4 board is connected via a Marvell 88E6061 switch.

config UBOOT_CONFIG_KM_PIGGY4_88E6352
	bool "Piggy via Switch 88E6352"
	help
	  The Piggy4 board is connected via a Marvell 88E6352 switch.

endmenu

if UBOOT_CONFIG_TARGET_KM_KIRKWOOD

config UBOOT_CONFIG_SYS_BOARD
	default "km_arm"

config UBOOT_CONFIG_SYS_VENDOR
	default "keymile"

config UBOOT_CONFIG_SYS_CONFIG_NAME
	default "km_kirkwood"

config UBOOT_CONFIG_BOARD_SPECIFIC_OPTIONS # dummy
	def_bool y
	select UBOOT_CONFIG_BOARD_LATE_INIT
	select UBOOT_CONFIG_DM
	select UBOOT_CONFIG_DM_ETH
	select UBOOT_CONFIG_DM_SERIAL
	select UBOOT_CONFIG_DM_SPI
	select UBOOT_CONFIG_DM_SPI_FLASH
	select UBOOT_CONFIG_USB
	select UBOOT_CONFIG_USB_EHCI_HCD
	select UBOOT_CONFIG_USB_EHCI_MARVELL
	imply CMD_CRAMFS
	imply CMD_DIAG
	imply FS_CRAMFS
	imply CMD_USB

endif
```

## open_uboot/config/board/keymile/kmcent2/Kconfig
```kconfig
if UBOOT_CONFIG_TARGET_KMCENT2

config UBOOT_CONFIG_SYS_BOARD
	default "kmcent2"

config UBOOT_CONFIG_SYS_VENDOR
	default "keymile"

config UBOOT_CONFIG_SYS_CONFIG_NAME
	default "kmcent2"

config UBOOT_CONFIG_BOARD_SPECIFIC_OPTIONS
	def_bool y
	select UBOOT_CONFIG_ARCH_T1040
	select UBOOT_CONFIG_PHYS_64BIT

endif
```

## open_uboot/config/board/keymile/pg-wcom-ls102xa/Kconfig
```kconfig
if UBOOT_CONFIG_TARGET_PG_WCOM_SELI8

config UBOOT_CONFIG_SYS_BOARD
	default "pg-wcom-ls102xa"

config UBOOT_CONFIG_SYS_VENDOR
	default "keymile"

config UBOOT_CONFIG_SYS_SOC
	default "ls102xa"

config UBOOT_CONFIG_SYS_CONFIG_NAME
	default "pg-wcom-seli8"

config UBOOT_CONFIG_BOARD_SPECIFIC_OPTIONS
	def_bool y
	imply FS_CRAMFS

endif

if UBOOT_CONFIG_TARGET_PG_WCOM_EXPU1

config UBOOT_CONFIG_SYS_BOARD
	default "pg-wcom-ls102xa"

config UBOOT_CONFIG_SYS_VENDOR
	default "keymile"

config UBOOT_CONFIG_SYS_SOC
	default "ls102xa"

config UBOOT_CONFIG_SYS_CONFIG_NAME
	default "pg-wcom-expu1"

config UBOOT_CONFIG_BOARD_SPECIFIC_OPTIONS
	def_bool y
	imply FS_CRAMFS

endif
```

## open_uboot/config/board/kmc/kzm9g/Kconfig
```kconfig
if UBOOT_CONFIG_TARGET_KZM9G

config UBOOT_CONFIG_SYS_BOARD
	default "kzm9g"

config UBOOT_CONFIG_SYS_VENDOR
	default "kmc"

config UBOOT_CONFIG_SYS_CONFIG_NAME
	default "kzm9g"

endif
```

## open_uboot/config/board/kontron/sl-mx8mm/Kconfig
```kconfig
if UBOOT_CONFIG_TARGET_KONTRON_MX8MM

config UBOOT_CONFIG_SYS_BOARD
	string
	default "sl-mx8mm"

config UBOOT_CONFIG_SYS_VENDOR
	string
	default "kontron"

config UBOOT_CONFIG_SYS_CONFIG_NAME
	string
	default "kontron-sl-mx8mm"

endif
```

## open_uboot/config/board/kosagi/novena/Kconfig
```kconfig
if UBOOT_CONFIG_TARGET_KOSAGI_NOVENA

config UBOOT_CONFIG_SYS_BOARD
	default "novena"

config UBOOT_CONFIG_SYS_VENDOR
	default "kosagi"

config UBOOT_CONFIG_SYS_CONFIG_NAME
	default "novena"

endif
```

## open_uboot/config/board/l+g/vinco/Kconfig
```kconfig
if UBOOT_CONFIG_TARGET_VINCO

config UBOOT_CONFIG_SYS_BOARD
	default "vinco"

config UBOOT_CONFIG_SYS_VENDOR
	default "l+g"

config UBOOT_CONFIG_SYS_CONFIG_NAME
	default "vinco"

endif
```

## open_uboot/config/board/lego/ev3/Kconfig
```kconfig
if UBOOT_CONFIG_TARGET_LEGOEV3

config UBOOT_CONFIG_SYS_BOARD
	default "ev3"

config UBOOT_CONFIG_SYS_VENDOR
	default "lego"

config UBOOT_CONFIG_SYS_CONFIG_NAME
	default "legoev3"

endif
```

## open_uboot/config/board/liebherr/display5/Kconfig
```kconfig
if UBOOT_CONFIG_TARGET_DISPLAY5

config UBOOT_CONFIG_SYS_CPU
	default "armv7"

config UBOOT_CONFIG_SYS_BOARD
	default "display5"

config UBOOT_CONFIG_SYS_VENDOR
	default "liebherr"

config UBOOT_CONFIG_SYS_SOC
	default "mx6"

config UBOOT_CONFIG_SYS_CONFIG_NAME
	default "display5"

endif
```

## open_uboot/config/board/liebherr/xea/Kconfig
```kconfig
if UBOOT_CONFIG_TARGET_XEA

config UBOOT_CONFIG_SYS_BOARD
	default "xea"

config UBOOT_CONFIG_SYS_VENDOR
	default "liebherr"

config UBOOT_CONFIG_SYS_SOC
	default "mxs"

config UBOOT_CONFIG_SYS_CONFIG_NAME
	default "xea"

config UBOOT_CONFIG_ENV_SIZE
	default 0x2000

config UBOOT_CONFIG_ENV_SECT_SIZE
	default 0x10000 if UBOOT_CONFIG_ENV_IS_IN_SPI_FLASH

config UBOOT_CONFIG_ENV_OFFSET
	default 0x80000 if UBOOT_CONFIG_ENV_IS_IN_SPI_FLASH

endif
```
