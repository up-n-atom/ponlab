## open_uboot/config/lib/optee/Kconfig
```kconfig
config UBOOT_CONFIG_OPTEE_LIB
	bool "Support OPTEE library"
	default y if UBOOT_CONFIG_OPTEE || UBOOT_CONFIG_OPTEE_IMAGE
	help
	  Selecting this option will enable the shared OPTEE library code.

config UBOOT_CONFIG_OPTEE_IMAGE
	bool "Support OPTEE images"
	help
	  Selecting this option to boot OPTEE images.
	  This option enable the OPTEE specific checks done before booting
	  an OPTEE image created with mkimage

config UBOOT_CONFIG_BOOTM_OPTEE
	bool "Support OPTEE bootm command"
	select UBOOT_CONFIG_BOOTM_LINUX
	select UBOOT_CONFIG_OPTEE_IMAGE
	help
	  Select this command to enable chain-loading of a Linux kernel
	  via an OPTEE firmware.
	  The bootflow is BootROM -> u-boot -> OPTEE -> Linux in this case.
```

## open_uboot/config/scripts/kconfig/tests/choice_value_with_m_dep/Kconfig
```kconfig
config UBOOT_CONFIG_MODULES
	def_bool y
	option modules

config UBOOT_CONFIG_DEP
	tristate
	default m

choice
	prompt "Tristate Choice"

config UBOOT_CONFIG_CHOICE0
	tristate "Choice 0"

config UBOOT_CONFIG_CHOICE1
	tristate "Choice 1"
	depends on UBOOT_CONFIG_DEP

endchoice
```

## open_uboot/config/scripts/kconfig/tests/inter_choice/Kconfig
```kconfig
config UBOOT_CONFIG_MODULES
	def_bool y
	option modules

choice
	prompt "Choice"

config UBOOT_CONFIG_CHOICE_VAL0
	tristate "Choice 0"

config UBOOT_CONFIG_CHOIVE_VAL1
	tristate "Choice 1"

endchoice

choice
	prompt "Another choice"
	depends on UBOOT_CONFIG_CHOICE_VAL0

config UBOOT_CONFIG_DUMMY
	bool "dummy"

endchoice
```

## open_uboot/config/scripts/kconfig/tests/no_write_if_dep_unmet/Kconfig
```kconfig
config UBOOT_CONFIG_A
	bool "A"

choice
	prompt "Choice ?"
	depends on UBOOT_CONFIG_A

config UBOOT_CONFIG_CHOICE_B
	bool "Choice B"

config UBOOT_CONFIG_CHOICE_C
	bool "Choice C"

endchoice
```

## open_uboot/config/test/env/Kconfig
```kconfig
config UBOOT_CONFIG_UT_ENV
	bool "Enable env unit tests"
	depends on UBOOT_CONFIG_UNIT_TEST
	default y
	help
	  This enables the 'ut env' command which runs a series of unit
	  tests on the env code.
	  If all is well then all tests pass although there will be a few
	  messages printed along the way.
```

## open_uboot/config/test/overlay/Kconfig
```kconfig
config UBOOT_CONFIG_UT_OVERLAY
	bool "Enable Device Tree Overlays Unit Tests"
	depends on UBOOT_CONFIG_UNIT_TEST && UBOOT_CONFIG_OF_CONTROL
	default y
	select UBOOT_CONFIG_OF_LIBFDT_OVERLAY
	help
	  This enables the 'ut overlay' command which runs a series of unit
	  tests on the fdt overlay code.
	  If all is well then all tests pass although there will be a few
	  messages printed along the way.
```

## speedtest/config/Config.in
```kconfig
if PACKAGE_speedtest-modules

config SPEEDTEST_IPERF_OPTION
    bool "speedtest with iperf2"
    select PACKAGE_iperf
    default y
    help
        This config enables iperf2. To disable iperf2,
        user must disable this config and then disable iperf2 at its config path.

config SPEEDTEST_IPERF3_OPTION
    bool "speedtest with iperf3"
    select PACKAGE_iperf3
    default y
    help
        This config enables iperf3. To disable iperf3,
        user must disable this config and then disable iperf3 at its config path.

config SPEEDTEST_CURL_OPTION
    bool "speedtest with curl"
    select PACKAGE_curl
    default y
    help
        This config enables client-side curl. To disable curl,
        user must disable this config and then disable curl at its config path.

config SPEEDTEST_OBUDPST_OPTION
    bool "speedtest with obudpst"
    select PACKAGE_obudpst
    default y
    help
        This config enables ob-udpst. To disable ob-udpst,
        user must disable this config and then disable ob-udpst at its config path.

config SPEEDTEST_TR143_OPTION
    bool "speedtest with HTTP based TR-143 diagnostic tool"
	select PACKAGE_kmod-dnsresolver
	select PACKAGE_kmod-speedtest-driver
	select PACKAGE_tr143diagtool
    default y
    help
        This config enables Maxlinear speedtest kernel module based on TR-143 used for network
        performance measurement.
        To disable it, user must disable this config and then disable driver at
        its config path in make menuconfig.

endif
```

## sse_driver/config/Config.in
```kconfig
config EIP123_SUPPORT
	bool 'Enable EIP123 Support'
	depends on INTEL_MIPS_KEYS_PROVISION
	default y
	help
	  Enable EIP123 SUPPORT

config EIP123_DEBUG
	bool 'Enable Debug'
	depends on INTEL_MIPS_KEYS_PROVISION
	help
	  Enable debug messages

config SECURE_BOOT_AUTH_SUPPORT
	bool 'Enable secure upgrade support'
	depends on INTEL_MIPS_KEYS_PROVISION
	default y
	help
	  Enable Secure Boot Authentication Support 
```

## sse_fapi_lgm/config/Config.in
```kconfig
config LGM_EIP123_SUPPORT
	bool 'Enable EIP123 Support'
	help
	  Enable EIP123 SUPPORT

config LGM_EIP123_DEBUG
	bool 'Enable Debug'
	help
	  Enable debug messages

config LGM_SECURE_BOOT_AUTH_SUPPORT
	bool 'Enable SECURE_BOOT_AUTH_SUPPORT support'
	help
	  Enable Secure Boot Authentication Support 
```

## sse_server/config/Config.in
```kconfig
config SSE_SERVER_DEBUG
	bool 'Enable Debug'
	default n
	help
		Enable debug messages

config SSE_OTP_ROLLBACK_ID
	bool 'Enable Anti-Rollback Id Support'
	default n
	help
		Enable Anti-Rollback Id Support
```

## upgrade_utils/config/Config.in
```kconfig
config FEATURE_WMD
	bool 'HS 2.0 WAN Metrics and QOS Rate Update functionality'
	depends on FEATURE_LTQ_IPQOS && PACKAGE_switch_cli
	default y
	help
	  Sends HS 2.0 Wan Metrics and does QOS rate update functionality

config FEATURE_READ_IMG	
	bool 'read_img'
	default n
	help 
		Enables read_img utility
config FEATURE_UPGRADE
	bool 'upgrade'
	default n
	help 
			Enables upgrade utility
config FEATURE_uboot_env			
	bool 'uboot_env'
	default n
	help 
		Enables uboot_env utility
```

## xrx500/uboot_configs/grx500-mr-cpe-secboot_defconfig
```kconfig
CONFIG_MIPS=y
CONFIG_SPL_SYS_MALLOC_SIMPLE=y
CONFIG_LANTIQ=y
CONFIG_SYS_TEXT_BASE=0xA0400000
CONFIG_LANTIQ_UBOOT_grx500=y
CONFIG_LTQ_SECURE_BOOT=y
# CONFIG_CERTIFICATION_SUPPORT is not set
CONFIG_IFX_MEMORY_SIZE=224
CONFIG_NAND_ECC_BCH=y
CONFIG_SPL_OOBSIZE=128
CONFIG_NAND_FLASH_128M=y
CONFIG_NAND_PAGE_SIZE=0x800
CONFIG_NAND_BLOCK_SIZE=0x20000
CONFIG_NAND_SPL_BLOCK_SIZE=0xA000
CONFIG_FIRMWARE_IN_ROOTFS=y
CONFIG_GRX500_A21=y
# CONFIG_GRX500_THERMAL is not set
CONFIG_TOS_32M=y
CONFIG_GRX500_CPU_800M=y
CONFIG_GRX500_CBM_FREQ_600M=y
CONFIG_ENV_REDUND=y
CONFIG_BUILD_ENV_BLOCK=y
CONFIG_MEM="224M"
CONFIG_PHYM="224M"
CONFIG_CONSOLE="ttyLTQ0"
CONFIG_ROOTFSMTD="/dev/mtdblock6"
CONFIG_NFSARGS="setenv bootargs ubi.mtd=system_sw root=/dev/nfs rw nfsroot=${serverip}:${rootpath}"
CONFIG_FLASHARGS="setenv bootargs ubi.mtd=system_sw root=/dev/ram ro rd_start=${initrd_start} rd_size=${initrd_size}"
CONFIG_ADDMISC="setenv bootargs ${bootargs} console=${console},${baudrate} ethaddr=${ethaddr} panic=1 ${mtdparts} init=/etc/preinit active_bank=${active_bank} update_chk=${update_chk} maxcpus=4 pci=pcie_bus_perf ubootver=${ver} mem=480M@512M ${custom}"
CONFIG_BOOT_CORE="openwrt-intel_mips-xrx500_4kec-easy350550_bootcore-initramfs-kernel.bin"
CONFIG_MTDIDS="nand0=17c00000.nand-parts"
# CONFIG_USE_DEFAULT_MTDPARTS is not set
CONFIG_MTDPARTS="mtdparts=17c00000.nand-parts:1m(uboot),256k(ubootconfigA),256k(ubootconfigB),256k(gphyfirmware),1m(calibration),250m(system_sw),-(res)"
CONFIG_NET_RAM="run run_bootcore;tftp ${loadaddr} ${tftppath}${bootfile}; run ramargs addip addmisc; bootm"
CONFIG_NET_FLASH="run run_bootcore;tftp ${loadaddr} ${tftppath}${bootfile}; run flashargs addip addmisc; bootm"
CONFIG_NET_NFS="run run_bootcore;tftp ${loadaddr} ${tftppath}${bootfile};run nfsargs addip addmisc;bootm"
CONFIG_FLASH_FLASH="run run_bootcore;ubi read 0xA07FFFC0 ${kernel_vol};auth_initrd 0xA07FFFC0;run flashargs addmisc;bootm 0xA0800000;reset"
CONFIG_UPDATE_NANDBOOT="if tftp ${loadaddr} ${tftppath}u-boot-nand.bin;then nand erase 0 100000;nand erase 2C0000 FA00000;nand write.partial ${loadaddr} 0 ${filesize};else echo Image not found!!;fi"
CONFIG_UPDATE_UBOOT="if tftp ${loadaddr} ${tftppath}${u-boot};then nand write.partial ${loadaddr} 0x4000 ${filesize};else echo Image not found!!;fi;reset"
CONFIG_UPDATE_BOOTLOADER="run update_uboot;run update_gphyfirmware;"
CONFIG_UPDATE_KERNEL="run ubi_init;if tftpboot ${loadaddr} ${tftppath}${bootfile};then run switchbankB;upgrade ${loadaddr} ${filesize};run switchbankA;set update_chk 0;upgrade ${loadaddr} ${filesize};else echo Image not found!!;fi"
CONFIG_UPDATE_ROOTFS="run ubi_init;if tftpboot ${loadaddr} ${tftppath}${rootfs};then run switchbankB;upgrade ${loadaddr} ${filesize};run switchbankA;set update_chk 0;upgrade ${loadaddr} ${filesize};else echo Image not found!!;fi"
CONFIG_UPDATE_GPHYFIRMWARE="if tftpboot ${loadaddr} ${tftppath}gphy_firmware.img;then nand write.partial ${loadaddr} 0x180000 ${filesize};else echo Image not found!!;fi;re"
CONFIG_UPDATE_FULLIMAGE="run ubi_init;if tftpboot ${loadaddr} ${tftppath}${fullimage};then run switchbankB;upgrade ${loadaddr} ${filesize};run switchbankA;set update_chk 0;upgrade ${loadaddr} ${filesize}; ubi create rootfs_data 0x2000000;else echo Image not found!!;fi"
CONFIG_UPDATE_TOTALIMAGE="run ubi_init;if tftpboot ${loadaddr} ${tftppath}${totalimage};then upgrade ${loadaddr} ${filesize};else echo Image not found!!;fi"
CONFIG_UPDATE_BOOTCORE="run ubi_init;if tftpboot ${loadaddr} ${tftppath}${bootcore};then run switchbankB;upgrade ${loadaddr} ${filesize};run switchbankA;set update_chk 0;upgrade ${loadaddr} ${filesize};else echo Image not found!!;fi"
CONFIG_RUN_BOOTCORE="run ubi_init; ubi read 0xA03FFFC0 ${bootcore_vol};secboot load_os 0xDEADBEEF 0xA0400000 0x200000;secboot wait_os"
CONFIG_UBI_INIT="setenv kernelA_id 0;setenv rootfsA_id 1;setenv firmwareA_id 2;setenv kernelB_id 3;setenv rootfsB_id 4;setenv firmwareB_id 5;setenv bootcoreA_id 6; setenv bootcoreB_id 7;setenv setbank check_image${update_chk};run ${setbank};ubi part system_sw"
CONFIG_DUAL_IMAGE=y
CONFIG_SWITCH_BANKA="setenv active_bank A;setenv kernel_id ${kernelA_id};setenv rootfs_id ${rootfsA_id};setenv f_kernel_size f_kernel_sizeA;setenv kernel_vol kernelA;setenv rootfs_vol rootfsA;setenv firmware_vol firmwareA;setenv rootfsname rootfsA;setenv bootcore_vol bootcoreA"
CONFIG_SWITCH_BANKB="setenv active_bank B;setenv kernel_id ${kernelB_id};setenv rootfs_id ${rootfsB_id};setenv f_kernel_size f_kernel_sizeB;setenv kernel_vol kernelB;setenv rootfs_vol rootfsB;setenv firmware_vol firmwareB;setenv rootfsname rootfsB;setenv bootcore_vol bootcoreB"
CONFIG_SPL=y
CONFIG_EXT_SPL_PATH="arch/mips/mach-lantiq/grx500/nand_spl"
CONFIG_NAND_BOOT=y
CONFIG_HUSH_PARSER=y
# CONFIG_CMD_BDI is not set
# CONFIG_CMD_CONSOLE is not set
# CONFIG_CMD_BOOTD is not set
# CONFIG_CMD_ELF is not set
# CONFIG_CMD_IMI is not set
# CONFIG_CMD_IMLS is not set
# CONFIG_CMD_XIMG is not set
CONFIG_CMD_BOOT_TOS=y
# CONFIG_CMD_EXPORTENV is not set
# CONFIG_CMD_IMPORTENV is not set
# CONFIG_CMD_EDITENV is not set
# CONFIG_CMD_ENV_EXISTS is not set
# CONFIG_CMD_CRC32 is not set
# CONFIG_CMD_LOADB is not set
# CONFIG_CMD_LOADS is not set
# CONFIG_CMD_FLASH is not set
# CONFIG_CMD_FPGA is not set
# CONFIG_CMD_ITEST is not set
# CONFIG_CMD_SOURCE is not set
# CONFIG_CMD_SETEXPR is not set
# CONFIG_CMD_NFS is not set
CONFIG_CMD_AUTH=y
CONFIG_CMD_UBI=y
# CONFIG_NET_TFTP_VARS is not set
# CONFIG_PARTITIONS is not set
```
