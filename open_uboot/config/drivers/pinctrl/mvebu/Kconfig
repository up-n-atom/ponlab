## open_uboot/config/drivers/pinctrl/mvebu/Kconfig
```kconfig
if UBOOT_CONFIG_ARCH_MVEBU

config UBOOT_CONFIG_PINCTRL_ARMADA_37XX
	depends on UBOOT_CONFIG_ARMADA_3700 && UBOOT_CONFIG_PINCTRL_FULL
	bool "Armada 37xx pin control driver"
	help
	   Support pin multiplexing and pin configuration control on
	   Marvell's Armada-37xx SoC.

config UBOOT_CONFIG_PINCTRL_ARMADA_8K
	depends on UBOOT_CONFIG_ARMADA_8K && UBOOT_CONFIG_PINCTRL_FULL
	bool "Armada 7k/8k pin control driver"
	help
	   Support pin multiplexing and pin configuration control on
	   Marvell's Armada-8K SoC.

endif
```

## open_uboot/config/drivers/pinctrl/nxp/Kconfig
```kconfig
config UBOOT_CONFIG_PINCTRL_IMX
	bool

config UBOOT_CONFIG_PINCTRL_IMX_SCU
	bool

config UBOOT_CONFIG_PINCTRL_IMX5
	bool "IMX5 pinctrl driver"
	depends on UBOOT_CONFIG_ARCH_MX5 && UBOOT_CONFIG_PINCTRL_FULL
	select UBOOT_CONFIG_DEVRES
	select UBOOT_CONFIG_PINCTRL_IMX
	help
	  Say Y here to enable the imx5 pinctrl driver

	  This provides a simple pinctrl driver for i.MX 53SoC familiy,
	  i.MX53. This feature depends on device tree
	  configuration. This driver is different from the linux one,
	  this is a simple implementation, only parses the 'fsl,pins'
	  property and configure related registers.

config UBOOT_CONFIG_PINCTRL_IMX6
	bool "IMX6 pinctrl driver"
	depends on UBOOT_CONFIG_ARCH_MX6 && UBOOT_CONFIG_PINCTRL_FULL
	select UBOOT_CONFIG_DEVRES
	select UBOOT_CONFIG_PINCTRL_IMX
	help
	  Say Y here to enable the imx6 pinctrl driver

	  This provides a simple pinctrl driver for i.MX6 SoC familiy,
	  i.MX6DQ/SL/SX/UL/DQP. This feature depends on device tree
	  configuration. This driver is different from the linux one,
	  this is a simple implementation, only parses the 'fsl,pins'
	  property and configure related registers.

config UBOOT_CONFIG_PINCTRL_IMX7
	bool "IMX7 pinctrl driver"
	depends on UBOOT_CONFIG_ARCH_MX7 && UBOOT_CONFIG_PINCTRL_FULL
	select UBOOT_CONFIG_DEVRES
	select UBOOT_CONFIG_PINCTRL_IMX
	help
	  Say Y here to enable the imx7 pinctrl driver

	  This provides a simple pinctrl driver for i.MX7 SoC familiy,
	  i.MX7D. This feature depends on device tree
	  configuration. This driver is different from the linux one,
	  this is a simple implementation, only parses the 'fsl,pins'
	  property and configure related registers.

config UBOOT_CONFIG_PINCTRL_IMX7ULP
	bool "IMX7ULP pinctrl driver"
	depends on UBOOT_CONFIG_ARCH_MX7ULP && UBOOT_CONFIG_PINCTRL_FULL
	select UBOOT_CONFIG_DEVRES
	select UBOOT_CONFIG_PINCTRL_IMX
	help
	  Say Y here to enable the imx7ulp pinctrl driver

	  This provides a simple pinctrl driver for i.MX7ULP SoC familiy.
	  This feature depends on device tree configuration. This driver
	  is different from the linux one, this is a simple implementation,
	  only parses the 'fsl,pins' property and configure related
	  registers.

config UBOOT_CONFIG_PINCTRL_IMX8ULP
	bool "IMX8ULP pinctrl driver"
	depends on UBOOT_CONFIG_ARCH_IMX8ULP && UBOOT_CONFIG_PINCTRL_FULL
	select UBOOT_CONFIG_DEVRES
	select UBOOT_CONFIG_PINCTRL_IMX
	help
	  Say Y here to enable the imx8ulp pinctrl driver

	  This provides a simple pinctrl driver for i.MX8ULP SoC familiy.
	  This feature depends on device tree configuration. This driver
	  is different from the linux one, this is a simple implementation,
	  only parses the 'fsl,pins' property and configure related
	  registers.

config UBOOT_CONFIG_PINCTRL_IMX8
	bool "IMX8 pinctrl driver"
	depends on UBOOT_CONFIG_ARCH_IMX8 && UBOOT_CONFIG_PINCTRL_FULL
	select UBOOT_CONFIG_DEVRES
	select UBOOT_CONFIG_PINCTRL_IMX
	select UBOOT_CONFIG_PINCTRL_IMX_SCU
	help
	  Say Y here to enable the imx8 pinctrl driver

	  This provides a simple pinctrl driver for i.MX8 SoC familiy.
	  This feature depends on device tree configuration. This driver
	  is different from the linux one, this is a simple implementation,
	  only parses the 'fsl,pins' property and configures related
	  registers.

config UBOOT_CONFIG_PINCTRL_IMX8M
	bool "IMX8M pinctrl driver"
	depends on UBOOT_CONFIG_ARCH_IMX8M && UBOOT_CONFIG_PINCTRL_FULL
	select UBOOT_CONFIG_DEVRES
	select UBOOT_CONFIG_PINCTRL_IMX
	help
	  Say Y here to enable the imx8m pinctrl driver

	  This provides a simple pinctrl driver for i.MX8M SoC familiy.
	  This feature depends on device tree configuration. This driver
	  is different from the linux one, this is a simple implementation,
	  only parses the 'fsl,pins' property and configure related
	  registers.

config UBOOT_CONFIG_PINCTRL_MXS
	bool "NXP MXS pinctrl driver"
	depends on UBOOT_CONFIG_ARCH_MX28 && UBOOT_CONFIG_PINCTRL_FULL
	help
	  Say Y here to enable the i.MX mxs pinctrl driver

	  This option provides a simple pinctrl driver for i.MX mxs SoC
	  familiy, e.g. i.MX28. This feature depends on device tree
	  configuration.

config UBOOT_CONFIG_PINCTRL_IMXRT
	bool "IMXRT pinctrl driver"
	depends on UBOOT_CONFIG_ARCH_IMXRT && UBOOT_CONFIG_PINCTRL_FULL
	select UBOOT_CONFIG_DEVRES
	select UBOOT_CONFIG_PINCTRL_IMX
	help
	  Say Y here to enable the imxrt pinctrl driver

	  This provides a simple pinctrl driver for i.MXRT SoC familiy.
	  This feature depends on device tree configuration. This driver
	  is different from the linux one, this is a simple implementation,
	  only parses the 'fsl,pins' property and configure related
	  registers.

config UBOOT_CONFIG_PINCTRL_VYBRID
	bool "Vybrid (vf610) pinctrl driver"
	depends on UBOOT_CONFIG_ARCH_VF610 && UBOOT_CONFIG_PINCTRL_FULL
	select UBOOT_CONFIG_DEVRES
	select UBOOT_CONFIG_PINCTRL_IMX
	help
	  Say Y here to enable the Vybrid (vf610) pinctrl driver

	  This provides a simple pinctrl driver for Vybrid SoC familiy,
	  vf610. This feature depends on device tree
	  configuration. This driver is different from the linux one,
	  this is a simple implementation, only parses the 'fsl,pins'
	  property and configure related registers.
```

## open_uboot/config/drivers/qe/Kconfig
```kconfig
#
# QUICC Engine Drivers
#
config UBOOT_CONFIG_QE
	bool "Enable support for QUICC Engine"
	depends on UBOOT_CONFIG_PPC
	default y if UBOOT_CONFIG_ARCH_T1040 || UBOOT_CONFIG_ARCH_T1042 || UBOOT_CONFIG_ARCH_T1024 || UBOOT_CONFIG_ARCH_P1021 \
		|| ARCH_P1025
	help
	  Chose this option to add support for the QUICC Engine.

config UBOOT_CONFIG_U_QE
	bool "Enable support for U QUICC Engine"
	default y if (UBOOT_CONFIG_ARCH_LS1021A && !UBOOT_CONFIG_SD_BOOT && !UBOOT_CONFIG_NAND_BOOT && !UBOOT_CONFIG_QSPI_BOOT) \
		|| (TARGET_T1024QDS) \
		|| (TARGET_T1024RDB) \
		|| (TARGET_LS1043ARDB && !UBOOT_CONFIG_SPL_NO_QE && !UBOOT_CONFIG_NAND_BOOT && !UBOOT_CONFIG_QSPI_BOOT)
	help
	  Choose this option to add support for U QUICC Engine.

config UBOOT_CONFIG_SYS_QE_FW_ADDR
	hex "QE Firmware Address"
	depends on UBOOT_CONFIG_FMAN_ENET || UBOOT_CONFIG_QE || UBOOT_CONFIG_U_QE
	default 0x0
choice
	prompt "QUICC Engine FMan ethernet firmware location"
	depends on UBOOT_CONFIG_FMAN_ENET || UBOOT_CONFIG_QE
	default UBOOT_CONFIG_SYS_QE_FMAN_FW_IN_ROM

config UBOOT_CONFIG_SYS_QE_FMAN_FW_IN_NOR
	bool "NOR flash"

config UBOOT_CONFIG_SYS_QE_FMAN_FW_IN_NAND
	bool "NAND flash"

config UBOOT_CONFIG_SYS_QE_FMAN_FW_IN_SPIFLASH
	bool "SPI flash"

config UBOOT_CONFIG_SYS_QE_FMAN_FW_IN_MMC
	bool "MMC"

config UBOOT_CONFIG_SYS_QE_FMAN_FW_IN_REMOTE
	bool "Remote memory location (PCI)"

config UBOOT_CONFIG_SYS_QE_FMAN_FW_IN_ROM
	bool "Firmware is already in ROM"

endchoice
```

## open_uboot/config/drivers/ram/aspeed/Kconfig
```kconfig
if UBOOT_CONFIG_RAM || UBOOT_CONFIG_SPL_RAM

config UBOOT_CONFIG_ASPEED_DDR4_DUALX8
	bool "Enable Dual X8 DDR4 die"
	depends on UBOOT_CONFIG_DM && UBOOT_CONFIG_OF_CONTROL && UBOOT_CONFIG_ARCH_ASPEED
	help
		Say Y if dual X8 DDR4 die is used on the board.  The aspeed ddr sdram
		controller needs to know if the memory chip mounted on the board is dual
		 x8 die or not.  Or it may get the wrong size of the memory space.

if UBOOT_CONFIG_ASPEED_AST2600

choice
	prompt "DDR4 target date rate"
	default UBOOT_CONFIG_ASPEED_DDR4_1600

config UBOOT_CONFIG_ASPEED_DDR4_400
	bool "DDR4 targets at 400Mbps"
	depends on UBOOT_CONFIG_DM && UBOOT_CONFIG_OF_CONTROL && UBOOT_CONFIG_ARCH_ASPEED
	help
	  select UBOOT_CONFIG_DDR4 target data rate at 400M

config UBOOT_CONFIG_ASPEED_DDR4_800
	bool "DDR4 targets at 800Mbps"
	depends on UBOOT_CONFIG_DM && UBOOT_CONFIG_OF_CONTROL && UBOOT_CONFIG_ARCH_ASPEED
	help
	  select UBOOT_CONFIG_DDR4 target data rate at 800M

config UBOOT_CONFIG_ASPEED_DDR4_1333
	bool "DDR4 targets at 1333Mbps"
	depends on UBOOT_CONFIG_DM && UBOOT_CONFIG_OF_CONTROL && UBOOT_CONFIG_ARCH_ASPEED
	help
	  select UBOOT_CONFIG_DDR4 target data rate at 1333M

config UBOOT_CONFIG_ASPEED_DDR4_1600
	bool "DDR4 targets at 1600Mbps"
	depends on UBOOT_CONFIG_DM && UBOOT_CONFIG_OF_CONTROL && UBOOT_CONFIG_ARCH_ASPEED
	help
	  select UBOOT_CONFIG_DDR4 target data rate at 1600M
endchoice

config UBOOT_CONFIG_ASPEED_BYPASS_SELFTEST
	bool "bypass self test during DRAM initialization"
	help
	  Say Y here to bypass DRAM self test to speed up the boot time

config UBOOT_CONFIG_ASPEED_ECC
	bool "aspeed SDRAM error correcting code"
	depends on UBOOT_CONFIG_DM && UBOOT_CONFIG_OF_CONTROL && UBOOT_CONFIG_ARCH_ASPEED
	help
	  enable SDRAM ECC function

if UBOOT_CONFIG_ASPEED_ECC
config UBOOT_CONFIG_ASPEED_ECC_SIZE
	int "ECC size: 0=driver auto-caluated"
	depends on UBOOT_CONFIG_ASPEED_ECC
	default 0
	help
	  SDRAM size with the error correcting code enabled. The unit is
	  in Megabytes.  Noted that only the 8/9 of the configured size
	  can be used by the system.  The remaining 1/9 will be used by
	  the ECC engine.  If the size is set to 0, the sdram driver will
	  calculate the SDRAM size and set the whole range be ECC enabled.
endif # end of ASPEED_ECC
endif # end of ASPEED_AST2600
endif # end of RAM || UBOOT_CONFIG_SPL_RAM
```

## open_uboot/config/drivers/ram/stm32mp1/Kconfig
```kconfig
config UBOOT_CONFIG_STM32MP1_DDR
	bool "STM32MP1 DDR driver"
	depends on UBOOT_CONFIG_DM && UBOOT_CONFIG_OF_CONTROL && UBOOT_CONFIG_ARCH_STM32MP
	select UBOOT_CONFIG_RAM
	select UBOOT_CONFIG_SPL_RAM if SPL
	default y
	help
		activate STM32MP1 DDR controller driver for STM32MP1 soc
		family:	support for LPDDR2, LPDDR3 and DDR3
		the SDRAM parameters for controleur and phy need to be provided
		in device tree (computed by DDR tuning tools)

config UBOOT_CONFIG_STM32MP1_DDR_INTERACTIVE
	bool "STM32MP1 DDR driver : interactive support"
	depends on UBOOT_CONFIG_STM32MP1_DDR
	help
		activate interactive support in STM32MP1 DDR controller driver
		used for DDR tuning tools
		to enter in intercative mode type 'd' during SPL DDR driver
		initialisation

config UBOOT_CONFIG_STM32MP1_DDR_INTERACTIVE_FORCE
	bool "STM32MP1 DDR driver : force interactive mode"
	depends on UBOOT_CONFIG_STM32MP1_DDR_INTERACTIVE
	help
		force interactive mode in STM32MP1 DDR controller driver
		skip the polling of character 'd' in console
		useful when SPL is loaded in sysram
		directly by programmer

config UBOOT_CONFIG_STM32MP1_DDR_TESTS
	bool "STM32MP1 DDR driver : tests support"
	depends on UBOOT_CONFIG_STM32MP1_DDR_INTERACTIVE
	default y
	help
		activate test support for interactive support in
		STM32MP1 DDR controller driver: command test

config UBOOT_CONFIG_STM32MP1_DDR_TUNING
	bool "STM32MP1 DDR driver : support of tuning"
	depends on UBOOT_CONFIG_STM32MP1_DDR_INTERACTIVE
	default y
	help
		activate tuning command in STM32MP1 DDR interactive mode
		used for DDR tuning tools
		- DQ Deskew algorithm
		- DQS Trimming
```

## open_uboot/config/drivers/remoteproc/Kconfig
```kconfig
# SPDX-License-Identifier: GPL-2.0+
#
# (C) Copyright 2015
# Texas Instruments Incorporated - http://www.ti.com/
#

menu "Remote Processor drivers"

# REMOTEPROC gets selected by drivers as needed
# All users should depend on DM
config UBOOT_CONFIG_REMOTEPROC
	bool
	depends on UBOOT_CONFIG_DM

# Please keep the configuration alphabetically sorted.
config UBOOT_CONFIG_K3_SYSTEM_CONTROLLER
	bool "Support for TI' K3 System Controller"
	select UBOOT_CONFIG_REMOTEPROC
	depends on UBOOT_CONFIG_DM
	depends on UBOOT_CONFIG_ARCH_K3
	depends on UBOOT_CONFIG_OF_CONTROL
	help
	  Say 'y' here to add support for TI' K3 System Controller.

config UBOOT_CONFIG_REMOTEPROC_SANDBOX
	bool "Support for Test processor for Sandbox"
	select UBOOT_CONFIG_REMOTEPROC
	depends on UBOOT_CONFIG_DM
	depends on UBOOT_CONFIG_SANDBOX
	help
	  Say 'y' here to add support for test processor which does dummy
	  operations for sandbox platform.

config UBOOT_CONFIG_REMOTEPROC_STM32_COPRO
	bool "Support for STM32 coprocessor"
	select UBOOT_CONFIG_REMOTEPROC
	depends on UBOOT_CONFIG_DM
	depends on UBOOT_CONFIG_ARCH_STM32MP
	depends on UBOOT_CONFIG_OF_CONTROL
	help
	  Say 'y' here to add support for STM32 Cortex-M4 coprocessors via the
	  remoteproc framework.

config UBOOT_CONFIG_REMOTEPROC_TI_K3_ARM64
	bool "Support for TI's K3 based ARM64 remoteproc driver"
	select UBOOT_CONFIG_REMOTEPROC
	depends on UBOOT_CONFIG_DM
	depends on UBOOT_CONFIG_ARCH_K3
	depends on UBOOT_CONFIG_OF_CONTROL
	help
	  Say y here to support TI's ARM64 processor subsystems
	  on various TI K3 family of SoCs through the remote processor
	  framework.

config UBOOT_CONFIG_REMOTEPROC_TI_K3_DSP
	bool "TI K3 C66 and C71 remoteproc support"
	select UBOOT_CONFIG_REMOTEPROC
	depends on UBOOT_CONFIG_ARCH_K3
	depends on UBOOT_CONFIG_TI_SCI_PROTOCOL
	help
	  Say y here to support TI's C66/C71 remote processor subsystems
	  on various TI K3 family of SoCs through the remote processor
	  framework.

config UBOOT_CONFIG_REMOTEPROC_TI_K3_R5F
	bool "TI K3 R5F remoteproc support"
	select UBOOT_CONFIG_REMOTEPROC
	depends on UBOOT_CONFIG_ARCH_K3
	depends on UBOOT_CONFIG_TI_SCI_PROTOCOL
	help
	  Say y here to support TI's R5F remote processor subsystems
	  on various TI K3 family of SoCs through the remote processor
	  framework.

config UBOOT_CONFIG_REMOTEPROC_TI_POWER
	bool "Support for TI Power processor"
	select UBOOT_CONFIG_REMOTEPROC
	depends on UBOOT_CONFIG_DM
	depends on UBOOT_CONFIG_ARCH_KEYSTONE
	depends on UBOOT_CONFIG_OF_CONTROL
	help
	  Say 'y' here to add support for TI power processors such as those
	  found on certain TI keystone and OMAP generation SoCs.

config UBOOT_CONFIG_REMOTEPROC_TI_PRU
	bool "Support for TI's K3 based PRU remoteproc driver"
	select UBOOT_CONFIG_REMOTEPROC
	depends on UBOOT_CONFIG_DM
	depends on UBOOT_CONFIG_TI_PRUSS
	depends on UBOOT_CONFIG_ARCH_K3
	depends on UBOOT_CONFIG_OF_CONTROL
	help
	  Say 'y' here to add support for TI' K3 remoteproc driver.

endmenu
```
