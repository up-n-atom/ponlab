## open_uboot/config/drivers/usb/musb/Kconfig
```kconfig
# SPDX-License-Identifier: GPL-2.0+
#
# (C) Copyright 2017
# Adam Ford, Logic PD, aford173@gmail.com

comment "Legacy MUSB Support"

config UBOOT_CONFIG_USB_MUSB_HCD
	bool "Legacy MUSB Host Controller"

config UBOOT_CONFIG_USB_MUSB_UDC
	bool "Legacy USB Device Controller"

config UBOOT_CONFIG_USB_OMAP3
	bool "Legacy MUSB OMAP3 / OMAP4"
	depends on UBOOT_CONFIG_ARCH_OMAP2PLUS

config UBOOT_CONFIG_USB_AM35X
	bool"Legacy MUSB AM35x"
	depends on UBOOT_CONFIG_ARCH_OMAP2PLUS && !UBOOT_CONFIG_USB_OMAP3
```
