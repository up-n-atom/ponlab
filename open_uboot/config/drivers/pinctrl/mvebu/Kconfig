## open_uboot/config/drivers/video/imx/Kconfig
```kconfig
config UBOOT_CONFIG_VIDEO_IPUV3
	bool "i.MX IPUv3 Core video support"
	depends on UBOOT_CONFIG_DM_VIDEO && (MX5 || UBOOT_CONFIG_MX6)
	help
	  This enables framebuffer driver for i.MX processors working
	  on the IPUv3(Image Processing Unit) internal graphic processor.
```

## open_uboot/config/drivers/video/meson/Kconfig
```kconfig
# SPDX-License-Identifier: GPL-2.0+
#
# Copyright (C) 2018 BayLibre, SAS
#
# Author: Neil Armstrong <narmstrong@baylibre.com>

config UBOOT_CONFIG_VIDEO_MESON
	bool "Enable Amlogic Meson video support"
	depends on UBOOT_CONFIG_DM_VIDEO
	select UBOOT_CONFIG_DISPLAY
	help
	  Enable Amlogic Meson Video Processing Unit video support.
```

## open_uboot/config/drivers/video/stm32/Kconfig
```kconfig
# SPDX-License-Identifier: GPL-2.0+
#
# Copyright (C) STMicroelectronics SA 2017
#
# Authors: Philippe Cornu <philippe.cornu@st.com>
#          Yannick Fertre <yannick.fertre@st.com>

menuconfig UBOOT_CONFIG_VIDEO_STM32
	bool "Enable STM32 video support"
	depends on UBOOT_CONFIG_DM_VIDEO
	help
	  STM32 supports many video output options including RGB and
	  DSI. This option enables these supports which can be used on
	  devices which have RGB TFT or DSI display connected.

config UBOOT_CONFIG_VIDEO_STM32_DSI
	bool "Enable STM32 DSI video support"
	depends on UBOOT_CONFIG_VIDEO_STM32
	select UBOOT_CONFIG_VIDEO_BRIDGE
	select UBOOT_CONFIG_VIDEO_DW_MIPI_DSI
	help
	  This option enables support DSI internal bridge which can be used on
	  devices which have DSI devices connected.

config UBOOT_CONFIG_VIDEO_STM32_MAX_XRES
	int "Maximum horizontal resolution (for memory allocation purposes)"
	depends on UBOOT_CONFIG_VIDEO_STM32
	default 640
	help
	  The maximum horizontal resolution to support for the framebuffer.
	  This configuration is used for reserving/allocating memory for the
	  framebuffer during device-model binding/probing.

config UBOOT_CONFIG_VIDEO_STM32_MAX_YRES
	int "Maximum vertical resolution (for memory allocation purposes)"
	depends on UBOOT_CONFIG_VIDEO_STM32
	default 480
	help
	  The maximum vertical resolution to support for the framebuffer.
	  This configuration is used for reserving/allocating memory for the
	  framebuffer during device-model binding/probing.

config UBOOT_CONFIG_VIDEO_STM32_MAX_BPP
	int "Maximum bits per pixel (for memory allocation purposes)"
	depends on UBOOT_CONFIG_VIDEO_STM32
	default 16
	help
	  The maximum bits per pixel to support for the framebuffer.
	  This configuration is used for reserving/allocating memory for the
	  framebuffer during device-model binding/probing.
```

## open_uboot/config/drivers/video/ti/Kconfig
```kconfig
# SPDX-License-Identifier: GPL-2.0+
#
# Copyright (C) 2020 Dario Binacchi <dariobin@libero.it>
#
config UBOOT_CONFIG_AM335X_LCD
	bool "Enable AM335x video support"
	help
	   Supports video output to an attached LCD panel.
```

## open_uboot/config/drivers/w1/Kconfig
```kconfig
#
# W1 subsystem configuration
#

menu "1-Wire support"

config UBOOT_CONFIG_W1
	bool "Enable 1-wire controllers support"
	depends on UBOOT_CONFIG_DM
	help
	  Support for the Dallas 1-Wire bus.

if UBOOT_CONFIG_W1

config UBOOT_CONFIG_W1_GPIO
	bool "Enable 1-wire GPIO bitbanging"
	depends on UBOOT_CONFIG_DM_GPIO
	help
	  Emulate a 1-wire bus using a GPIO.

config UBOOT_CONFIG_W1_MXC
	bool "Enable 1-wire controller on i.MX processors"
	depends on UBOOT_CONFIG_ARCH_MX31 || UBOOT_CONFIG_ARCH_MX5
	help
	  Support the one wire controller found in some members of the NXP
	  i.MX SoC family.
	  There are currently two silicon variants:
	  V1: i.MX21, i.MX27, i.MX31, i.MX51
	  V2: i.MX25, i.MX35, i.MX50, i.MX53
	  Newer i.MX SoCs such as the i.MX6 do not have one wire controllers.

	  The driver supports both silicon variants.

endif

endmenu
```

## open_uboot/config/drivers/watchdog/Kconfig
```kconfig
menu "Watchdog Timer Support"

config UBOOT_CONFIG_WATCHDOG
	bool "Enable U-Boot watchdog reset"
	depends on !UBOOT_CONFIG_HW_WATCHDOG
	help
	  This option enables U-Boot watchdog support where U-Boot is using
	  watchdog_reset function to service watchdog device in U-Boot. Enable
	  this option if you want to service enabled watchdog by U-Boot. Disable
	  this option if you want U-Boot to start watchdog but never service it.

config UBOOT_CONFIG_WATCHDOG_AUTOSTART
	bool "Automatically start watchdog timer"
	depends on UBOOT_CONFIG_WDT
	default n if UBOOT_CONFIG_ARCH_SUNXI
	default y
	help
	  Automatically start watchdog timer and start servicing it during
	  init phase. Enabled by default. Disable this option if you want
	  to compile U-Boot with CONFIG_WDT support but do not want to
	  activate watchdog, like when CONFIG_WDT option is disabled. You
	  would be able to start watchdog manually by 'wdt' command. Useful
	  when you want to have support for 'wdt' command but do not want
	  to have watchdog enabled by default.

config UBOOT_CONFIG_WATCHDOG_TIMEOUT_MSECS
	int "Watchdog timeout in msec"
	default 128000 if UBOOT_CONFIG_ARCH_MX31 || UBOOT_CONFIG_ARCH_MX5 || UBOOT_CONFIG_ARCH_MX6
	default 128000 if UBOOT_CONFIG_ARCH_MX7 || UBOOT_CONFIG_ARCH_VF610
	default 30000 if UBOOT_CONFIG_ARCH_SOCFPGA
	default 16000 if UBOOT_CONFIG_ARCH_SUNXI
	default 60000
	help
	  Watchdog timeout in msec

config UBOOT_CONFIG_HW_WATCHDOG
	bool

config UBOOT_CONFIG_IMX_WATCHDOG
	bool "Enable Watchdog Timer support for IMX and LSCH2 of NXP"
	select UBOOT_CONFIG_HW_WATCHDOG if !WDT
	help
	  Select this to enable the IMX and LSCH2 of Layerscape watchdog
	  driver.

config UBOOT_CONFIG_WATCHDOG_RESET_DISABLE
	bool "Disable reset watchdog"
	depends on UBOOT_CONFIG_IMX_WATCHDOG
	help
	  Disable reset watchdog, which can let WATCHDOG_RESET invalid, so
	  that the watchdog will not be fed in u-boot.

config UBOOT_CONFIG_OMAP_WATCHDOG
	bool "TI OMAP watchdog driver"
	depends on UBOOT_CONFIG_ARCH_OMAP2PLUS
	select UBOOT_CONFIG_HW_WATCHDOG
	help
	  Say Y here to enable the OMAP3+ watchdog driver.

config UBOOT_CONFIG_ULP_WATCHDOG
	bool "i.MX7ULP watchdog"
	help
	  Say Y here to enable i.MX7ULP watchdog driver.

config UBOOT_CONFIG_DESIGNWARE_WATCHDOG
	bool "Designware watchdog timer support"
	select UBOOT_CONFIG_HW_WATCHDOG if !WDT
	default y if UBOOT_CONFIG_WDT && UBOOT_CONFIG_ROCKCHIP_RK3399
	help
	  Enable this to support Designware Watchdog Timer IP, present e.g.
	  on Altera SoCFPGA SoCs.

config UBOOT_CONFIG_WDT
	bool "Enable driver model for watchdog timer drivers"
	depends on UBOOT_CONFIG_DM
	imply WATCHDOG
	help
	  Enable driver model for watchdog timer. At the moment the API
	  is very simple and only supports four operations:
	  start, stop, reset and expire_now (expire immediately).
	  What exactly happens when the timer expires is up to a particular
	  device/driver.

config UBOOT_CONFIG_WDT_ARMADA_37XX
	bool "Marvell Armada 37xx watchdog timer support"
	depends on UBOOT_CONFIG_WDT && UBOOT_CONFIG_ARMADA_3700
	help
	  Enable this to support Watchdog Timer on Marvell Armada 37xx SoC.
	  There are 4 possible clocks which can be used on these SoCs. This
	  driver uses the second clock (ID 1), assuming that so will also
	  Linux's driver.

config UBOOT_CONFIG_WDT_ASPEED
	bool "Aspeed ast2400/ast2500 watchdog timer support"
	depends on UBOOT_CONFIG_WDT
	default y if UBOOT_CONFIG_ARCH_ASPEED
	help
	  Select this to enable watchdog timer for Aspeed ast2500/ast2400 devices.
	  The watchdog timer is stopped when initialized. It performs reset, either
	  full SoC reset or CPU or just some peripherals, based on the flags.
	  It currently does not support Boot Flash Addressing Mode Detection or
	  Second Boot.

config UBOOT_CONFIG_WDT_AST2600
	bool "Aspeed AST2600 watchdog timer support"
	depends on UBOOT_CONFIG_WDT
	default y if UBOOT_CONFIG_ASPEED_AST2600
	help
	  Select this to enable watchdog timer for Aspeed ast2500/ast2400 devices.
	  The watchdog timer is stopped when initialized. It performs reset, either
	  full SoC reset or CPU or just some peripherals, based on the flags.

config UBOOT_CONFIG_WDT_AT91
	bool "AT91 watchdog timer support"
	depends on UBOOT_CONFIG_WDT
	help
	  Select this to enable Microchip watchdog timer, which can be found on
	  some AT91 devices.

config UBOOT_CONFIG_WDT_BCM6345
	bool "BCM6345 watchdog timer support"
	depends on UBOOT_CONFIG_WDT && (ARCH_BMIPS || UBOOT_CONFIG_ARCH_BCM68360 || \
			   ARCH_BCM6858 || UBOOT_CONFIG_ARCH_BCM63158)
	help
	  Select this to enable watchdog timer for BCM6345 SoCs.
	  The watchdog timer is stopped when initialized.
	  It performs full SoC reset.

config UBOOT_CONFIG_WDT_BOOKE
	bool "PowerPC Book-E watchdog driver"
	depends on UBOOT_CONFIG_WDT && UBOOT_CONFIG_MPC85xx
	help
	  Watchdog driver for PowerPC Book-E chips, such as the Freescale
	  MPC85xx SOCs and the IBM PowerPC 440.

config UBOOT_CONFIG_WDT_CDNS
	bool "Cadence watchdog timer support"
	depends on UBOOT_CONFIG_WDT
	imply WATCHDOG
	help
	  Select this to enable Cadence watchdog timer, which can be found on some
	  Xilinx Microzed Platform.

config UBOOT_CONFIG_WDT_CORTINA
	bool "Cortina Access CAxxxx watchdog timer support"
	depends on UBOOT_CONFIG_WDT
	help
	  Cortina Access CAxxxx watchdog timer support.
	  This driver support all CPU ISAs supported by Cortina
	  Access CAxxxx SoCs.

config UBOOT_CONFIG_WDT_GPIO
	bool "External gpio watchdog support"
	depends on UBOOT_CONFIG_WDT
	depends on UBOOT_CONFIG_DM_GPIO
	help
	  Support for external watchdog fed by toggling a gpio. See
	  doc/device-tree-bindings/watchdog/gpio-wdt.txt for
	  information on how to describe the watchdog in device tree.

config UBOOT_CONFIG_WDT_LGM
	bool "Lightning watchdog timer support"
	depends on UBOOT_CONFIG_WDT && UBOOT_CONFIG_DRIVER_LIGHTNING
	select UBOOT_CONFIG_HW_WATCHDOG
	default n
	help
	  Select this to enable lightning watchdog timer

config UBOOT_CONFIG_WDT_MPC8xx
	bool "MPC8xx watchdog timer support"
	depends on UBOOT_CONFIG_WDT && UBOOT_CONFIG_MPC8xx
	select UBOOT_CONFIG_HW_WATCHDOG
	help
	  Select this to enable mpc8xx watchdog timer

config UBOOT_CONFIG_WDT_MT7620
	bool "MediaTek MT7620 watchdog timer support"
	depends on UBOOT_CONFIG_WDT && UBOOT_CONFIG_SOC_MT7620
	help
	  Select this to enable watchdog timer on MediaTek MT7620 and earlier
	  SoC chips.

config UBOOT_CONFIG_WDT_MT7621
	bool "MediaTek MT7621 watchdog timer support"
	depends on UBOOT_CONFIG_WDT && UBOOT_CONFIG_SOC_MT7628
	help
	  Select this to enable Ralink / Mediatek watchdog timer,
	  which can be found on some MediaTek chips.

config UBOOT_CONFIG_WDT_MTK
	bool "MediaTek watchdog timer support"
	depends on UBOOT_CONFIG_WDT && UBOOT_CONFIG_ARCH_MEDIATEK
	help
	  Select this to enable watchdog timer for MediaTek SoCs.
	  The watchdog timer is stopped when initialized.
	  It performs full SoC reset.

config UBOOT_CONFIG_WDT_OCTEONTX
	bool "OcteonTX core watchdog support"
	depends on UBOOT_CONFIG_WDT && (ARCH_OCTEONTX || UBOOT_CONFIG_ARCH_OCTEONTX2)
	default y
	imply WATCHDOG
	help
	  This enables OcteonTX watchdog driver, which can be
	  found on OcteonTX/TX2 chipsets and inline with driver model.
	  Only supports watchdog reset.

config UBOOT_CONFIG_WDT_OMAP3
	bool "TI OMAP watchdog timer support"
	depends on UBOOT_CONFIG_WDT && UBOOT_CONFIG_ARCH_OMAP2PLUS
	default y if UBOOT_CONFIG_AM33XX
	help
	  This enables OMAP3+ watchdog timer driver, which can be
	  found on some TI chipsets and inline with driver model.

config UBOOT_CONFIG_WDT_ORION
	bool "Orion watchdog timer support"
	depends on UBOOT_CONFIG_WDT
	select UBOOT_CONFIG_CLK
	help
	  Select this to enable Orion watchdog timer, which can be found on some
	  Marvell Armada chips.

config UBOOT_CONFIG_WDT_K3_RTI
	bool "Texas Instruments K3 RTI watchdog"
	depends on UBOOT_CONFIG_WDT && UBOOT_CONFIG_ARCH_K3
	help
	  Say Y here if you want to include support for the K3 watchdog
	  timer (RTI module) available in the K3 generation of processors.

if UBOOT_CONFIG_WDT_K3_RTI

config UBOOT_CONFIG_WDT_K3_RTI_LOAD_FW
	bool "Load watchdog firmware"
	depends on UBOOT_CONFIG_REMOTEPROC
	help
	  Automatically load the specified firmware image into the MCU R5F
	  core 0. On the AM65x, this firmware is supposed to handle the expiry
	  of the watchdog timer, typically by resetting the system.

config UBOOT_CONFIG_WDT_K3_RTI_FW_FILE
	string "Watchdog firmware image file"
	default "k3-rti-wdt.fw"
	depends on UBOOT_CONFIG_WDT_K3_RTI_LOAD_FW
	help
	  Firmware image to be embedded into U-Boot and loaded on watchdog
	  start.

endif

config UBOOT_CONFIG_WDT_SANDBOX
	bool "Enable Watchdog Timer support for Sandbox"
	depends on UBOOT_CONFIG_SANDBOX && UBOOT_CONFIG_WDT
	help
	  Enable Watchdog Timer support in Sandbox. This is a dummy device that
	  can be probed and supports all of the methods of WDT, but does not
	  really do anything.

config UBOOT_CONFIG_WDT_SBSA
	bool "SBSA watchdog timer support"
	depends on UBOOT_CONFIG_WDT
	help
	   Select this to enable SBSA watchdog timer.
	   This driver can operate ARM SBSA Generic Watchdog as a single stage.
	   In the single stage mode, when the timeout is reached, your system
	   will be reset by WS1. The first signal (WS0) is ignored.

config UBOOT_CONFIG_WDT_SP805
	bool "SP805 watchdog timer support"
	depends on UBOOT_CONFIG_WDT
	help
	  Select this to enable SP805 watchdog timer, which can be found on some
	  nxp layerscape chips.

config UBOOT_CONFIG_WDT_STM32MP
	bool "IWDG watchdog driver for STM32 MP's family"
	depends on UBOOT_CONFIG_WDT
	imply WATCHDOG
	help
	  Enable the STM32 watchdog (IWDG) driver. Enable support to
	  configure STM32's on-SoC watchdog.

config UBOOT_CONFIG_WDT_SUNXI
	bool "Allwinner sunxi watchdog timer support"
	depends on UBOOT_CONFIG_WDT && UBOOT_CONFIG_ARCH_SUNXI
	default y
	help
	  Enable support for the watchdog timer in Allwinner sunxi SoCs.

config UBOOT_CONFIG_XILINX_TB_WATCHDOG
	bool "Xilinx Axi watchdog timer support"
	depends on UBOOT_CONFIG_WDT
	imply WATCHDOG
	help
	  Select this to enable Xilinx Axi watchdog timer, which can be found on some
	  Xilinx Microblaze Platforms.

config UBOOT_CONFIG_WDT_XILINX
	bool "Xilinx window watchdog timer support"
	depends on UBOOT_CONFIG_WDT && UBOOT_CONFIG_ARCH_VERSAL
	select UBOOT_CONFIG_REGMAP
	imply WATCHDOG
	help
	  Select this to enable Xilinx window watchdog timer, which can be found on
	  Xilinx Versal Platforms.

config UBOOT_CONFIG_WDT_TANGIER
	bool "Intel Tangier watchdog timer support"
	depends on UBOOT_CONFIG_WDT && UBOOT_CONFIG_INTEL_MID
	help
	  This enables support for watchdog controller available on
	  Intel Tangier SoC. If you're using a board with Intel Tangier
	  SoC, say Y here.

config UBOOT_CONFIG_SPL_WDT
	bool "Enable driver model for watchdog timer drivers in SPL"
	depends on UBOOT_CONFIG_SPL_DM
	help
	  Enable driver model for watchdog timer in SPL.
	  This is similar to CONFIG_WDT in U-Boot.

endmenu
```

## open_uboot/config/fs/ubifs/Kconfig
```kconfig
config UBOOT_CONFIG_UBIFS_SILENCE_MSG
	bool "UBIFS silence verbose messages"
	default UBOOT_CONFIG_ENV_IS_IN_UBI
	help
	  Make the verbose messages from UBIFS stop printing. This leaves
	  warnings and errors enabled.
```

## open_uboot/config/lib/crypt/Kconfig
```kconfig
menuconfig UBOOT_CONFIG_CRYPT_PW
	bool "Add crypt support for password-based unlock"
	depends on UBOOT_CONFIG_AUTOBOOT_KEYED && UBOOT_CONFIG_AUTOBOOT_ENCRYPTION
	help
	  Enable support for crypt-style hashed passphrases.
	  This will then be used as the mechanism of choice to
	  verify whether the entered password to unlock the
	  console is correct or not.

if UBOOT_CONFIG_CRYPT_PW

config UBOOT_CONFIG_CRYPT_PW_SHA256
	bool "Provide sha256crypt"
	select UBOOT_CONFIG_SHA256
	select UBOOT_CONFIG_SHA256_ALGO
	help
	  Enables support for the sha256crypt password-hashing algorithm.
	  The prefix is "$5$".

config UBOOT_CONFIG_CRYPT_PW_SHA512
	bool "Provide sha512crypt"
	select UBOOT_CONFIG_SHA512
	help
	  Enables support for the sha512crypt password-hashing algorithm.
	  The prefix is "$6$".

endif
```
