## open_uboot/config/drivers/rng/Kconfig
```kconfig
config UBOOT_CONFIG_DM_RNG
	bool "Driver support for Random Number Generator devices"
	depends on UBOOT_CONFIG_DM
	help
	  Enable driver model for random number generator(rng) devices.
	  This interface is used to initialise the rng device and to
	  read the random seed from the device.

if UBOOT_CONFIG_DM_RNG

config UBOOT_CONFIG_RNG_MESON
	bool "Amlogic Meson Random Number Generator support"
	depends on UBOOT_CONFIG_ARCH_MESON
	default y
	help
	  Enable support for hardware random number generator
	  of Amlogic Meson SoCs.

config UBOOT_CONFIG_RNG_SANDBOX
	bool "Sandbox random number generator"
	depends on UBOOT_CONFIG_SANDBOX
	default y
	help
	  Enable random number generator for sandbox. This is an
	  emulation of a rng device.

config UBOOT_CONFIG_RNG_MSM
	bool "Qualcomm SoCs Random Number Generator support"
	depends on UBOOT_CONFIG_DM_RNG
	help
	  This driver provides support for the Random Number
	  Generator hardware found on Qualcomm SoCs.

config UBOOT_CONFIG_RNG_STM32MP1
	bool "Enable random number generator for STM32MP1"
	depends on UBOOT_CONFIG_ARCH_STM32MP
	help
	  Enable STM32MP1 rng driver.

config UBOOT_CONFIG_RNG_ROCKCHIP
	bool "Enable random number generator for rockchip crypto rng"
	depends on UBOOT_CONFIG_ARCH_ROCKCHIP && UBOOT_CONFIG_DM_RNG
	help
	  Enable random number generator for rockchip.This driver is
	  support rng module of crypto v1 and crypto v2.

config UBOOT_CONFIG_RNG_IPROC200
	bool "Broadcom iProc RNG200 random number generator"
	depends on UBOOT_CONFIG_DM_RNG
	help
	  Enable random number generator for RPI4.
endif
```

## open_uboot/config/drivers/smem/Kconfig
```kconfig
menuconfig UBOOT_CONFIG_SMEM
	bool  "SMEM (Shared Memory mamanger) support"

if UBOOT_CONFIG_SMEM

config UBOOT_CONFIG_SANDBOX_SMEM
    bool "Sandbox Shared Memory Manager (SMEM)"
    depends on UBOOT_CONFIG_SANDBOX && UBOOT_CONFIG_DM
    help
      enable SMEM support for sandbox. This is an emulation of a real SMEM
      manager.
      The sandbox driver allocates a shared memory from the heap and
      initialzies it on start.

config UBOOT_CONFIG_MSM_SMEM
    bool "Qualcomm Shared Memory Manager (SMEM)"
    depends on UBOOT_CONFIG_DM
    depends on UBOOT_CONFIG_ARCH_SNAPDRAGON || UBOOT_CONFIG_ARCH_IPQ40XX
    help
      Enable support for the Qualcomm Shared Memory Manager.
      The driver provides an interface to items in a heap shared among all
      processors in a Qualcomm platform.

endif # menu "SMEM Support"
```

## open_uboot/config/drivers/soc/ti/Kconfig
```kconfig
# SPDX-License-Identifier: GPL-2.0+

menuconfig UBOOT_CONFIG_SOC_TI
	bool "TI SOC drivers support"

if UBOOT_CONFIG_SOC_TI

config UBOOT_CONFIG_TI_K3_NAVSS_RINGACC
	bool "K3 Ring accelerator Sub System"
	depends on UBOOT_CONFIG_ARCH_K3
	select UBOOT_CONFIG_MISC
	help
	  Say y here to support the K3 AM65x Ring accelerator module.
	  The Ring Accelerator (RINGACC or RA)  provides hardware acceleration
	  to enable straightforward passing of work between a producer
	  and a consumer. There is one RINGACC module per NAVSS on TI AM65x SoCs
	  If unsure, say N.

config UBOOT_CONFIG_TI_KEYSTONE_SERDES
	bool "Keystone SerDes driver for ethernet"
	depends on UBOOT_CONFIG_ARCH_KEYSTONE
	help
	 SerDes driver for Keystone SoC used for ethernet support on TI
	 K2 platforms.

config UBOOT_CONFIG_TI_PRUSS
	bool "Support for TI's K3 based Pruss driver"
	depends on UBOOT_CONFIG_DM
	depends on UBOOT_CONFIG_ARCH_K3
	depends on UBOOT_CONFIG_OF_CONTROL
	depends on UBOOT_CONFIG_SYSCON
	help
	  Support for TI PRU-ICSSG subsystem.
	  Currently supported on AM65xx SoCs Say Y here to support the
	  Programmable Realtime Unit (PRU).

endif # SOC_TI
```

## open_uboot/config/drivers/spmi/Kconfig
```kconfig
menu "SPMI support"

config UBOOT_CONFIG_SPMI
	bool "Enable SPMI bus support"
	depends on UBOOT_CONFIG_DM
	---help---
	  Select this to enable to support SPMI bus.
	  SPMI (System Power Management Interface) bus is used
	  to connect PMIC devices on various SoCs.

config UBOOT_CONFIG_SPMI_MSM
	bool "Support Qualcomm SPMI bus"
	depends on UBOOT_CONFIG_SPMI
	---help---
	  Support SPMI bus implementation found on Qualcomm Snapdragon SoCs.

config UBOOT_CONFIG_SPMI_SANDBOX
	bool "Support for Sandbox SPMI bus"
	depends on UBOOT_CONFIG_SPMI
	---help---
	  Demo SPMI bus implementation. Emulates part of PM8916 as single
          slave (0) on bus. It has 4 GPIO peripherals, pid 0xC0-0xC3.
endmenu
```

## open_uboot/config/drivers/tpm/Kconfig
```kconfig
#
# TPM subsystem configuration
#

menu "TPM support"

config UBOOT_CONFIG_TPM_V1
	bool "TPMv1.x support"
	depends on UBOOT_CONFIG_TPM
	default y
	help
	  Major TPM versions are not compatible at all, choose either
	  one or the other. This option enables TPMv1.x drivers/commands.

if UBOOT_CONFIG_TPM_V1

config UBOOT_CONFIG_TPM_TIS_SANDBOX
	bool "Enable sandbox TPM driver"
	depends on UBOOT_CONFIG_TPM_V1 && UBOOT_CONFIG_SANDBOX
	default y
	help
	  This driver emulates a TPMv1.x, providing access to base functions
	  such as reading and writing TPM private data. This is enough to
	  support Chrome OS verified boot. Extend functionality is not
	  implemented.

config UBOOT_CONFIG_TPM_ATMEL_TWI
	bool "Enable Atmel TWI TPM device driver"
	depends on UBOOT_CONFIG_TPM_V1
	help
	  This driver supports an Atmel TPM device connected on the I2C bus.
	  The usual tpm operations and the 'tpm' command can be used to talk
	  to the device using the standard TPM Interface Specification (TIS)
	  protocol

config UBOOT_CONFIG_TPM_TIS_INFINEON
	bool "Enable support for Infineon SLB9635/45 TPMs on I2C"
	depends on UBOOT_CONFIG_TPM_V1 && UBOOT_CONFIG_DM_I2C
	help
	  This driver supports Infineon TPM devices connected on the I2C bus.
	  The usual tpm operations and the 'tpm' command can be used to talk
	  to the device using the standard TPM Interface Specification (TIS)
	  protocol

config UBOOT_CONFIG_TPM_TIS_I2C_BURST_LIMITATION
	bool "Enable I2C burst length limitation"
	depends on UBOOT_CONFIG_TPM_TIS_INFINEON
	help
	  Some broken TPMs have a limitation on the number of bytes they can
	  receive in one message. Enable this option to allow you to set this
	  option. The can allow a broken TPM to be used by splitting messages
	  into separate pieces.

config UBOOT_CONFIG_TPM_TIS_I2C_BURST_LIMITATION_LEN
	int "Length"
	depends on UBOOT_CONFIG_TPM_TIS_I2C_BURST_LIMITATION
	help
	  Use this to set the burst limitation length

config UBOOT_CONFIG_TPM_TIS_LPC
	bool "Enable support for Infineon SLB9635/45 TPMs on LPC"
	depends on UBOOT_CONFIG_TPM_V1 && UBOOT_CONFIG_X86
	help
	  This driver supports Infineon TPM devices connected on the LPC bus.
	  The usual tpm operations and the 'tpm' command can be used to talk
	  to the device using the standard TPM Interface Specification (TIS)
	  protocol

config UBOOT_CONFIG_TPM_AUTH_SESSIONS
	bool "Enable TPM authentication session support"
	depends on UBOOT_CONFIG_TPM_V1
	help
	  Enable support for authorised (AUTH1) commands as specified in the
	  TCG Main Specification 1.2. OIAP-authorised versions of the commands
	  TPM_LoadKey2 and TPM_GetPubKey are provided. Both features are
	  available using the 'tpm' command, too.

config UBOOT_CONFIG_TPM_ST33ZP24_I2C
	bool "STMicroelectronics ST33ZP24 I2C TPM"
	depends on UBOOT_CONFIG_TPM_V1 && UBOOT_CONFIG_DM_I2C
	---help---
	  This driver supports STMicroelectronics TPM devices connected on the I2C bus.
	  The usual tpm operations and the 'tpm' command can be used to talk
	  to the device using the standard TPM Interface Specification (TIS)
	  protocol

config UBOOT_CONFIG_TPM_ST33ZP24_SPI
	bool "STMicroelectronics ST33ZP24 SPI TPM"
	depends on UBOOT_CONFIG_TPM_V1 && UBOOT_CONFIG_DM_SPI
	---help---
	  This driver supports STMicroelectronics TPM devices connected on the SPI bus.
	  The usual tpm operations and the 'tpm' command can be used to talk
	  to the device using the standard TPM Interface Specification (TIS)
	  protocol

config UBOOT_CONFIG_TPM_FLUSH_RESOURCES
	bool "Enable TPM resource flushing support"
	depends on UBOOT_CONFIG_TPM_V1
	help
	  Enable support to flush specific resources (e.g. keys) from the TPM.
	  The functionality is available via the 'tpm' command as well.

config UBOOT_CONFIG_TPM_LOAD_KEY_BY_SHA1
	bool "Enable TPM key loading by SHA1 support"
	depends on UBOOT_CONFIG_TPM_V1
	help
	  Enable support to load keys into the TPM by identifying
	  their parent via the public key's SHA1 hash.
	  The functionality is available via the 'tpm' command as well.

config UBOOT_CONFIG_TPM_LIST_RESOURCES
	bool "Enable TPM resource listing support"
	depends on UBOOT_CONFIG_TPM_V1
	help
	  Enable support to list specific resources (e.g. keys) within the TPM.
	  The functionality is available via the 'tpm' command as well.

endif # TPM_V1

config UBOOT_CONFIG_TPM_V2
	bool "TPMv2.x support"
	depends on UBOOT_CONFIG_TPM
	default y
	help
	  Major TPM versions are not compatible at all, choose either
	  one or the other. This option enables TPMv2.x drivers/commands.

if UBOOT_CONFIG_TPM_V2

config UBOOT_CONFIG_TPM2_CR50_I2C
	bool "Enable support for Google cr50 TPM"
	depends on UBOOT_CONFIG_DM_I2C
	help
	  Cr50 is an implementation of a TPM on Google's H1 security chip.
	  This uses the same open-source firmware as the Chromium OS EC.
	  While Cr50 has other features, its primary role is as the root of
	  trust for a device, It operates like a TPM and can be used with
	  verified boot. Cr50 is used on recent Chromebooks (since 2017).

config UBOOT_CONFIG_TPM2_TIS_SANDBOX
	bool "Enable sandbox TPMv2.x driver"
	depends on UBOOT_CONFIG_TPM_V2 && UBOOT_CONFIG_SANDBOX
	default y
	help
	  This driver emulates a TPMv2.x, providing access to base functions
	  such as basic configuration, PCR extension and PCR read. Extended
	  functionalities are not implemented.

config UBOOT_CONFIG_TPM2_TIS_SPI
	bool "Enable support for TPMv2.x SPI chips"
	depends on UBOOT_CONFIG_TPM_V2 && UBOOT_CONFIG_DM_SPI
	help
	  This driver supports TPMv2.x devices connected on the SPI bus.
	  The usual TPM operations and the 'tpm' command can be used to talk
	  to the device using the standard TPM Interface Specification (TIS)
	  protocol.

config UBOOT_CONFIG_TPM2_FTPM_TEE
	bool "TEE based fTPM Interface"
	depends on UBOOT_CONFIG_TEE && UBOOT_CONFIG_OPTEE && UBOOT_CONFIG_TPM_V2
	help
	  This driver supports firmware TPM running in TEE.

config UBOOT_CONFIG_TPM2_MMIO
	bool "MMIO based TPM2 Interface"
	depends on UBOOT_CONFIG_TPM_V2
	help
	  This driver supports firmware TPM2.0 MMIO interface.
	  The usual TPM operations and the 'tpm' command can be used to talk
	  to the device using the standard TPM Interface Specification (TIS)
	  protocol.

endif # TPM_V2

endmenu
```

## open_uboot/config/drivers/ufs/Kconfig
```kconfig
menu "UFS Host Controller Support"

config UBOOT_CONFIG_UFS
	bool "Support UFS controllers"
	depends on UBOOT_CONFIG_DM_SCSI
	help
	  This selects support for Universal Flash Subsystem (UFS).
	  Say Y here if you want UFS Support.

config UBOOT_CONFIG_CADENCE_UFS
	bool "Cadence platform driver for UFS"
	depends on UBOOT_CONFIG_UFS
        help
	  This selects the platform driver for the Cadence UFS host
	  controller present on present TI's J721e devices.

config UBOOT_CONFIG_TI_J721E_UFS
	bool "Glue Layer driver for UFS on TI J721E devices"
	help
	  This selects the glue layer driver for Cadence controller
	  present on TI's J721E devices.

endmenu
```

## open_uboot/config/drivers/usb/Kconfig
```kconfig
menuconfig UBOOT_CONFIG_USB
	bool "USB support"
	---help---
	  Universal Serial Bus (USB) is a specification for a serial bus
	  subsystem which offers higher speeds and more features than the
	  traditional PC serial port.  The bus supplies power to peripherals
	  and allows for hot swapping.  Up to 127 USB peripherals can be
	  connected to a single USB host in a tree structure.

	  The USB host is the root of the tree, the peripherals are the
	  leaves and the inner nodes are special USB devices called hubs.
	  Most PCs now have USB host ports, used to connect peripherals
	  such as scanners, keyboards, mice, modems, cameras, disks,
	  flash memory, network links, and printers to the PC.

	  Say Y here if your device has an USB port, either host, peripheral or
	  dual-role.

	  For an USB host port, you then need to say Y to at least one of the
	  Host Controller Driver (HCD) options below.  Choose a USB 1.1
	  controller, such as "UHCI HCD support" or "OHCI HCD support",
	  and "EHCI HCD (USB 2.0) support" except for older systems that
	  do not have USB 2.0 support.  It doesn't normally hurt to select
	  them all if you are not certain.

	  If your system has a device-side USB port, used in the peripheral
	  side of the USB protocol, see the "USB Gadget" framework instead.

	  After choosing your HCD, then select drivers for the USB peripherals
	  you'll be using.  You may want to check out the information provided
	  in <file:Documentation/usb/> and especially the links given in
	  <file:Documentation/usb/usb-help.txt>.

if UBOOT_CONFIG_USB

config UBOOT_CONFIG_DM_USB
	bool
	depends on UBOOT_CONFIG_DM && UBOOT_CONFIG_OF_CONTROL
	help
	  Enable driver model for USB. The USB interface is then implemented
	  by the USB uclass. Multiple USB controllers of different types
	  (XHCI, EHCI, OHCI) can be attached and used. The 'usb' command works
	  as normal.

	  Much of the code is shared but with this option enabled the USB
	  uclass takes care of device enumeration. USB devices can be
	  declared with the U_BOOT_USB_DEVICE() macro and will be
	  automatically probed when found on the bus.

config UBOOT_CONFIG_SPL_DM_USB
	bool "Enable driver model for USB host most in SPL"
	depends on UBOOT_CONFIG_SPL_DM && UBOOT_CONFIG_DM_USB
	default y

config UBOOT_CONFIG_DM_USB_GADGET
	bool "Enable driver model for USB Gadget"
	depends on UBOOT_CONFIG_DM_USB
	help
	  Enable driver model for USB Gadget (Peripheral
	  mode)

config UBOOT_CONFIG_SPL_DM_USB_GADGET
	bool "Enable driver model for USB Gadget in SPL"
	depends on UBOOT_CONFIG_SPL_DM_USB
	help
	  Enable driver model for USB Gadget in SPL
	  (Peripheral mode)

source "host/Kconfig"

source "cdns3/Kconfig"

source "dwc3/Kconfig"

source "mtu3/Kconfig"

source "musb/Kconfig"

source "musb-new/Kconfig"

source "emul/Kconfig"

source "phy/Kconfig"

source "ulpi/Kconfig"

if UBOOT_CONFIG_USB_HOST

comment "USB peripherals"

config UBOOT_CONFIG_USB_STORAGE
	bool "USB Mass Storage support"
	depends on !(BLK && !UBOOT_CONFIG_DM_USB)
	---help---
	  Say Y here if you want to connect USB mass storage devices to your
	  board's USB port.

config UBOOT_CONFIG_USB_KEYBOARD
	bool "USB Keyboard support"
	select UBOOT_CONFIG_DM_KEYBOARD if DM_USB
	select UBOOT_CONFIG_SYS_STDIO_DEREGISTER
	---help---
	  Say Y here if you want to use a USB keyboard for U-Boot command line
	  input.

if UBOOT_CONFIG_USB_KEYBOARD

config UBOOT_CONFIG_USB_KEYBOARD_FN_KEYS
	bool "USB keyboard function key support"
	help
	  Say Y here if you want support for keys F1 - F12, INS, HOME, DELETE,
	  END, PAGE UP, and PAGE DOWN.

choice
	prompt "USB keyboard polling"
	default UBOOT_CONFIG_SYS_USB_EVENT_POLL_VIA_INT_QUEUE if UBOOT_CONFIG_ARCH_SUNXI
	default UBOOT_CONFIG_SYS_USB_EVENT_POLL
	---help---
	  Enable a polling mechanism for USB keyboard.

config UBOOT_CONFIG_SYS_USB_EVENT_POLL
    bool "Interrupt polling"

config UBOOT_CONFIG_SYS_USB_EVENT_POLL_VIA_INT_QUEUE
    bool "Poll via interrupt queue"

config UBOOT_CONFIG_SYS_USB_EVENT_POLL_VIA_CONTROL_EP
    bool "Poll via control EP"

endchoice

endif

source "eth/Kconfig"

endif

source "gadget/Kconfig"

endif
```
