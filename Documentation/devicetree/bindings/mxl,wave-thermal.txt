## intel_x86/lgm/uboot_configs/lgp-urx851-emmc-field-img_defconfig
```kconfig
CONFIG_CREATE_ARCH_SYMLINK=y
CONFIG_SYS_CACHE_SHIFT_6=y
CONFIG_SYS_CACHELINE_SIZE=64
CONFIG_LINKER_LIST_ALIGN=8
CONFIG_X86=y
CONFIG_SYS_ARCH="x86"
CONFIG_SYS_CPU="atom"
CONFIG_SYS_SOC="lightning"
CONFIG_SYS_VENDOR="maxlinear"
CONFIG_SYS_BOARD="lightning"
CONFIG_SYS_CONFIG_NAME="lightning_mountain"
CONFIG_SPL_LDSCRIPT="board/$(BOARDDIR)/u-boot-spl.lds"
CONFIG_SYS_TEXT_BASE=0x08200000
CONFIG_SYS_MALLOC_LEN=0x8000000
CONFIG_SYS_MALLOC_F_LEN=0x1000
CONFIG_SPL_GPIO=y
CONFIG_BOARD_SPECIFIC_OPTIONS=y
CONFIG_ENV_SIZE=0x80000
CONFIG_DEFAULT_DEVICE_TREE="lightning-mountain"
CONFIG_SPL_TEXT_BASE=0xBFF20000
CONFIG_SPL_MMC=y
CONFIG_SPL_SERIAL=y
CONFIG_SPL_SYS_MALLOC_F_LEN=0x1000
CONFIG_NR_DRAM_BANKS=1
CONFIG_ERR_PTR_OFFSET=0x0
CONFIG_SPL_SIZE_LIMIT=0x60000
CONFIG_SPL_SIZE_LIMIT_PROVIDE_STACK=0
CONFIG_SPL=y
CONFIG_X86_RUN_32BIT=y
# CONFIG_AHCI is not set
CONFIG_URX851_SOC=y
CONFIG_LIGHTNING_MOUNTAIN_SOC=y
CONFIG_UBOOT_RAM=y
CONFIG_VENDOR_MAXLINEAR=y
CONFIG_SYS_CAR_ADDR=0xBFF00000
CONFIG_SYS_CAR_SIZE=0x80000
CONFIG_TARGET_LIGHTNING_MOUNTAIN=y
CONFIG_LGM_U_BOOT_SIZE=0x72000
CONFIG_DRIVER_LIGHTNING=y
CONFIG_ROC_VOLTAGE=0x3D
CONFIG_CMD_WATCHDOG=y
CONFIG_SPL_WATCHDOG=y
CONFIG_WATCHDOG_TIMEOUT_MSECS=180000
CONFIG_WDT=y
CONFIG_WDT_LGM=y
CONFIG_SPL_WDT=y
CONFIG_PMIC_CONFIGURATIONS=y
CONFIG_ROHM_PMIC=y
CONFIG_LIGHTNING_B0=y
CONFIG_BOARD_ANYWAN_LIGHTNING=y
CONFIG_LGM_MEM_SIZE=2048
CONFIG_LGM_LPDDR4=y
CONFIG_LGM_FREQ_3733M=y
CONFIG_UBOOT_IN_USER_PART=y
CONFIG_MAX_RBE_PER_PART=4
CONFIG_SPL_PAD_SIZE=0x32000
CONFIG_COPIES_OF_RBE=0x1
CONFIG_RECOVERY_SPL_PAD_SIZE=0x16000
CONFIG_PREBOOT="if gpt verify mmc 0 ${partitions}; then echo; else run init_user_partition; fi; echo; wdt dev wdt@e2500000; wdt stop"
CONFIG_BOOTDELAY=5
CONFIG_MAX_BOOT_COUNTER=3
CONFIG_LOADADDR=0x8200000
CONFIG_DTB_LOADADDR=0x8000000
CONFIG_ROOTFS_LOADADDR=0x40000000
CONFIG_BOOTCOMMAND="if test \"${recovery_image}\" -eq 1; then run led_inv_img; run recover_primary ; else wdt start 60000 && run check_upgrade; run flashargs; run addmisc; mmc dev 0 0; setenv select_partition primary; load mmc 0#${fs_part_a} ${loadaddr} ${rootfs} && run auth_rootfs && cp.b 0x40000000 ${rootfs_loadaddr} ${filesystem_size} && mmc read ${dtb_loadaddr} ${dtb_a_block_start} ${dtb_a_block_size} && run auth_dtb && run set_cma_size && load mmc 0#${fs_part_a} ${kernel_loadaddr} ${bootfile} && run auth_kernel && parsemd ${kernel_loadaddr} ${kernel_loadaddr} && run update_bootargs && run led_auth_success && icc 1 0x${md_ro_start} 0x${md_ro_end} 0x${rootfs_loadaddr} 0x800 && run led_kern_start && bootm ${kernel_loadaddr} - ${dtb_loadaddr}; fi"
CONFIG_FLASHARGS="setenv bootargs phram.phram=RAM0,0x${rootfs_loadaddr},0x${filesystem_size} mtdparts=RAM0:0x${filesystem_size}@0x00000000(RootFileSystem-RAM) root=/dev/mtdblock0 rootfstype=squashfs rootwait"
CONFIG_ADDMISC="setenv bootargs ${bootargs} earlycon=lantiq,mmio32,0xe0a00000 console=ttyLTQ0,115200n8r ethaddr=${ethaddr} maxcpus=4 mem=2048M memmap=31M$1M,0x${filesystem_size}$0x${rootfs_loadaddr} initcall_debug=0 loglevel=${kernel_loglvl} intel_pstate=active intel_idle.max_cstate=2 max_cpufreq=${max_cpu_freq} init_cstate_margin=1 init_pstate_threshold=20 rootfs_startaddr=0x${rootfs_loadaddr} rootfs_endaddr=0x${rootfs_loadaddr_end} epu_table_ver=${epu_table_ver} pci=pcie_bus_perf ${custom}"
CONFIG_RESET_UBOOT_CONFIG="mmc dev 0 0; mw.l ${loadaddr} 0x0 0x20; mmc write ${loadaddr} ${env_a_block_start} 0x10; mmc write ${loadaddr} ${env_b_block_start} 0x10"
CONFIG_UPGRADE_FS_INIT="tftpboot ${loadaddr} ${tftppath}${filesystem_image} && mmc erase ${extended_boot_a_block_start} ${extended_boot_a_block_size} && mmc erase ${extended_boot_b_block_start} ${extended_boot_b_block_size} && mmc dev 0 0 && mmc write ${loadaddr} ${extended_boot_a_block_start} ${extended_boot_a_block_size} && mmc write ${loadaddr} ${extended_boot_b_block_start} ${extended_boot_b_block_size}"
CONFIG_UPDATE_UBOOT="tftp ${loadaddr} ${tftppath}${u-boot}; if test $? -eq 0; then mw.l 0x8000 0x56190527 && cmp.l ${loadaddr} 0x8000 1; if test $? -eq 1; then echo \"Mkimage not found\"; mmc dev 0 1; mmc write ${loadaddr} 0x0 ${uboot_a_block_size}; mmc dev 0 2; mmc write ${loadaddr} 0x0 ${uboot_b_block_size}; else setenv select_partition primary; upgrade ${loadaddr} ${filesize}; fi; else echo \"TFTP failed - no upgrade performed\"; fi;"
CONFIG_UPDATE_RBE="tftp ${loadaddr} ${tftppath}${rbe} && setenv select_partition primary; upgrade ${loadaddr} ${filesize}"
CONFIG_UPDATE_BOOTLOADER="tftp ${loadaddr} ${tftppath}${bootloader}; setenv select_partition primary; upgrade ${loadaddr} ${filesize}"
CONFIG_UPDATE_FULLIMAGE="tftp ${loadaddr} ${tftppath}${fullimage} && cp.b ${loadaddr} 0x40000000 ${filesize} && mmc dev 0 0 && setenv select_partition primary && upgrade ${loadaddr} ${filesize} && setenv select_partition secondary && upgrade 0x40000000 ${filesize}"
CONFIG_UPDATE_KERNEL="tftp ${loadaddr} ${tftppath}${bootfile} && mmc dev 0 0; setenv select_partition primary; upgrade ${loadaddr} ${filesize} ${bootfile}"
CONFIG_UPDATE_DTB="tftpboot ${loadaddr} ${tftppath}${dtb} && mmc dev 0 0 && mmc write ${loadaddr} ${dtb_a_block_start} ${dtb_a_block_size}"
CONFIG_UPDATE_ROOTFS="tftp ${loadaddr} ${tftppath}${rootfs} && mmc dev 0 0; setenv select_partition primary; upgrade ${loadaddr} ${filesize} ${rootfs}"
CONFIG_NET_RAM="tftpboot ${loadaddr} ${tftppath}${bootfile}; run nfsargs addmisc; bootm ${loadaddr}"
CONFIG_U_BOOT="u-boot-plus-spl-emmc.bin"
CONFIG_RBE_BINARY="u-boot-spl-emmc.bin"
CONFIG_BOOTLOADER_BINARY="u-boot-emmc.bin"
CONFIG_DTB="openwrt-intel_x86-lgm-CBSP_B0-lgp_b0.dtb"
CONFIG_ROOTFS="/openwrt-intel_x86-lgm-CBSP_B0-squashfs-fs.rootfs"
CONFIG_FULLIMAGE="openwrt-intel_x86-lgm-CBSP_B0-lgp_b0_fullimage.img"
CONFIG_TEP_FIRMWARE="tep_fw.bin"
CONFIG_UPDATE_TEP_FIRMWARE="tftpboot ${loadaddr} ${tftppath}${tep_firmware} && setenv select_partition primary; upgrade ${loadaddr} ${filesize} ${tep_firmware}"
CONFIG_CHECK_IMAGE="echo check image"
CONFIG_BOOTFILE="/openwrt-intel_x86-lgm-CBSP_B0-kernel.bin"
CONFIG_EXTRA_ENV_DATA="load_firmwares=run flashargs && run addmisc; mmc dev 0 0; setenv select_partition primary; load mmc 0#${fs_part_a} ${kernel_loadaddr} ${bootfile} && load mmc 0#${fs_part_a} ${rootfs_loadaddr} ${rootfs} && mmc read ${dtb_loadaddr} ${dtb_a_block_start} ${dtb_a_block_size}\0commit_image=mmc dev 0 0; load mmc 0#${upgrade_part} 0x8200000 \"${udt_file}\" && mmc dev 0 1 && setenv select_partition secondary && upgrade \"${loadaddr}\" \"${filesize}\" && setenv udt_status 6; saveenv;\0upgrade_image=if test -n \"${udt_file}\"; then mmc dev 0 0; load mmc 0#${upgrade_part} 0x8200000 \"${udt_file}\" && mmc dev 0 0 && setenv select_partition primary && upgrade \"${loadaddr}\" \"${filesize}\"; if test $? -eq 0; then setenv udt_status 2;saveenv; else setenv udt_status 6; saveenv; fi; fi\0check_upgrade=if test \"${udt_status}\" -eq 1; then run upgrade_image ; elif test \"${udt_status}\" -eq 5;then run commit_image; fi\0kernel_loglvl=4\0udt_status=0\0udt_file=0\0udt_num=0\0udt_file_1=\"${dtb}\"\0udt_loc=${dtb_vol}\0upgrade_vol=upgrade\0update_bootloader=tftp ${loadaddr} ${tftppath}${bootloader} && setenv select_partition primary && upgrade ${loadaddr} ${filesize} && setenv select_partition secondary && upgrade ${loadaddr} ${filesize}\0set_cma_size=fdt addr ${dtb_loadaddr} ${dtb_a_block_size} && fdt get value cma_size /reserved-memory/linux,cma size; fdt get value cma_alignment /reserved-memory/linux,cma alignment; setexpr cma_start ${rootfs_loadaddr} - ${cma_size}; setenv bootargs ${bootargs} cma=${cma_size}@0x${cma_start}; run cma_check\0update_bootargs=setexpr md_ro_end ${md_ro_end} - 1; setenv bootargs ${bootargs} kernel_startaddr=0x${md_ro_start} kernel_endaddr=0x${md_ro_end}\0cpu_freq=2028000\0led_auth_success=led led1 on\0led_kern_start=led led3 blink 4\0led_inv_img=led led_green off; led led_blue off; led led_red on\0auth_rootfs=auth 5 ${loadaddr} ${rootfs_a_filesize}; if test $? -ne 0; then led led1 off; led led2 blink 4 && exit 1; else exit 0; fi\0auth_dtb=auth 4 ${dtb_loadaddr} ${dtb_a_block_size}; if test $? -ne 0; then led led1 off; led led2 blink 4 && exit 1; else exit 0; fi\0auth_kernel=auth 4 0x8200040 ${kernel_a_filesize}; if test $? -ne 0; then led led1 off; led led2 blink 4 && exit 1; else exit 0; fi\0assert_cma_alignment=setexpr result ${rootfs_alignment} % ${cma_alignment}; if test $result -eq 0; then setexpr ret 0; else echo \"CMA size is not a multiple or larger than RootFS size\"; setexpr ret 1; fi;\0assert_cma_size_align=setexpr result ${cma_size} % ${cma_alignment}; if test $result -eq 0; then setexpr ret 0; else echo \"CMA size not aligned, pls check DTS\"; setexpr ret 1; fi;\0cma_check=run assert_cma_size_align; if test $ret > 0; then false; else run assert_cma_alignment; if test $ret > 0; then false; else true; fi; fi;\0"
CONFIG_ROOTFS_A_SIZE=0x4000000
CONFIG_ROOTFS_B_SIZE=0x4000000
CONFIG_FILESYSTEM_PART_A="extended_boot_a"
CONFIG_FILESYSTEM_PART_B="extended_boot_b"
CONFIG_UPGRADE_PART="upgrade_partition"
CONFIG_FILESYSTEM_IMG="ext4.fs"
CONFIG_TOTAL_GPT_PARTITION=18
CONFIG_LGM_PART_LIST="name=uboot_a,start=512k,size=1M;name=uboot_b,size=1M;name=tep_firmware_a,size=2M;name=tep_firmware_b,size=2M;name=dtb_a,size=512k;name=dtb_b,size=512k;name=env_a,size=512k;name=env_b,size=512k;name=extended_boot_a,start=9M,size=112M;name=extended_boot_b,size=112M;name=securestore_a,size=16M;name=securestore_b,size=16M;name=calibration_a,size=2M;name=calibration_b,size=2M;name=upgrade_partition,size=128M;name=overlay_container_a,size=32M;name=overlay_container_b,size=32M;name=log_partition,size=32M;"
CONFIG_NET=y
CONFIG_CMD_NET=y
CONFIG_CMD_PING=y
CONFIG_DM_ETH=y
CONFIG_NETDEVICES=y
CONFIG_LIGHTNING_MOUNTAIN_ETH=y
CONFIG_LGM_P34X_SUPPORT=y
CONFIG_IP_ADDRESS="192.168.1.1"
CONFIG_SERVER_IP_ADDRESS="192.168.1.2"
CONFIG_ETHERNET_ADDRESS="00:E0:92:00:01:40"
CONFIG_ETHERNET_DEVICE="eth0"
CONFIG_CPU_ADDR_BITS=36
CONFIG_ATOM=y
CONFIG_DEBUG_UART=y
CONFIG_DEBUG_SIMPLIFY=y
CONFIG_SMP_CORES=0x4
CONFIG_LGM_EPU=y
CONFIG_LGM_CPU_1560M=y
CONFIG_LGM_CPU_FREQ=0x14
CONFIG_TARGET_U_BOOT_LIGHTNING=y
CONFIG_INTEL_UCODE_PATCH=y
CONFIG_ASSERT_FIREWALL_RULES=y
# CONFIG_ENABLE_IA_VMM_SWITCH is not set
# CONFIG_TEP_PKG is not set
CONFIG_BOOT_FROM_EMMC=y
CONFIG_CHD_SECURE_BOOT=y
# CONFIG_CHD_SECURE_BOOT_WITHOUT_SIGNING is not set
CONFIG_SIGNTOOL="/nfs/site/proj/chdsw_ci/telco/dist/Secureboot_Keys/LGM_Tools/signtool"
CONFIG_PRIVATE_KEY="/nfs/site/proj/chdsw_ci/telco/dist/Secureboot_Keys/LGM_Keys_Vault/Product/384-bit_keypair_product.der"
CONFIG_PROD_UNIQUE_KEY="/nfs/site/proj/chdsw_ci/telco/dist/Secureboot_Keys/LGM_Keys_Vault/Product/256-bit_huk_product.bin"
# CONFIG_ENCRYPTION_SUPPORT is not set
# CONFIG_ROLLBACKID_SUPPORT is not set
# CONFIG_ROLLBACKID_VALUE is not set
# CONFIG_CERTIFICATION_SUPPORT is not set
# CONFIG_CERTIFICATION is not set
# CONFIG_LGM_SECURE_UART is not set
CONFIG_X86_TSC_TIMER_FREQ=2496000000
CONFIG_TIMER_EARLY=y
CONFIG_X86_LOAD_FROM_32_BIT=y
CONFIG_RAMBASE=0x100000
CONFIG_X86_RESET_VECTOR=y
CONFIG_USE_EARLY_BOARD_INIT=y
CONFIG_BOARD_EARLY_INIT_R=y
CONFIG_LOCALVERSION=" URX851-EMMC-SECURE_PRODUCT_FIELD_IMAGE-FOR-REFERENCE-ONLY"
# CONFIG_CC_IS_GCC=y
# CONFIG_GCC_VERSION=80300
CONFIG_CLANG_VERSION=0
CONFIG_CC_OPTIMIZE_FOR_SIZE=y
# CONFIG_OPTIMIZE_INLINING is not set
# CONFIG_SPL_OPTIMIZE_INLINING is not set
CONFIG_CC_HAS_ASM_INLINE=y
# CONFIG_XEN is not set
# CONFIG_DISTRO_DEFAULTS is not set
# CONFIG_ENV_VARS_UBOOT_CONFIG is not set
# CONFIG_SYS_BOOT_GET_CMDLINE is not set
# CONFIG_SYS_BOOT_GET_KBD is not set
CONFIG_SYS_MALLOC_F=y
CONFIG_EXPERT=y
CONFIG_SYS_MALLOC_CLEAR_ON_INIT=y
CONFIG_SPL_IMAGE="spl/u-boot-spl-emmc.bin"
CONFIG_SYS_LOAD_ADDR=0x08200000
CONFIG_PLATFORM_ELFENTRY="_start"
CONFIG_STACK_SIZE=0x2000000
CONFIG_SYS_SRAM_BASE=0x0
CONFIG_SYS_SRAM_SIZE=0x0
CONFIG_LEGACY_IMAGE_FORMAT=y
CONFIG_SYS_EXTRA_OPTIONS=""
CONFIG_HAVE_SYS_TEXT_BASE=y
CONFIG_ARCH_FIXUP_FDT_MEMORY=y
CONFIG_BOOTSTAGE_STASH_SIZE=0x1000
CONFIG_DEBUG_UART_BASE=0xE0A00000
CONFIG_DEBUG_UART_CLOCK=115200
CONFIG_SD_BOOT=y
CONFIG_AUTOBOOT=y
CONFIG_USE_PREBOOT=y
CONFIG_LOGLEVEL=4
CONFIG_DISPLAY_CPUINFO=y
CONFIG_BOARD_LATE_INIT=y
CONFIG_SUPPORT_SPL=y
CONFIG_SUPPORT_TPL=y
CONFIG_SPL_SYS_STACK_F_CHECK_BYTE=0xaa
CONFIG_SPL_SYS_MALLOC_SIMPLE=y
# CONFIG_SPL_BANNER_PRINT is not set
CONFIG_SPL_CRC32=y
CONFIG_SPL_I2C=y
CONFIG_SYS_MMCSD_FS_BOOT_PARTITION=1
CONFIG_SPL_MMC_TINY=y
CONFIG_SPL_MMC_WRITE=y
CONFIG_CMDLINE=y
CONFIG_CMDLINE_EDITING=y
CONFIG_HUSH_PARSER=y
CONFIG_AUTO_COMPLETE=y
CONFIG_SYS_LONGHELP=y
CONFIG_SYS_PROMPT="=> "
CONFIG_SYS_XTRACE=y
CONFIG_CMD_BOOTM=y
CONFIG_CMD_LOADB=y
CONFIG_RECOVER_PRIMARY_IMG="run overwrite_new_img; run reset_uboot_config; reset"
# CONFIG_CMD_BOOTD is not set
# CONFIG_BOOTM_PLAN9 is not set
# CONFIG_BOOTM_RTEMS is not set
# CONFIG_BOOTM_VXWORKS is not set
CONFIG_BOOTM_LINUX=y
CONFIG_CMD_IMI=y
# CONFIG_CMD_XIMG is not set
CONFIG_CMD_FDT=y
CONFIG_CMD_GO=y
CONFIG_CMD_RUN=y
CONFIG_CMD_EDITENV=y
CONFIG_CMD_SAVEENV=y
CONFIG_CMD_CRC32=y
CONFIG_CMD_MEMORY=y
CONFIG_CMD_I2C=y
# CONFIG_CMD_LOADS is not set
# CONFIG_CMD_RANDOM is not set
CONFIG_CMD_MMC=y
# CONFIG_CMD_PCI is not set
CONFIG_CMD_GPT=y
CONFIG_RANDOM_UUID=y
CONFIG_CMD_GPT_RENAME=y
CONFIG_CMD_ECHO=y
CONFIG_CMD_ITEST=y
CONFIG_CMD_SOURCE=y
CONFIG_CMD_SETEXPR=y
CONFIG_CMD_CACHE=y
CONFIG_CMD_SLEEP=y
# CONFIG_CMD_AUTH is not set
# CONFIG_CMD_ICC is not set
# CONFIG_CMD_IA_SWITCH is not set
CONFIG_CMD_EXT4=y
CONFIG_CMD_EXT4_WRITE=y
CONFIG_CMD_FS_GENERIC=y
CONFIG_CMD_FS_UUID=y
CONFIG_PARTITIONS=y
CONFIG_EFI_PARTITION=y
CONFIG_EFI_PARTITION_ENTRIES_NUMBERS=128
CONFIG_EFI_PARTITION_ENTRIES_OFF=0
CONFIG_PARTITION_UUIDS=y
CONFIG_SUPPORT_OF_CONTROL=y
CONFIG_PYLIBFDT=y
CONFIG_OF_CONTROL=y
CONFIG_OF_REAL=y
CONFIG_SPL_OF_CONTROL=y
CONFIG_OF_EMBED=y
CONFIG_OF_SPL_REMOVE_PROPS="clocks clock-names interrupt-parent interrupts"
CONFIG_SPL_OF_REAL=y
CONFIG_ENV_SUPPORT=y
CONFIG_SAVEENV=y
CONFIG_ENV_IS_IN_MMC=y
CONFIG_SYS_REDUNDAND_ENVIRONMENT=y
CONFIG_ENV_OFFSET=0x780000
CONFIG_ENV_OFFSET_REDUND=0x800000
CONFIG_DM=y
CONFIG_SPL_DM=y
CONFIG_DM_WARN=y
CONFIG_DM_STDIO=y
CONFIG_DM_SEQ_ALIAS=y
CONFIG_SPL_DM_INLINE_OFNODE=y
# CONFIG_DM_DEVICE_REMOVE is not set
CONFIG_REGMAP=y
CONFIG_SPL_REGMAP=y
CONFIG_SYSCON=y
CONFIG_SPL_SYSCON=y
CONFIG_SIMPLE_BUS=y
CONFIG_SPL_SIMPLE_BUS=y
CONFIG_OF_TRANSLATE=y
# CONFIG_ACPIGEN is not set
# CONFIG_SPL_OF_TRANSLATE is not set
# CONFIG_TRANSLATION_OFFSET is not set
CONFIG_DM_DEV_READ_INLINE=y
#
# Bus devices
#
CONFIG_GPIO=y
CONFIG_MXL_LGM_GPIO=y
CONFIG_I2C=y
CONFIG_DM_I2C=y
# CONFIG_SPL_DM_I2C is not set
CONFIG_SPL_SYS_I2C_LEGACY=y
CONFIG_SYS_I2C_DW=y
CONFIG_SYS_I2C_SLAVE=0x6a
CONFIG_SYS_I2C_SPEED=100000
# CONFIG_INPUT is not set
CONFIG_SPL_BLK=y
CONFIG_MMC=y
CONFIG_MMC_WRITE=y
CONFIG_DM_MMC=y
CONFIG_SPL_DM_MMC=y
CONFIG_MMC_QUIRKS=y
CONFIG_MMC_HW_PARTITIONING=y
CONFIG_MMC_SDHCI=y
CONFIG_MMC_SDHCI_ADMA=y
CONFIG_MMC_SDHCI_MXL=y
# CONFIG_MMC_VERBOSE is not set
CONFIG_SERIAL=y
CONFIG_BAUDRATE=115200
CONFIG_REQUIRE_SERIAL_CONSOLE=y
# CONFIG_SPECIFY_CONSOLE_INDEX is not set
CONFIG_SERIAL_PRESENT=y
CONFIG_SPL_SERIAL_PRESENT=y
CONFIG_DM_SERIAL=y
# CONFIG_SPL_DM_SERIAL is not set
CONFIG_DEBUG_UART_SHIFT=0
CONFIG_MXL_SERIAL=y
CONFIG_TIMER=y
CONFIG_SPL_TIMER=y
CONFIG_X86_TSC_TIMER=y
CONFIG_FS_EXT4=y
CONFIG_HAVE_ARCH_IOMAP=y
CONFIG_HAVE_PRIVATE_LIBGCC=y
CONFIG_LIB_UUID=y
CONFIG_PRINTF=y
CONFIG_SPL_PRINTF=y
CONFIG_SPRINTF=y
CONFIG_SPL_SPRINTF=y
CONFIG_STRTO=y
CONFIG_SPL_STRTO=y
CONFIG_USE_PRIVATE_LIBGCC=y
CONFIG_SYS_HZ=1000
CONFIG_SPL_USE_TINY_PRINTF=y
# CONFIG_PANIC_HANG is not set
CONFIG_REGEX=y
CONFIG_LIB_RAND=y

# CONFIG_DM_RTC is not set
# CONFIG_DM_SCSI is not set
# CONFIG_DM_VIDEO is not set
# CONFIG_BACKLIGHT is not set
# CONFIG_CMD_VIDCONSOLE is not set
# CONFIG_DM_KEYBOARD is not set
# CONFIG_USB_ETHER_ASIX is not set
# CONFIG_USB_ETHER_SMSC95XX is not set
# CONFIG_USB_HOST_ETHER is not set
# CONFIG_PCH is not set
# CONFIG_CMD_FPGA_LOADMK is not set
# CONFIG_CMD_GETTIME is not set
# CONFIG_CMD_IO is not set
# CONFIG_CMD_IRQ is not set
# CONFIG_PCI is not set
# CONFIG_CMD_BOOTEFI_BOOTMGR is not set
# CONFIG_EFI_LOADER is not set
# CONFIG_BINMAN_FDT is not set
# CONFIG_CHARSET is not set
# CONFIG_SYSRESET is not set
# CONFIG_SYSRESET_CMD_RESET is not set
# CONFIG_SYSINFO_SMBIOS is not set
# CONFIG_X86_PCH7 is not set
# CONFIG_X86_PCH9 is not set
# CONFIG_IRQ is not set
# CONFIG_CMD_ELF is not set
# CONFIG_DM_GPIO is not set
# CONFIG_SPL_SPI_FLASH_SUPPORT is not set
# CONFIG_SPL_SPI is not set
CONFIG_SPL_PAYLOAD="u-boot-emmc.bin"
CONFIG_BUILD_TARGET="u-boot-plus-spl-emmc.bin"
# CONFIG_SPL_FRAMEWORK is not set
# CONFIG_SPL_RAW_IMAGE_SUPPORT is not set
# CONFIG_SPL_LEGACY_IMAGE_SUPPORT is not set

#
# Hashing Support
#
CONFIG_CRC32=y

#
# Compression Support
#
CONFIG_LZMA=y
CONFIG_GZIP=y
CONFIG_ZLIB=y
CONFIG_OF_LIBFDT=y
CONFIG_OF_LIBFDT_ASSUME_MASK=0
CONFIG_SPL_OF_LIBFDT=y
CONFIG_SPL_OF_LIBFDT_ASSUME_MASK=0xff

#
# System tables
#
CONFIG_GENERATE_SMBIOS_TABLE=y
CONFIG_LMB=y
CONFIG_LMB_USE_MAX_REGIONS=y
CONFIG_LMB_MAX_REGIONS=8

#
# Tools options
#
CONFIG_MKIMAGE_DTC_PATH="dtc"
CONFIG_TOOLS_CRC32=y
CONFIG_TOOLS_HOST_CRC32=y
CONFIG_TOOLS_LIBCRYPTO=y
CONFIG_TOOLS_FIT=y
CONFIG_TOOLS_FIT_FULL_CHECK=y
CONFIG_TOOLS_FIT_PRINT=y
CONFIG_TOOLS_FIT_RSASSA_PSS=y
# CONFIG_TOOLS_FIT_SIGNATURE is not set
CONFIG_TOOLS_FIT_VERBOSE=y
# CONFIG_TOOLS_MD5 is not set
CONFIG_TOOLS_OF_LIBFDT=y
# CONFIG_TOOLS_SHA1 is not set
# CONFIG_TOOLS_SHA256 is not set
# CONFIG_TOOLS_SHA384 is not set
# CONFIG_TOOLS_SHA512 is not set
CONFIG_SERIAL_SHIFT_LGM=y
CONFIG_SERIAL_SHIFT_LGM_ENABLE_PIN=y
CONFIG_SERIAL_SHIFT_ENABLE_PIN_NO=9
CONFIG_CMD_SSO=y
CONFIG_CMD_GPIO=y
CONFIG_CMD_LED=y
CONFIG_LED=y
CONFIG_LED_BLINK=y
CONFIG_LED_LGM_SSO=y
CONFIG_LGM_SSO_PORT=0
CONFIG_LGM_SSO_LED_DUTY_CYCLE=255
CONFIG_LGM_SSO_LED1_PIN=y
CONFIG_LGM_SSO_LED1_PIN_NO=31
CONFIG_LGM_SSO_LED2_PIN=y
CONFIG_LGM_SSO_LED2_PIN_NO=30
CONFIG_LGM_SSO_LED3_PIN=y
CONFIG_LGM_SSO_LED3_PIN_NO=29
CONFIG_LGM_SSO_LED4_PIN=y
CONFIG_LGM_SSO_LED4_PIN_NO=28
CONFIG_LGM_SSO_LED5_PIN=y
CONFIG_LGM_SSO_LED5_PIN_NO=27
CONFIG_LGM_SSO_BLUE_LED_PIN=y
CONFIG_LGM_SSO_BLUE_LED_PIN_NO=26
CONFIG_LGM_SSO_GREEN_LED_PIN=y
CONFIG_LGM_SSO_GREEN_LED_PIN_NO=25
CONFIG_LGM_SSO_RED_LED_PIN=y
CONFIG_LGM_SSO_RED_LED_PIN_NO=24
CONFIG_LED_STATUS=y
CONFIG_LED_STATUS_OFF=0
CONFIG_LED_STATUS_BLINKING=1
CONFIG_LED_STATUS_ON=2
CONFIG_LED_STATUS_BOARD_SPECIFIC=y
CONFIG_LED_STATUS0=y
CONFIG_LED_STATUS_BIT=50
CONFIG_LED_STATUS_STATE=1
CONFIG_LED_STATUS_FREQ=4
CONFIG_LED_STATUS_BOOT_ENABLE=y
CONFIG_LED_STATUS_BOOT=0
# CONFIG_FLEXI_RBID is not set
# CONFIG_COMPATIBILITY_VER is not set
# CONFIG_SB_ENV_PROTECTION is not set
```
