## intel/feed_target_mips/image/Config.in
```kconfig
# Copyright (C) 2018 OpenWrt.org
#
# This is free software, licensed under the GNU General Public License v2.
# See /LICENSE for more information.
#

config INTEL_MIPS_FLASH_PROGRAMMER_IMAGE
	bool "Flash programmer image support" if IMAGEOPT
	depends on TARGET_intel_mips
	help
	   Enable to get binary images to use with flash programmer tool to program entire flash

config INTEL_MIPS_ROOTFS_DATA_SIZE
	int "Overlay (rootfs_data) UBI volume size in megabytes" if INTEL_MIPS_FLASH_PROGRAMMER_IMAGE
	default 32
	depends on TARGET_intel_mips
	help
	  Specify ubifs 'rootfs_data' volume (overlay) size. Please make sure not to provide all
	  available free space of NAND partition to overlay. Reserve atleast 2% of flash for bad block handling,
	  additional space for backup bank images and additional space for new features from future firmware
	  upgrades.

menuconfig INTEL_MIPS_SECBOOT
	bool "Secure Boot Image options for MIPS based Intel Platforms" if IMAGEOPT
	depends on (TARGET_intel_mips_xrx500||TARGET_intel_mips_xrx500_4kec||TARGET_intel_mips_prx300||TARGET_intel_mips_prx300_4kec)
	help
		These options allow to build secure boot image variant for
		Intel MIPS XRX500 Platform. Input signtool, public key and
		CRkey (Confidentiality Root Key) with optional Certificate 
		support and path

if INTEL_MIPS_SECBOOT
	config INTEL_MIPS_KEYS_PROVISION
		bool "provison of keys done"
		help
			keys path properly set

	config INTEL_MIPS_SIGNTOOL
		string "signtool (path)"
		default "signtool"
		help
			signtool as released to Customer
			If unspecified, it defaults to signtool.

	config INTEL_MIPS_PROD_UNIQUE_KEY
		string "product unique key(path)"
		default "CRkey.bin"
		help
			AES256 product unique key.
			If unspecified, it defaults to CRkey.bin

	config INTEL_MIPS_PRIVATE_KEY
		string "private key(path)"
		default "privatekey.der"
		help
			ECDSA256 private key.
			If unspecified, it defaults to privatekey.der

	config INTEL_MIPS_CERTIFICATION_SUPPORT
		bool "Certification Support"
		help
			enable chain of trust certificate.

	config INTEL_MIPS_CERTIFICATION
		string "certification(path)"
		default "cert.bin"
		depends on INTEL_MIPS_CERTIFICATION_SUPPORT
		help
			ECDSA256 certificate
			If unspecified, it defaults to cert.bin

	config INTEL_MIPS_ROLLBACK
		int "rollback id (0-63)"
		range 0 63
		default "0"
		help
			Rollback ID added in the image header.
endif
```

## intel_x86/image/rootfs-fit.its
```
/*
 * The image source file creates FIT image with filesystem.
 */

/dts-v1/;

/ {
	description = " FIT image with filesystem(MXL URX rootfs)";

	images {
		filesystem {
			description = "Mxl URX rootfs filesystem";
			data = /incbin/("ROOTFS");
			type = "filesystem";
			arch = "x86";
			os = "linux";
			compression = "none";
			load = <00000000>;
			entry = <00000000>;
			hash-1 {
				algo = "sha1";
			};
		};
	};

	configurations {
		default = "rootfs-conf";
		rootfs-conf {
			description = "Mxl URX rootfs";
			filesystem = "filesystem";
		};
	};
};
```
