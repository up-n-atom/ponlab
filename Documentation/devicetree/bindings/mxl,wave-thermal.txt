## Documentation/devicetree/bindings/mxl,wave-thermal.txt
```
* WAVE Thermal

This describes the device tree binding for WAVE thermal management.

Required properties:
- compatible:
  - "mxl,wave" : For WAVE Gen6 family of SoCs
- #thermal-sensor-cells : Should be 0. See Kernel Documentation/devicetree/bindings/thermal/thermal-sensor.yaml for a description.
- max-cooling-state : Max number of cooling states defined for the device.
- cooling-states : Cooling states parameter defines {type param} array.
                   Type specifies cooling method type which can be 0 or 1.
                    - 0 denotes DutyCycle based cooling method,
                    - 1 denotes Antenna count based cooling method.
                   Param value is defined as per the cooling method.
                    - DutyCycle param value ranges (10-90) specifying radio offtime in msec.
                    - Antenna count param value ranges (1-4) considering 4NSS as Max.
- #cooling-cells : Must be at least 2, in order to specify minimum and maximum cooling state used.

Example:
Device tree bindings:
--------------------
  wave_5_0: iwlwave@1 {
    compatible = "mxl,wave";
    wave-band = <0>;  /* 5GHz */
    /* type - 0/1,  param - param required for Cooling type
     * type 0 for Duty Cycle, 1 for Antenna count
     */
    max-cooling-state = <6>;
    cooling-states = <
      /* type param */
      0  30
      0  50
      0  80
      1  3
      1  2
      1  1
    >;
    #thermal-sensor-cells = <0>;
    #cooling-cells = <2>;
  };

Trips and cooling maps:
----------------------
    wave_5_0_thermal: wave_5_0-thermal {
      polling-delay-passive = <1000>; /* milliseconds */
      polling-delay = <1500>; /* milliseconds */

      thermal-sensors = <&wave_5_0>;

      trips {
        wave_5_0_alert0: wave_5_0-alert0 {
          temperature = <95000>; /* millicelsius */
          hysteresis = <5000>; /* millicelsius */
          type = "active";
        };

        wave_5_0_alert1: wave_5_0-alert1 {
          temperature = <110000>; /* millicelsius */
          hysteresis = <5000>; /* millicelsius */
          type = "passive";
        };

        wave_5_0_crit: wave_5_0-crit {
          temperature = <125000>;
          hysteresis = <5000>;
          type = "critical";
        };
      };

      cooling-maps {
        map0 {
          trip = <&wave_5_0_alert0>;
          cooling-device = <&wave_5_0 THERMAL_NO_LIMIT  3>;
        };
        map1 {
          trip = <&wave_5_0_alert1>;
          cooling-device = <&wave_5_0 4 6>;
        };
      };

    };
```

## Documentation/devicetree/bindings/net/mxl,vpn.txt
```
Maxlinear VPN driver

Maxlinear VPN driver is a driver that serves as interface between linux and VPN
ARC-EM6 firmware, used in Maxlinear LGM SoC.
Its job includes loading the firmware, provide necessary information to it,
and also miscellanous functionalities e.g. debugging features. It also need
to interracts with other modules i.e. datapath and PPA.

Required properties:
- compatible	: should be "mxl,lgm-vpn" (A-Step) or "mxl,lgm-vpn-b" (B-Step)
- resets	: list of phandle and reset specifier pairs for ARC-EM6 firmware
- reset-names	: list of reset signal names. Should be "arcem".
		  See: Documentation/devicetree/bindings/reset/reset.txt
- mxl,sram	: list of phandle to VPN sram area
		  See: Documentation/devicetree/bindings/sram/sram.txt
- mxl,syscon	: phandle to sysconf chiptop

Required properties for B-Step:
- interrupt-parent	: phandle to ioapic
- interrupts		: atom-to-arc interrupt specifier

Optional properties:
- umt-period-us	: UMT period (in us). Default to 10us if not defined.

Example:

sram@e7b00000 {
	compatible = "mmio-sram";
	reg = <0xe7b00000 0x4000>;
	#address-cells = <1>;
	#size-cells = <1>;
	ranges = <0 0xe7b00000 0x4000>;
	vpn_sram: vpn_sram@0 {
		reg = <0x0 0x4000>;
		pool;
	};
};

vpn: vpn {
	compatible = "mxl,lgm-vpn";
	resets = <&rcu0 0x70 12>;
	reset-names = "arcem";
	mxl,sram = <&vpn_sram>;
	mxl,syscon = <&sysconf>; /* chiptop */
};
```

## Documentation/devicetree/bindings/phy/mxl,combo-phy-lgmc.yaml
```yaml
# SPDX-License-Identifier: (GPL-2.0 OR BSD-2-Clause)
%YAML 1.2
---
$id: http://devicetree.org/schemas/phy/intel,combo-phy.yaml#
$schema: http://devicetree.org/meta-schemas/core.yaml#

title: MaxLinear ComboPhy Subsystem for LGM C-step

description: |
  MaxLinear Combophy subsystem supports PHYs for PCIe, EMAC and SATA
  controllers. A single Combophy provides two PHY instances.

properties:
  $nodename:
    pattern: "combophy(@.*|-[0-9a-f])*$"

  compatible:
    items:
      - const: mxl,combo-phy-lgmc

  clocks:
    maxItems: 1

  resets:
    maxItems: 2

  reset-names:
    items:
      - const: combo
      - const: phy

  intel,syscfg:
    $ref: /schemas/types.yaml#/definitions/phandle-array
    description: Chip configuration registers handle and ComboPhy instance id

  intel,hsio:
    $ref: /schemas/types.yaml#/definitions/phandle-array
    description: HSIO registers handle and ComboPhy instance id on NOC

  intel,bid:
    description: HSIO bus id

  intel,epu-idx:
    description: epu index to notify

required:
  - compatible
  - clocks
  - resets
  - reset-names
  - intel,syscfg
  - intel,hsio
  - intel,bid

examples:
  - |
    #include <dt-bindings/phy/phy.h>
    cb0phy0_cr: cbphy-app@d0a00000 {
        compatible = "mxl,cbphy-app-lgm", "syscon";
        reg = <0xd0a00000 0x40000>;
    };
    cb0phy0_app: cbphy-app@d0a40000 {
        compatible = "mxl,cbphy-app-lgm", "syscon";
        reg = <0xd0a40000 0x1000>;
    };
    combophy0:combophy0 {
        compatible = "intel,combo-phy", "simple-bus";
        #address-cells = <1>;
        #size-cells = <1>;
        ranges;
        resets = <&rcu0 0x50 17>, /* Combo */
                 <&rcu0 0x50 6>;  /* PCIe 10/11 PHY */
        reset-names = "combo", "phy";
        clocks = <&cgu0 LGM_CLK_CBPHY0>;
        intel,syscon = <&sysconf>; /* chiptop */
        intel,hsio = <&hsiol>; /* hsiol cbphy0 */
        intel,bid = <0>; /* hsio bus id */
        intel,epu-idx = <1>;
        cb0phy0:cb0phy@0 { /* PCIe 10/XPCS 0/SATA 0 */
            compatible = "intel,cbphy";
            #phy-cells = <1>;
            mxl,cr = <&cb0phy0_cr>;
            mxl,app = <&cb0phy0_app>;
            resets = <&rcu0 0x50 23>,
                     <&rcu0 0x50 12>;
            reset-names = "pcie", "xpcs";
        };
        cb0phy1:cb0phy@1 { /* PCIe 11/XPCS 1/SATA 1 */
            compatible = "intel,cbphy";
            #phy-cells = <1>;
            mxl,cr = <&cb0phy1_cr>;
            mxl,app = <&cb0phy1_app>;
            resets = <&rcu0 0x50 24>,
                     <&rcu0 0x50 13>;
            reset-names = "pcie", "xpcs";
        };
    };
```

## drivers/net/datapath/dp_oam/Kconfig
```kconfig
# SPDX-License-Identifier: GPL-2.0

config DP_OAM
	tristate "Datapath OAM driver"
	depends on DPM_DATAPATH && !GRX500_CBM

	help
	  This driver provides user space API for configuring OAM specific
	  hardware configuration. The Intel datapath driver is used to do the
	  actual hardware configuration.
```

## drivers/net/datapath/dpm/Kconfig
```kconfig
#
# Datapath Lib
#
menuconfig DPM_DATAPATH
	bool "Datapath Manager/Core/LIB"
	default y
	depends on LTQ_CBM || MXL_CBM
	help
	  Datapath Lib is to provide common rx/tx wrapper Lib without taking
	  care of much HW knowledge and also provide common interface for legacy
	  devices and different HW like to CBM or LRO.
	  Take note: All devices need to register to datapath Lib first

if DPM_DATAPATH

config DPM_DATAPATH_PARTIAL_FEEDS
	bool "Datapath in partial feeds"
	default y
	depends on PRX300_CQM || LGM_CQM
	help
	  Support dpm out of kernel tree but not fully sine some driver still 
	  calling dpm api which is built in kernel

config DPM_DATAPATH_DBG
	bool "Datapath Debug Tool"
	default y
	depends on DPM_DATAPATH
	help
	  Datapath Debug Tool is used to provide simple debug tool
	  All other debug tools is based on it
	  Once it is disabled, all other datapath debug tool disabled.
	  By default had better enable it

config DPM_DATAPATH_DBG_PROTOCOL_PARSE
	bool "Datapath Debug Tool for hw checksum's protocol parsing"
	depends on DPM_DATAPATH_DBG
	help
	  Datapath Debug Tool for hw checksum's protocol parsing
	  Only for debugging purpose
	  By default it should be disabled.

config DPM_DATAPATH_EXTRA_DEBUG
	bool "extra debugging support"
	depends on  DPM_DATAPATH_DBG
	help
	  This is to enable/disable extra strict debugging support.
	  This is useful during initial system bring up
	  It will affect performance
	  For production builds it should be disabled.

config DPM_DATAPATH_DEBUGFS
	bool "Datapath debugfs support"
	depends on DPM_DATAPATH && DEBUG_FS
	help
	  This option enables the datapath debug info via debugfs.
	  For production builds it should be disabled.


config DPM_DATAPATH_SWITCHDEV
	bool "Switchdev Support"
	depends on  DPM_DATAPATH && NET_SWITCHDEV && !GRX500_CBM
	help
	  Switchdev support for different switch in datapath

#
# Datapath Lib
#

config DPM_DATAPATH_HAL_GSWIP31
	bool "Datapath HAL"
	default y
	depends on DPM_DATAPATH && PRX300_CQM

config DPM_DATAPATH_HAL_GSWIP32
	bool "Datapath HAL"
	default y
	depends on DPM_DATAPATH && LGM_CQM

config DPM_DATAPATH_QOS_HAL
	bool "Datapath HAL-QOS"
	default y
	depends on PPV4 && (DPM_DATAPATH_HAL_GSWIP31 || DPM_DATAPATH_HAL_GSWIP32)

endif
```

## drivers/net/datapath/qos_notify/Kconfig
```kconfig
# SPDX-License-Identifier: GPL-2.0

config QOS_NOTIFY
	bool "QoS NOTIFY"
	default y
	help
		This module provides API to publish and subscribe QoS
		events like queue addition, deletion etc. QOS_TC and QOS_MGR are the publisher
		of these events whereas PPA is the subscriber.
```

## drivers/net/datapath/qos_tc/Kconfig
```kconfig
# SPDX-License-Identifier: GPL-2.0

config QOS_TC
	tristate "QoS TC driver"
	depends on DPM_DATAPATH && !GRX500_CBM
	select NET_SCH_RED
	select NET_ACT_COLMARK
	select NET_CLS_IND

	help
	  This driver provides user space API for configuring HW QoS over TC
	  resources as schedulers, queues etc. The interface is based on linux
	  tc offload interface. The Intel datapath driver is used to do the
	  actual hardware configuration.

config QOS_TC_KCOV
	bool "QoS TC KCOV"
	depends on KCOV && QOS_TC
	help
	  Enable coverage on QoS TC driver for fuzzing.

config QOS_TC_TRACING
	bool "QoS TC tracing support"
	depends on QOS_TC
	depends on EVENT_TRACING
	help
	  Select this to enable qos_tc tracing infrastructure.
```

## drivers/net/datapath/umt/Kconfig
```kconfig
# SPDX-License-Identifier: GPL-2.0

config MXL_UMT
	bool "User message transfer driver"

	help
	  This driver supports MaxLinear UMT Hardware.
	  UMT HW is designed to work with CQM HW to
	  send the RX/TX counter to PCIe Endpoint.

config MXL_UMT_TEST
	tristate "Testing driver for UMT driver"

	help
	  This test driver is used to test UMT function
	  in the case that PCIe Endpoint driver is not ready
	  or testing result not as expected.
	  This test driver doen't need PCIe HW support.
```

## drivers/net/datapath/xpcs/Kconfig
```kconfig
config MXL_XPCS
	tristate "Maxlinear XPCS driver support"
	select PHY_MXL_WAN_XPCS
	select GENERIC_PHY
	help
	  This driver provides support for XPCS.
```

## drivers/net/ppa/Kconfig
```kconfig
menu "PPA"

config PPA
        bool "Protocol Processing Accelerator"
        depends on SOC_LGM
        help
        Protocol Acceleration Engine

if PPA 

config PPA_API_DIRECTCONNECT
        bool "Direct connect Support for SOC"
        help
        Direct connect Support (e.g. WLAN) for PPA

config PPA_API_SW_FASTPATH
       bool "PPA software acceleration"
       default y
       help       
       PPA software acceleration enable

config PPA_TCP_LITEPATH
       bool "TCP litepath"
       depends on PPA_API_SW_FASTPATH
       default y
       help       
       PPA local TCP session Acceleration

config PPA_EXT_PKT_LEARNING
        bool "External packet learning driver"
        depends on (X86_INTEL_LGM || SOC_LGM)
        help
            External packet learning driver support for PPA

config PPA_BBF247_MODE1
        bool "BBF247 HGU Mode1 Feature"
        help
            BBF247 HGU Mode support in PPA driver

config PPA_UDP_LITEPATH
       bool "UDP litepath"
       depends on PPA_API_SW_FASTPATH
       default y
       help
       PPA local UDP session Acceleration
endif # PPA
endmenu
```

## drivers/net/sgam/Kconfig
```kconfig
menu "Bandwidth Monitoring"

config SGAM
	tristate "Session based accounting and metering"
	depends on SOC_LGM
	help
	  This module provides HW based packet counter and HW based metering
	  of the bandwidth to the group of sessions accelerated by HW.
	  These packet counters and meters can be created using the IOCTLs
	  provided in the sgam_api.h and the sessions can be added to these
	  counters and meters using the iptables extended target "GROUP".
endmenu
```

## drivers/soc/mxl/Kconfig
```kconfig
#
# Maxlinear SoC drivers
#

config SOC_MXL
	bool "MXL SoC platform"
	select SOC_BUS
	default n
	help
	  Say yes here to add support for the Maxlinear SoC drivers.

config SOC_LGM
	bool "LGM SoC Support"
	depends on SOC_MXL
	default n
	help
	  Say yes here to add support for the Maxlinear LGM SoC.
	  This driver will print LGM SoC version and chip
	  speed catagory. It also provides LGM SoC fuse infomation
	  to other drivers.

config MXL_FW_DOWNLOAD
	bool "Maxlinear SoC security Firmware download"
	depends on SOC_MXL
	default n
	help
	  This module provides Firemware downaload API that
	  would add firewall rules to protect the DDR that
	  used by fireware from corrupted by various error
	  operations, e.g. buffer overflow.
	  It only works for firmware that stay in DDR.

config MXL_NOC_FIREWALL
	bool "Maxlinear NOC firewall driver"
	default n
	help
	  This driver provides interface to request permission for
	  individul hardware modules and CPU. Requests would be sent
	  to security OS via regmap_icc driver API.
	  It provides firewall domain to user driver to hold static
	  firewall rules and notification chain to support dynamic
	  firewall rule request.

config MXL_NOC_FW_DEFAULT
	bool "Maxlinear NOC firewall default domain driver"
	depends on MXL_NOC_FIREWALL
	default n
	help
	  This driver register default firewall domain of MXL
	  NOC firewall. It is used to hold rules for those
	  register banks that shared by drivers but don't belong
	  to a certain driver. e.g. HSIO_L/HSIOL_R
	  It is also used to hold dynamic rules but not requested
	  via driver.

config MXL_SEC_GEN_POOL
	bool "Maxlinear security genpool driver"
	select GENERIC_ALLOCATOR
	depends on SOC_MXL
	default n
	help
	  This driver wraps genpool API with Maxlinear NOC firewall
	  rules. Firewall rule would be issued immediately after the
	  buffer allocated.

config MXL_LGM_SYSCTL
	bool "Maxlinear system control driver for LGM"
	default y
	help
	  This driver provides /proc/sys control for directly controlling
	  few system control parameters for LGM SoC. These params are
	  exported at /proc/sys/lgm_sysctl/* file system location.

config MXL_SKB_EXT
	bool "Maxlinear skb extension"
	depends on SOC_LGM
	depends on ARCH_SKB_EXT
	default y
	help
	  This flag provides skb extensions for MXL over ARCH_SKB_EXT.

config MXL_SKB_EXT_EXTMARK
	bool "Maxlinear skb extmark extension"
	depends on MXL_SKB_EXT
	help
	  This flag provides skb extmark extension over MXL_SKB_EXT.
```
