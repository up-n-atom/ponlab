## intel_x86/lgm/uboot_configs/lgp-urx851-sec-p34x-phy-2K-page-ebu_nand_defconfig
```kconfig
CONFIG_CREATE_ARCH_SYMLINK=y
CONFIG_SYS_CACHE_SHIFT_6=y
CONFIG_SYS_CACHELINE_SIZE=64
CONFIG_LINKER_LIST_ALIGN=8
CONFIG_X86=y
CONFIG_SYS_ARCH="x86"
CONFIG_SYS_CPU="atom"
CONFIG_SYS_SOC="lightning"
CONFIG_SYS_VENDOR="maxlinear"
CONFIG_SYS_BOARD="lightning"
CONFIG_SYS_CONFIG_NAME="lightning_mountain"
CONFIG_SPL_LDSCRIPT="board/$(BOARDDIR)/u-boot-spl.lds"
CONFIG_SYS_TEXT_BASE=0x08200000
CONFIG_SYS_MALLOC_LEN=0x8000000
CONFIG_SYS_MALLOC_F_LEN=0x1000
CONFIG_SPL_GPIO=y
CONFIG_SPL_LIBCOMMON_SUPPORT=y
CONFIG_SPL_LIBGENERIC_SUPPORT=y
CONFIG_NR_DRAM_BANKS=1
CONFIG_BOARD_SPECIFIC_OPTIONS=y
CONFIG_ENV_SIZE=0x80000
CONFIG_DEFAULT_DEVICE_TREE="lightning-mountain"
CONFIG_SPL_TEXT_BASE=0xBFF20000
CONFIG_SPL_SERIAL=y
CONFIG_SPL_DRIVERS_MISC=y
CONFIG_SPL_SYS_MALLOC_F_LEN=0x1000
CONFIG_ERR_PTR_OFFSET=0x0
CONFIG_SPL_SIZE_LIMIT=0x60000
CONFIG_SPL_SIZE_LIMIT_PROVIDE_STACK=0
CONFIG_SPL=y
CONFIG_DEBUG_UART_BASE=0xE0A00000
CONFIG_DEBUG_UART_CLOCK=115200
CONFIG_URX851_SOC=y
CONFIG_LIGHTNING_MOUNTAIN_SOC=y
CONFIG_UBOOT_RAM=y
CONFIG_VENDOR_MAXLINEAR=y
CONFIG_SYS_CAR_ADDR=0xECD00000
CONFIG_TARGET_LIGHTNING_MOUNTAIN=y
CONFIG_LGM_U_BOOT_SIZE=0x80000
CONFIG_DRIVER_LIGHTNING=y
CONFIG_WDT=y
CONFIG_CMD_WATCHDOG=y
CONFIG_WDT_LGM=y
CONFIG_WDT_TIMEOUT_VALUE=0x0002BF20
CONFIG_SPL_WATCHDOG=y
CONFIG_PMIC_CONFIGURATIONS=y
CONFIG_ROHM_PMIC=y
CONFIG_ROC_VOLTAGE=0x3D
CONFIG_LIGHTNING_B0=y
CONFIG_BOARD_ANYWAN_LIGHTNING=y
CONFIG_LGM_MEM_SIZE=2048
CONFIG_LGM_LPDDR4=y
CONFIG_LGM_FREQ_3733M=y
CONFIG_MAX_RBE_PER_PART=1
CONFIG_SPL_PAD_SIZE=0x40000
CONFIG_COPIES_OF_RBE=0x1
CONFIG_RECOVERY_SPL_PAD_SIZE=0x16000
CONFIG_NAND_FLASH_MXL_256M=y
CONFIG_NAND_FLASH_SIZE=256
CONFIG_PREBOOT="echo; echo run \"bootcmd\" to bring up the kernel; echo;"
CONFIG_BOOTDELAY=5
CONFIG_MAX_BOOT_COUNTER=3
CONFIG_LOADADDR=0x8200000
CONFIG_DTB_LOADADDR=0x8000000
CONFIG_ROOTFS_LOADADDR=0x40000000
CONFIG_BOOTCOMMAND="run ubi_init; run flashargs addmisc; ubi read ${rootfs_loadaddr} ${rootfs_vol} && auth 5 ${rootfs_loadaddr} ${rootfs_a_filesize} && cp.b 0x40000000 ${rootfs_loadaddr} ${rootfs_a_filesize} && ubi read ${dtb_loadaddr} ${dtb_vol} && auth 4 ${dtb_loadaddr} dtb_a_filesize && run set_cma_size && ubi read ${kernel_loadaddr} ${kernel_vol} && auth 4 0x8200040 kernel_a_filesize && parsemd ${kernel_loadaddr} ${kernel_loadaddr} && run update_bootargs && icc 1 0x${md_ro_start} 0x${md_ro_end} 0x${rootfs_loadaddr} 0x800 && bootm ${kernel_loadaddr} - ${dtb_loadaddr}"
CONFIG_NFS_ARGS="setenv bootargs ubi.mtd=extended_boot,4096 root=/dev/nfs rw nfsroot=${serverip}:${rootpath}"
CONFIG_RAMARGS="setenv bootargs root=/dev/ram rw init=/init"
CONFIG_FLASHARGS="setenv bootargs ubi.mtd=extended_boot,2048 root=/dev/mtdblock0 rootfstype=squashfs rootwait"
CONFIG_ADDMISC="setenv bootargs ${bootargs} earlycon=lantiq,mmio32,0xe0a00000 console=ttyLTQ0,115200n8r ethaddr=${ethaddr} phram.phram=RAM0,0x${rootfs_loadaddr},0x${filesystem_size} ${mtdparts} maxcpus=4 mem=2048M memmap=31M$1M,0x${filesystem_size}$0x${rootfs_loadaddr} initcall_debug=0 loglevel=${kernel_loglvl} rootfs_startaddr=0x${rootfs_loadaddr} rootfs_endaddr=0x${rootfs_loadaddr_end} intel_pstate=active intel_idle.max_cstate=2 max_cpufreq=${max_cpu_freq} init_cstate_margin=1 init_pstate_threshold=20 epu_table_ver=${epu_table_ver} pci=pcie_bus_perf"
CONFIG_MTDIDS="nand0=e0f00000.nand-controller"
CONFIG_MTDPARTS="mtdparts=e0f00000.nand-controller:256k(rbe_a),512k(uboot_a),256k(rbe_b),512k(uboot_b),1m(tep_firmware_a),1m(tep_firmware_b),128m(extended_boot),64m(misc),16m(log),-(res)"
CONFIG_RESET_UBOOT_CONFIG="ubi part ${env_part} && ubi remove \"${env_vol_a}\"; ubi remove \"${env_vol_b}\";"
CONFIG_SWITCH_PRIMARY="setenv kernel_vol kernel_a; setenv rootfs_vol rootfs_a; setenv dtb_vol dtb_a"
CONFIG_SWITCH_SECONDARY="setenv kernel_vol kernel_b; setenv rootfs_vol rootfs_b; setenv dtb_vol dtb_b"
CONFIG_UPGRADE_FS_INIT="ubi part misc && ubifsmount ubi1:${upgrade_volume}"
CONFIG_UBI_INIT="ubi part ${env_part} && ubi check \"${env_vol_a}\"; if test $? -eq 1; then ubi create \"${env_vol_a}\" ${env_size} && ubi create \"${env_vol_b}\" ${env_size}; else echo \"ENV already exist\"; fi; ubi part extended_boot;"
CONFIG_UPDATE_UBOOT="tftp ${loadaddr} ${tftppath}${u-boot} && run ubi_init && setenv select_partition primary && upgrade ${loadaddr} ${filesize}"
CONFIG_UPDATE_RBE="tftp ${loadaddr} ${tftppath}${rbe} && run ubi_init && setenv select_partition primary && upgrade ${loadaddr} ${filesize}"
CONFIG_UPDATE_BOOTLOADER="tftp ${loadaddr} ${tftppath}${bootloader} && run ubi_init && setenv select_partition primary && upgrade ${loadaddr} ${filesize}"
CONFIG_UPDATE_FULLIMAGE="tftpboot ${loadaddr} ${tftppath}${fullimage} && run ubi_init && setenv select_partition primary && upgrade ${loadaddr} ${filesize} && if true; then ubi remove rootfs_data; ubi create rootfs_data 1000000; fi"
CONFIG_UPDATE_KERNEL="tftpboot ${loadaddr} ${tftppath}${bootfile} && run ubi_init && ubi remove ${kernel_vol} ; ubi create ${kernel_vol} ${filesize}; ubi write ${loadaddr} ${kernel_vol} ${filesize}"
CONFIG_UPDATE_DTB="tftpboot ${loadaddr} ${tftppath}${dtb} && run ubi_init && ubi remove ${dtb_vol} ; ubi create ${dtb_vol} ${filesize}; ubi write ${loadaddr} ${dtb_vol} ${filesize}"
CONFIG_UPDATE_ROOTFS="tftpboot ${loadaddr} ${tftppath}${rootfs} && run ubi_init && ubi remove ${rootfs_vol} ; ubi create ${rootfs_vol} ${filesize}; ubi write ${loadaddr} ${rootfs_vol} ${filesize}"
CONFIG_NET_RAM="tftpboot ${loadaddr} ${tftppath}${bootfile}; run nfsargs addmisc; bootm ${loadaddr}"
CONFIG_U_BOOT="u-boot-plus-spl-nand.bin"
CONFIG_RBE_BINARY="u-boot-spl-nand.bin"
CONFIG_BOOTLOADER_BINARY="u-boot-nand.bin"
CONFIG_DTB="openwrt-intel_x86-lgm-CBSP_B0-lgp_b0.dtb"
CONFIG_ROOTFS="/openwrt-intel_x86-lgm-CBSP_B0-squashfs-fs.rootfs"
CONFIG_FULLIMAGE="openwrt-intel_x86-lgm-CBSP_B0-lgp_b0_fullimage.img"
CONFIG_TEP_FIRMWARE="tep_fw.bin"
CONFIG_UPDATE_TEP_FIRMWARE="tftpboot ${loadaddr} ${tftppath}${tep_firmware} && run ubi_init && setenv select_partition primary && upgrade ${loadaddr} ${filesize}"
CONFIG_CHECK_IMAGE="echo check image"
CONFIG_BOOTFILE="/openwrt-intel_x86-lgm-CBSP_B0-kernel.bin"
CONFIG_ROOTFS_A_SIZE=0x5000000
CONFIG_ROOTFS_B_SIZE=0x5000000
CONFIG_IP_ADDRESS="192.168.1.1"
CONFIG_SERVER_IP_ADDRESS="192.168.1.2"
CONFIG_ETHERNET_ADDRESS="00:E0:92:00:01:40"
CONFIG_ETHERNET_DEVICE="eth0"
CONFIG_EXTRA_ENV_DATA="cpu_freq=2028000\0env_size=0x80000\0env_part=\'misc\'\0env_vol_a=\'ubootconfig_a\'\0env_vol_b=\'ubootconfig_b\'\0udt_num=0\0udt_file_1=\"${dtb}\"\0udt_loc=${dtb_vol}\0upgrade_vol=upgrade\0kernel_loglvl=4\0set_cma_size=fdt addr ${dtb_loadaddr} ${dtb_a_block_size} && fdt get value cma_size /reserved-memory/linux,cma size; fdt get value cma_alignment /reserved-memory/linux,cma alignment; setexpr cma_start ${rootfs_loadaddr} - ${cma_size}; setenv bootargs ${bootargs} cma=${cma_size}@0x${cma_start}; run cma_check\0update_bootargs=setexpr md_ro_end ${md_ro_end} - 1; setenv bootargs ${bootargs} kernel_startaddr=0x${md_ro_start} kernel_endaddr=0x${md_ro_end}\0assert_cma_alignment=setexpr result ${rootfs_alignment} % ${cma_alignment}; if test $result -eq 0; then setexpr ret 0; else echo \"CMA size is not a multiple or larger than RootFS size\"; setexpr ret 1; fi;\0assert_cma_size_align=setexpr result ${cma_size} % ${cma_alignment}; if test $result -eq 0; then setexpr ret 0; else echo \"CMA size not aligned, pls check DTS\"; setexpr ret 1; fi;\0cma_check=run assert_cma_size_align; if test $ret > 0; then false; else run assert_cma_alignment; if test $ret > 0; then false; else true; fi; fi;\0"
CONFIG_CPU_ADDR_BITS=36
CONFIG_DEBUG_UART=y
CONFIG_DEBUG_SIMPLIFY=y
CONFIG_ATOM=y
CONFIG_SMP_CORES=0x4
CONFIG_LGM_EPU=y
CONFIG_LGM_CPU_1560M=y
CONFIG_LGM_CPU_FREQ=0x14
CONFIG_TARGET_U_BOOT_LIGHTNING=y
CONFIG_INTEL_UCODE_PATCH=y
CONFIG_ASSERT_FIREWALL_RULES=y
CONFIG_ENABLE_IA_VMM_SWITCH=y
CONFIG_TEP_PKG=y
CONFIG_NAND_SPL_TEXT_BASE=0xBFF20000
CONFIG_BOOT_FROM_NAND=y
CONFIG_CHD_SECURE_BOOT=y
# CONFIG_CHD_SECURE_BOOT_WITHOUT_SIGNING is not set
CONFIG_SIGNTOOL="/nfs/site/proj/chdsw_ci/telco/dist/Secureboot_Keys/LGM_Tools/signtool"
CONFIG_PRIVATE_KEY="/nfs/site/proj/chdsw_ci/telco/dist/Secureboot_Keys/LGM_Keys_Vault/Product/384-bit_keypair_product_a.der"
CONFIG_PROD_UNIQUE_KEY="/nfs/site/proj/chdsw_ci/telco/dist/Secureboot_Keys/LGM_Keys_Vault/Product/256-bit_huk_product.bin"
# CONFIG_ENCRYPTION_SUPPORT is not set
CONFIG_ROLLBACKID_SUPPORT=y
CONFIG_ROLLBACKID_VALUE=5
CONFIG_CERTIFICATION_SUPPORT=y
CONFIG_CERTIFICATION="/nfs/site/proj/chdsw_ci/telco/dist/Secureboot_Keys/LGM_Keys_Vault/Product/384-bit_certificate_product_a.bin"
CONFIG_LGM_SECURE_UART=y
CONFIG_X86_TSC_TIMER_FREQ=2496000000
CONFIG_X86_LOAD_FROM_32_BIT=y
CONFIG_RAMBASE=0x100000
CONFIG_X86_RESET_VECTOR=y
CONFIG_USE_EARLY_BOARD_INIT=y
CONFIG_BOARD_EARLY_INIT_R=y
CONFIG_USE_CAR=y
CONFIG_LOCALVERSION=" URX851-2K_PAGE-EBU_NAND-SECURE_BOOT"
CONFIG_LOCALVERSION_AUTO=y
CONFIG_CC_OPTIMIZE_FOR_SIZE=y
CONFIG_CC_HAS_ASM_INLINE=y
CONFIG_SYS_MALLOC_F=y
CONFIG_EXPERT=y
CONFIG_SYS_MALLOC_CLEAR_ON_INIT=y
CONFIG_SPL_IMAGE="spl/u-boot-spl-nand.bin"
CONFIG_SYS_LOAD_ADDR=0x08200000
CONFIG_PLATFORM_ELFENTRY="_start"
CONFIG_STACK_SIZE=0x2000000
CONFIG_SYS_SRAM_BASE=0x0
CONFIG_SYS_SRAM_SIZE=0x0
CONFIG_LEGACY_IMAGE_FORMAT=y
CONFIG_SYS_EXTRA_OPTIONS=""
CONFIG_HAVE_SYS_TEXT_BASE=y
CONFIG_ARCH_FIXUP_FDT_MEMORY=y
CONFIG_BOOTSTAGE_STASH_SIZE=0x1000
CONFIG_NAND_BOOT=y
CONFIG_AUTOBOOT=y
CONFIG_USE_PREBOOT=y
CONFIG_LOGLEVEL=0
CONFIG_SPL_LOGLEVEL=0
CONFIG_TPL_LOGLEVEL=0
CONFIG_DISPLAY_CPUINFO=y
CONFIG_BOARD_LATE_INIT=y
CONFIG_HASH=y
CONFIG_SUPPORT_SPL=y
# CONFIG_SPL_FRAMEWORK is not set
CONFIG_SPL_SYS_MALLOC_SIMPLE=y
CONFIG_SPL_CRC32=y
CONFIG_SPL_I2C=y
# CONFIG_SPL_DM_I2C is not set
# CONFIG_SPL_SPI is not set
CONFIG_SPL_PAYLOAD="u-boot-nand.bin"
CONFIG_BUILD_TARGET="u-boot-plus-spl-nand.bin"
# CONFIG_SPL_RAW_IMAGE_SUPPORT is not set
# CONFIG_SPL_LEGACY_IMAGE_SUPPORT is not set
CONFIG_SYS_MMCSD_FS_BOOT_PARTITION=1
CONFIG_SPL_NAND_SUPPORT=y
CONFIG_SPL_NAND_DRIVERS=y
CONFIG_CMDLINE=y
CONFIG_HUSH_PARSER=y
CONFIG_CMDLINE_EDITING=y
# CONFIG_AUTO_COMPLETE is not set
# CONFIG_SYS_LONGHELP is not set
CONFIG_SYS_PROMPT="=> "
CONFIG_SYS_PROMPT_HUSH_PS2="> "
# CONFIG_CMD_BDI is not set
# CONFIG_CMD_CONFIG is not set
# CONFIG_CMD_CONSOLE is not set
# CONFIG_CMD_LICENSE is not set
# CONFIG_CMD_PMC is not set
# CONFIG_CMD_BOOTD is not set
CONFIG_CMD_BOOTM=y
# CONFIG_CMD_BOOTZ is not set
CONFIG_BOOTM_LINUX=y
# CONFIG_BOOTM_NETBSD is not set
# CONFIG_BOOTM_PLAN9 is not set
# CONFIG_BOOTM_RTEMS is not set
# CONFIG_BOOTM_VXWORKS is not set
CONFIG_CMD_UPGRADE=y
# CONFIG_CMD_BOOTMENU is not set
# CONFIG_CMD_ADTIMG is not set
# CONFIG_CMD_ELF is not set
CONFIG_CMD_FDT=y
CONFIG_CMD_GO=y
CONFIG_CMD_RUN=y
# CONFIG_CMD_IMI is not set
# CONFIG_CMD_IMLS is not set
# CONFIG_CMD_XIMG is not set
CONFIG_CMD_ZBOOT=y
# CONFIG_CMD_ASKENV is not set
# CONFIG_CMD_EXPORTENV is not set
# CONFIG_CMD_IMPORTENV is not set
# CONFIG_CMD_EDITENV is not set
# CONFIG_CMD_GREPENV is not set
CONFIG_CMD_SAVEENV=y
# CONFIG_CMD_ERASEENV is not set
CONFIG_CMD_CRC32=y
CONFIG_SYS_EEPROM_PAGE_WRITE_DELAY_MS=0
CONFIG_CMD_MEMORY=y
CONFIG_CMD_DM=y
CONFIG_CMD_GPIO=y
CONFIG_CMD_SSO=y
CONFIG_CMD_I2C=y
CONFIG_CMD_LOADB=y
# CONFIG_CMD_LOADS is not set
# CONFIG_CMD_MTD is not set
# CONFIG_CMD_FLASH is not set
# CONFIG_CMD_IO is not set
CONFIG_CMD_NAND=y
CONFIG_CMD_NAND_LOCK_UNLOCK=y
# CONFIG_CMD_PCI is not set
CONFIG_CMD_ECHO=y
CONFIG_CMD_ITEST=y
# CONFIG_CMD_SOURCE is not set
CONFIG_CMD_SETEXPR=y
CONFIG_CMD_CACHE=y
CONFIG_CMD_AUTH=y
CONFIG_CMD_ICC=y
CONFIG_CMD_IA_SWITCH=y
CONFIG_CMD_NET=y
# CONFIG_CMD_BOOTP is not set
CONFIG_CMD_TFTPBOOT=y
CONFIG_NET_TFTP_VARS=y
# CONFIG_CMD_NFS is not set
CONFIG_CMD_PING=y
CONFIG_CMD_LED=y
CONFIG_CMD_SLEEP=y
CONFIG_CMD_MTDPARTS=y
# CONFIG_CMD_DATE is not set
# CONFIG_CMD_GETTIME is not set
# CONFIG_CMD_MTDPARTS_SPREAD is not set
# CONFIG_CMD_MTDPARTS_SHOW_NET_SIZES is not set
CONFIG_MTDIDS_DEFAULT=""
CONFIG_MTDPARTS_DEFAULT=""
# CONFIG_CMD_IRQ is not set
CONFIG_CMD_UBI=y
CONFIG_CMD_UBIFS=y
# CONFIG_PARTITIONS is not set
CONFIG_SUPPORT_OF_CONTROL=y
CONFIG_OF_CONTROL=y
CONFIG_OF_REAL=y
CONFIG_SPL_OF_CONTROL=y
CONFIG_OF_EMBED=y
CONFIG_SPL_OF_REAL=y
CONFIG_ENV_SUPPORT=y
CONFIG_SAVEENV=y
CONFIG_ENV_IS_IN_UBI=y
CONFIG_SYS_REDUNDAND_ENVIRONMENT=y
CONFIG_ENV_UBI_PART="misc"
CONFIG_ENV_UBI_VOLUME="ubootconfig_a"
CONFIG_ENV_UBI_VOLUME_REDUND="ubootconfig_b"
CONFIG_ENV_UBI_VID_OFFSET=0
CONFIG_NET=y
CONFIG_TFTP_BLOCKSIZE=1468
CONFIG_TFTP_WINDOWSIZE=1
CONFIG_SERVERIP_FROM_PROXYDHCP_DELAY_MS=100
CONFIG_DM=y
CONFIG_SPL_DM=y
# CONFIG_DM_DEVICE_REMOVE is not set
# CONFIG_REGMAP is not set
# CONFIG_DM_WARN is not set
# CONFIG_DM_STDIO is not set
# NFIG_DM_SEQ_ALIAS is not set
CONFIG_SYSCON=y
# CONFIG_SPL_SYSCON is not set
CONFIG_SIMPLE_BUS=y
CONFIG_SPL_SIMPLE_BUS=y
CONFIG_OF_TRANSLATE=y
CONFIG_DM_DEV_READ_INLINE=y
# CONFIG_SPL_REGMAP is not set
# CONFIG_SPL_BLK is not set
# CONFIG_BLOCK_CACHE is not set
# CONFIG_AHCI is not set
# CONFIG_ACPIGEN is not set
# CONFIG_INPUT is not set
# CONFIG_DM_KEYBOARD is not set
# CONFIG_IRQ is not set
# CONFIG_DM_MMC is not set
CONFIG_GPIO=y
# CONFIG_DM_GPIO is not set
CONFIG_MXL_LGM_GPIO=y
CONFIG_I2C=y
CONFIG_DM_I2C=y
CONFIG_SPL_SYS_I2C_LEGACY=y
CONFIG_SYS_I2C_DW=y
CONFIG_SYS_I2C_SLAVE=0x6a
CONFIG_SYS_I2C_SPEED=100000
CONFIG_LED=y
CONFIG_LED_BLINK=y
CONFIG_LED_LGM_SSO=y
CONFIG_SERIAL_SHIFT_LGM_ENABLE_PIN=y
CONFIG_SERIAL_SHIFT_ENABLE_PIN_NO=9
CONFIG_LGM_SSO_PORT=0
CONFIG_LGM_SSO_LED_DUTY_CYCLE=255
CONFIG_LGM_SSO_LED1_PIN=y
CONFIG_LGM_SSO_LED1_PIN_NO=31
CONFIG_LGM_SSO_LED2_PIN=y
CONFIG_LGM_SSO_LED2_PIN_NO=30
CONFIG_LGM_SSO_LED3_PIN=y
CONFIG_LGM_SSO_LED3_PIN_NO=29
CONFIG_LGM_SSO_LED4_PIN=y
CONFIG_LGM_SSO_LED4_PIN_NO=28
CONFIG_LGM_SSO_LED5_PIN=y
CONFIG_LGM_SSO_LED5_PIN_NO=27
CONFIG_LGM_SSO_BLUE_LED_PIN=y
CONFIG_LGM_SSO_BLUE_LED_PIN_NO=26
CONFIG_LGM_SSO_GREEN_LED_PIN=y
CONFIG_LGM_SSO_GREEN_LED_PIN_NO=25
CONFIG_LGM_SSO_RED_LED_PIN=y
CONFIG_LGM_SSO_RED_LED_PIN_NO=24
CONFIG_SERIAL_SHIFT_LGM=y
CONFIG_LED_STATUS=y
CONFIG_LED_STATUS_OFF=0
CONFIG_LED_STATUS_BLINKING=1
CONFIG_LED_STATUS_ON=2
CONFIG_LED_STATUS_BOARD_SPECIFIC=y
CONFIG_LED_STATUS0=y
CONFIG_LED_STATUS_BIT=50
CONFIG_LED_STATUS_STATE=1
CONFIG_LED_STATUS_FREQ=4
CONFIG_LED_STATUS_BOOT_ENABLE=y
CONFIG_LED_STATUS_BOOT=0
CONFIG_MTD_PARTITIONS=y
CONFIG_MTD=y
CONFIG_MTD_RAW_NAND=y
CONFIG_SYS_NAND_USE_FLASH_BBT=y
CONFIG_NAND_FLASH_MXL=y
CONFIG_NAND_EBU_MXL=y
CONFIG_MXL_HW_BCH=y
CONFIG_8BITS_BCH_ECC=y
CONFIG_BCH_ECC_STRENGTH=3
CONFIG_SYS_NAND_BLOCK_SIZE=0x20000
CONFIG_SYS_NAND_PAGE_SIZE=0x800
CONFIG_SYS_NAND_OOBSIZE=64
CONFIG_SYS_NAND_ONFI_DETECTION=y
CONFIG_SYS_NAND_MAX_CHIPS=1
CONFIG_MTD_UBI=y
CONFIG_MTD_UBI_WL_THRESHOLD=4096
CONFIG_MTD_UBI_BEB_LIMIT=20
CONFIG_ETH=y
CONFIG_DM_ETH=y
CONFIG_NETDEVICES=y
CONFIG_LIGHTNING_MOUNTAIN_ETH=y
CONFIG_LGM_P34X_SUPPORT=y
CONFIG_LGM_GPHY_FW_SIZE=0x10000
# CONFIG_PCI is not set
# CONFIG_PCH is not set
# CONFIG_X86_PCH7 is not set
# CONFIG_X86_PCH9 is not set
CONFIG_SPL_PINCTRL=y
CONFIG_SPL_PINCTRL_FULL=y
CONFIG_SPL_PINCTRL_GENERIC=y
CONFIG_SPL_PINMUX=y
CONFIG_SPL_PINCONF_RECURSIVE=y
# CONFIG_POWER is not set
# CONFIG_DM_SCSI is not set
# CONFIG_SYSINFO is not set
# CONFIG_SYSRESET is not set
CONFIG_SERIAL=y
CONFIG_BAUDRATE=115200
CONFIG_REQUIRE_SERIAL_CONSOLE=y
# CONFIG_SPECIFY_CONSOLE_INDEX is not set
# CONFIG_CONSOLE_MUX is not set
CONFIG_SERIAL_PRESENT=y
CONFIG_SPL_SERIAL_PRESENT=y
CONFIG_DM_SERIAL=y
# CONFIG_SPL_DM_SERIAL is not set
CONFIG_DEBUG_UART_SHIFT=0
CONFIG_MXL_SERIAL=y
CONFIG_TIMER=y
CONFIG_SPL_TIMER=y
CONFIG_TIMER_EARLY=y
CONFIG_X86_TSC_TIMER=y
# CONFIG_DM_VIDEO is not set
# CONFIG_HAVE_ARCH_IOMAP is not set
# CONFIG_SYS_WHITE_ON_BLACK is not set
CONFIG_HAVE_PRIVATE_LIBGCC=y
CONFIG_PRINTF=y
CONFIG_SPL_PRINTF=y
CONFIG_SPRINTF=y
CONFIG_SPL_SPRINTF=y
CONFIG_STRTO=y
CONFIG_SPL_STRTO=y
CONFIG_USE_PRIVATE_LIBGCC=y
CONFIG_SYS_HZ=1000
CONFIG_SPL_USE_TINY_PRINTF=y
CONFIG_REGEX=y
CONFIG_RBTREE=y
CONFIG_CRC32=y
CONFIG_LZMA=y
CONFIG_LZO=y
CONFIG_GZIP=y
CONFIG_ZLIB=y
CONFIG_OF_LIBFDT=y
CONFIG_OF_LIBFDT_ASSUME_MASK=0
CONFIG_SPL_OF_LIBFDT=y
CONFIG_SPL_OF_LIBFDT_ASSUME_MASK=0xff
# CONFIG_EFI_LOADER is not set
CONFIG_LMB=y
CONFIG_LMB_USE_MAX_REGIONS=y
CONFIG_LMB_MAX_REGIONS=8
CONFIG_MKIMAGE_DTC_PATH="dtc"
CONFIG_TOOLS_CRC32=y
CONFIG_TOOLS_HOST_CRC32=y
CONFIG_TOOLS_LIBCRYPTO=y
```
