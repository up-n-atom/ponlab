## maxlinear/feed_target_x86/intel_x86/dts/octopus_851_fit.its
```
// SPDX-License-Identifier: GPL-2.0

/*
 * Copyright (C) 2022 MaxLinear, Inc.
 *
 * This program is free software; you can redistribute it and/or modify it
 * under the terms of the GNU General Public License, as published by the Free
 * Software Foundation; either version 2 of the License, or (at your option)
 * any later version.
 *
 * This program is distributed in the hope that it will be useful, but WITHOUT
 * ANY WARRANTY; without even the implied warranty of MERCHANTABILITY or
 * FITNESS FOR A PARTICULAR PURPOSE.
 * See the GNU General Public License for more details.
 *
 * You should have received a copy of the GNU General Public License along
 * with this program; if not, see <http://www.gnu.org/licenses/>.
 */

/dts-v1/;

/ {
	description = "Octopus URX851 fit image";

	images {
		fdt {
			description = "Flattened Device Tree blob";
			data = /incbin/("octopus_851.dtb");
			type = "flat_dt";
			arch = "x86";
			compression = "none";
			load = <0x08000000>;
			entry = <0x08000000>;
		};

/*
		wave700 reserved for future
		dtbo_wave700 {
			description = "wave700 overlay";
			data = /incbin/("target/linux/intel_x86/dts/sso_gpio_overlay.dtbo");
			type = "flat_dt";
			arch = "x86";
			compression = "none";
			load = <0x080f0000>;
			entry = <0x08f00000>;
		};
*/

		dtbo_10g_eth {
			description = "10g eth overlay";
			data = /incbin/("eth_serdesb_ov.dtbo");
			type = "flat_dt";
			arch = "x86";
			compression = "none";
			load = <0x080f0000>;
			entry = <0x08f00000>;
		};

		dtbo_serdesAsl {
			description = "PCIe SerdesA configurations";
			data = /incbin/("pcie_serdesa_ov.dtbo");
			type = "flat_dt";
			arch = "x86";
			compression = "none";
		};

		dtbo_serdesBsl {
			description = "PCIe SerdesB configurations";
			data = /incbin/("pcie_serdesb_ov.dtbo");
			type = "flat_dt";
			arch = "x86";
			compression = "none";
		};


		dtbo_serdesCsl {
			description = "PCIe SerdesC configurations";
			data = /incbin/("pcie_serdesc_ov.dtbo");
			type = "flat_dt";
			arch = "x86";
			compression = "none";
		};

		dtbo_serdesDsl {
			description = "PCIe SerdesD configurations";
			data = /incbin/("pcie_serdesd_ov.dtbo");
			type = "flat_dt";
			arch = "x86";
			compression = "none";
		};

	};

	configurations {
		default = "base_dtb";

		base_dtb {
			description = "Linux kernel with FDT blob";
			fdt = "fdt";
		};

/*
		wave700 reserved for future
		wave700 {
			description = "wave700 dtbo";
			fdt = "dtbo_wave700";
		};
*/

		10g_eth {
			description = "10g eth dtbo";
			fdt = "eth_serdesb_ov.dtbo";
		};

		pcie_serdesa {
			description = "pcie serdes-a dtbo";
			fdt = "pcie_serdesa_ov.dtbo";
		};

		pcie_serdesb {
			description = "pcie serdes-b dtbo";
			fdt = "pcie_serdesb_ov.dtbo";
		};

		pcie_serdesc {
			description = "pcie serdes-c dtbo";
			fdt = "pcie_serdesc_ov.dtbo";
		};

		pcie_serdesd {
			description = "pcie serdes-d dtbo";
			fdt = "pcie_serdesd_ov.dtbo";
		};
	};
};
```

## maxlinear/feed_target_x86/intel_x86/image/Config.in
```kconfig
config X86_ETHERBOOT_IMAGES
	bool "Build Etherboot image"
	depends on TARGET_x86_thincan_DBE61
	default y
	help
		Builds network bootable image for ThinCan DBE61 (Etherboot BIOS)

config X86_ETHERBOOT_BOOTOPTS
	string "Extra kernel boot options"
	depends on X86_ETHERBOOT_IMAGES
	default "ip=dhcp nbdport=2000 " if TARGET_ROOTFS_SQUASHFS
	default "ip=dhcp root=/dev/nfs nfsroot=192.168.0.1:/srv/dbe61"
	help
		Kernel arguments to pass to the kernel eg. NFS root location etc.

config NEW_FRAMEWORK
	bool "UGW NEW FRAMEWORK"
	default y
	help
		UGW New Framework

config INTEL_X86_ALT_SUBTARGET_CONFIG
	string "Use an alternate subtarget kernel config"
	depends on TARGET_intel_x86
	help
	  Use an alternate subtarget kernel config other than config-default like config-default-x.
	  Mention only the file suffix name 'x' here.

config INTEL_X86_KERNEL_METADATA
        bool "UGW KERNEL METADATA FRAMEWORK"
        depends on (TARGET_intel_x86_lgm)
        help
          Used for enabling the metadata framework on the kernel.

config BUILD_SDK
	string "Type/Name of the SDK"
	depends on TARGET_intel_x86
	default "ugw"
	help
	  Specify the Type/Name of SDK being used.
	  Mention one of 'ugw' or 'prplos' here

config INTEL_X86_ENV_SZ
	hex 'config env size'
	depends on TARGET_intel_x86
	default 0x80000
	help
	  config u-boot env partition size 

menuconfig INTEL_X86_SECBOOT
	bool "Secure Boot Image options for X86 based Intel Platforms" if IMAGEOPT
	depends on (TARGET_intel_x86_lgm)
	help
			These options allow to build secure boot image variant for
			Intel X86 Platform. Input signtool, public key and
			CRkey (Confidentiality Root Key) with optional Certificate
			support and path

config INTEL_X86_IMAGE_FORMAT_FIT
	bool "Build a image in FIT format"
	help
		Builds a image in FIT format.

config INTEL_X86_IMAGE_FORMAT_MKIMAGE
	bool "Build a image in mkimage format"
	default y
	help
		Builds a image in mkimage format.

if INTEL_X86_SECBOOT
	config INTEL_X86_EXTERNAL_IMAGE_SIGNING
		bool "enable external image signing"
		help
			Build system generates unsigned images.External
			signing util will be used to sign these images.
	
	config INTEL_X86_SIGNING_SER_USER
		string "signing server user"
		default ""
		help
			external signing server user.
	
	config INTEL_X86_SIGNING_SER_PASS
		string "signing server password"
		default ""
		help
			external signing server password.

	config INTEL_X86_KEYS_PROVISION
		bool "provison of keys done"
		help
			keys path properly set

	config INTEL_X86_SIGNTOOL
		string "signtool (path)"
		default "signtool"
		help
			signtool as released to Customer
			If unspecified, it defaults to signtool.

	config INTEL_X86_PROD_UNIQUE_KEY
		string "product unique key(path)"
		default "CRkey.bin"
		help
			AES256 product unique key.
			If unspecified, it defaults to CRkey.bin

	config INTEL_X86_PRIVATE_KEY
		string "private key(path)"
		default "privatekey.der"
		help
			ECDSA256 private key.
			If unspecified, it defaults to privatekey.der

	config INTEL_X86_ENC_KEY
		string "enc key(path)"
		default "ENCkey.bin"
		help
			ENC256 private key.
			If unspecified, it defaults to ENCkey.bin

	config INTEL_X86_CERTIFICATION_SUPPORT
		bool "Certification Support"
		help
			enable chain of trust certificate.

	config INTEL_X86_CERTIFICATION
		string "certification(path)"
		default "cert.bin"
		depends on INTEL_X86_CERTIFICATION_SUPPORT
		help
			ECDSA256 certificate
			If unspecified, it defaults to cert.bin

	config INTEL_X86_TEP_BASEADDR
		hex 'tep base address'
		default 0x00100000
		help
			tep base address

	config INTEL_X86_AIC_BASEADDR
		hex 'aic base address'
		default 0x010000000
		help
			aic base address

	config INTEL_X86_KERNEL_BASEADDR
		hex 'kernel base address'
		default 0x8200000
		help
			kernel base address

	config INTEL_X86_KERNEL_ROLLBACKID
		hex 'kernel roll back id'
		default 0x4
		help
			kernel roll back id

	config INTEL_X86_ROOTFS_ROLLBACKID
		hex 'rootfs roll back id'
		default 0x4
		help
			rootfs roll back id

	config INTEL_X86_DTB_ROLLBACKID
		hex 'dtb roll back id'
		default 0x4
		help
			device tree roll back id

	config INTEL_X86_TEP_ROLLBACKID
		hex 'tep roll back id'
		default 0x4
		help
			tep roll back id
endif
```

## maxlinear/feed_target_x86/intel_x86/image/kernel-dtb-fit.its
```
/*
 * The image source file creates FIT image with MXL URX Linux kernel and Device Tree Blob (DTB)
 */

/dts-v1/;

/ {
	description = "FIT image with MXL URX Linux kernel and DTB";

	images {
		kernel {
			description = " MXL URX Linux kernel";
			data = /incbin/("KERNEL");
			type = "kernel";
			arch = "x86_64";
			os = "linux";
			compression = "gzip";
			load = <0x02000000>;
			entry = <0x02000000>;
			hash-1 {
				algo = "crc32";
			};
			hash-2 {
				algo = "sha1";
			};
		};
		device-tree {
			description = "Device Tree blob";
			data = /incbin/("DTB");
			type = "flat_dt";
			arch = "x86_64";
			compression = "none";
			hash-1 {
				algo = "crc32";
			};
			hash-2 {
				algo = "sha1";
			};
		};
	};

	configurations {
		default = "kernel-dtb-conf";
		kernel-dtb-conf {
			description = "MXL URX Linux kernel with Device Tree blob";
			kernel = "kernel";
			fdt = "device-tree";
		};
	};
};
```

## maxlinear/feed_target_x86/intel_x86/image/overlay_pon.its
```
/*
 * The image source file creates FIT image with MXL URX Base Device Tree Blob (DTB) and Device Tree Blob Overlay (DTBO).
 */

/dts-v1/;

/ {
	description = "URX overlay fit image";

	images {
		fdt {
			description = "Base Device Tree blob";
			data = /incbin/("DTB_FILE");
			type = "flat_dt";
			arch = "x86_64";
			compression = "none";
			load = <0x8000000>;
		};

		dtbopon {
			description = "PON overly";
			data = /incbin/("DTBO_FILE");
			type = "flat_dt"; 
			arch = "x86_64";
			compression = "none";
		};
	};

	configurations {
		default = "basedtb";

		basedtb {
			description = "base dtb";
			fdt = "fdt";
		};

		pon {
			description = "PON dtbo";
			fdt = "dtbopon";
		};
	};
};
```
