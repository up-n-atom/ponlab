## maxlinear/feed_uboot/open_uboot/config/arch/arc/Kconfig
```kconfig
menu "ARC architecture"
	depends on UBOOT_CONFIG_ARC

config UBOOT_CONFIG_SYS_ARCH
	default "arc"

config UBOOT_CONFIG_SYS_CPU
	default "arcv1" if UBOOT_CONFIG_ISA_ARCOMPACT
	default "arcv2" if UBOOT_CONFIG_ISA_ARCV2

choice
	prompt "ARC Instruction Set"
	default UBOOT_CONFIG_ISA_ARCOMPACT

config UBOOT_CONFIG_ISA_ARCOMPACT
	bool "ARCompact ISA"
	help
	  The original ARC ISA of ARC600/700 cores

config UBOOT_CONFIG_ISA_ARCV2
	bool "ARC ISA v2"
	help
	  ISA for the Next Generation ARC-HS cores

endchoice

choice
	prompt "CPU selection"
	default UBOOT_CONFIG_CPU_ARC770D if UBOOT_CONFIG_ISA_ARCOMPACT
	default UBOOT_CONFIG_CPU_ARCHS38 if UBOOT_CONFIG_ISA_ARCV2

config UBOOT_CONFIG_CPU_ARC750D
	bool "ARC 750D"
	depends on UBOOT_CONFIG_ISA_ARCOMPACT
	select UBOOT_CONFIG_ARC_MMU_V2
	help
	  Choose this option to build an U-Boot for ARC750D CPU.

config UBOOT_CONFIG_CPU_ARC770D
	bool "ARC 770D"
	depends on UBOOT_CONFIG_ISA_ARCOMPACT
	select UBOOT_CONFIG_ARC_MMU_V3
	help
	  Choose this option to build an U-Boot for ARC770D CPU.

config UBOOT_CONFIG_CPU_ARCEM6
	bool "ARC EM6"
	depends on UBOOT_CONFIG_ISA_ARCV2
	select UBOOT_CONFIG_ARC_MMU_ABSENT
	help
	  Next Generation ARC Core based on ISA-v2 ISA without MMU.

config UBOOT_CONFIG_CPU_ARCHS36
	bool "ARC HS36"
	depends on UBOOT_CONFIG_ISA_ARCV2
	select UBOOT_CONFIG_ARC_MMU_ABSENT
	help
	  Next Generation ARC Core based on ISA-v2 ISA without MMU.

config UBOOT_CONFIG_CPU_ARCHS38
	bool "ARC HS38"
	depends on UBOOT_CONFIG_ISA_ARCV2
	select UBOOT_CONFIG_ARC_MMU_V4
	help
	  Next Generation ARC Core based on ISA-v2 ISA with MMU.

endchoice

choice
	prompt "MMU Version"
	default UBOOT_CONFIG_ARC_MMU_V3 if UBOOT_CONFIG_CPU_ARC770D
	default UBOOT_CONFIG_ARC_MMU_V2 if UBOOT_CONFIG_CPU_ARC750D
	default UBOOT_CONFIG_ARC_MMU_ABSENT if UBOOT_CONFIG_CPU_ARCEM6
	default UBOOT_CONFIG_ARC_MMU_ABSENT if UBOOT_CONFIG_CPU_ARCHS36
	default UBOOT_CONFIG_ARC_MMU_V4 if UBOOT_CONFIG_CPU_ARCHS38

config UBOOT_CONFIG_ARC_MMU_ABSENT
	bool "No MMU"
	help
	  No MMU

config UBOOT_CONFIG_ARC_MMU_V2
	bool "MMU v2"
	depends on UBOOT_CONFIG_CPU_ARC750D
	help
	  Fixed the deficiency of v1 - possible thrashing in memcpy sceanrio
	  when 2 D-TLB and 1 I-TLB entries index into same 2way set.

config UBOOT_CONFIG_ARC_MMU_V3
	bool "MMU v3"
	depends on UBOOT_CONFIG_CPU_ARC770D
	help
	  Introduced with ARC700 4.10: New Features
	  Variable Page size (1k-16k), var JTLB size 128 x (2 or 4)
	  Shared Address Spaces (SASID)

config UBOOT_CONFIG_ARC_MMU_V4
	bool "MMU v4"
	depends on UBOOT_CONFIG_CPU_ARCHS38
	help
	  Introduced as a part of ARC HS38 release.

endchoice

config UBOOT_CONFIG_CPU_BIG_ENDIAN
	bool "Enable Big Endian Mode"
	help
	  Build kernel for Big Endian Mode of ARC CPU

config UBOOT_CONFIG_SYS_ICACHE_OFF
	bool "Do not enable icache"
	help
	  Do not enable instruction cache in U-Boot.

config UBOOT_CONFIG_SPL_SYS_ICACHE_OFF
	bool "Do not enable icache in SPL"
	depends on UBOOT_CONFIG_SPL
	default UBOOT_CONFIG_SYS_ICACHE_OFF
	help
	  Do not enable instruction cache in SPL.

config UBOOT_CONFIG_SYS_DCACHE_OFF
	bool "Do not enable dcache"
	help
	  Do not enable data cache in U-Boot.

config UBOOT_CONFIG_SPL_SYS_DCACHE_OFF
	bool "Do not enable dcache in SPL"
	depends on UBOOT_CONFIG_SPL
	default UBOOT_CONFIG_SYS_DCACHE_OFF
	help
	  Do not enable data cache in SPL.

menuconfig UBOOT_CONFIG_ARC_DBG
	bool "ARC debugging"

if UBOOT_CONFIG_ARC_DBG

config UBOOT_CONFIG_ARC_DBG_IOC_ENABLE
	bool "Enable IO coherency unit"
	depends on UBOOT_CONFIG_CPU_ARCHS38
	help
	  Enable IO coherency unit to debug problems with caches and
	  DMA peripherals.
	  NOTE: as of today linux will not work properly if this option
	  is enabled in u-boot!

endif

choice
	prompt "Target select"
	default UBOOT_CONFIG_TARGET_AXS103

config UBOOT_CONFIG_TARGET_TB100
	bool "Support tb100"

config UBOOT_CONFIG_TARGET_NSIM
	bool "Support ARC simulation & prototyping platforms"

config UBOOT_CONFIG_TARGET_AXS101
	bool "Support Synopsys Designware SDP board AXS101"

config UBOOT_CONFIG_TARGET_AXS103
	bool "Support Synopsys Designware SDP board AXS103"

config UBOOT_CONFIG_TARGET_EMSDP
	bool "Synopsys EM Software Development Platform"
	select UBOOT_CONFIG_CPU_ARCEM6

config UBOOT_CONFIG_TARGET_HSDK
	bool "Support Synopsys HSDK or HSDK-4xD board"

config UBOOT_CONFIG_TARGET_IOT_DEVKIT
	bool "Synopsys Brite IoT Development kit"
	select UBOOT_CONFIG_CPU_ARCEM6

endchoice

source "../../board/abilis/tb100/Kconfig"
source "../../board/synopsys/axs10x/Kconfig"
source "../../board/synopsys/emsdp/Kconfig"
source "../../board/synopsys/hsdk/Kconfig"
source "../../board/synopsys/iot_devkit/Kconfig"
source "../../board/synopsys/nsim/Kconfig"

endmenu
```

## maxlinear/feed_uboot/open_uboot/config/arch/arm/cpu/armv7/vf610/Kconfig
```kconfig
if UBOOT_CONFIG_ARCH_VF610

config UBOOT_CONFIG_VF610
	bool
	default y

choice
	prompt "Vybrid board select"

config UBOOT_CONFIG_TARGET_VF610TWR
	bool "TWR-VF65GS10-DS5"

config UBOOT_CONFIG_TARGET_COLIBRI_VF
	bool "Colibri VF50/61"
	select UBOOT_CONFIG_BOARD_LATE_INIT

config UBOOT_CONFIG_TARGET_PCM052
	bool "PCM-052"
	select UBOOT_CONFIG_SYS_FSL_ERRATUM_ESDHC135
	select UBOOT_CONFIG_SYS_FSL_ERRATUM_ESDHC_A001

config UBOOT_CONFIG_TARGET_BK4R1
	bool "BK4r1"
	select UBOOT_CONFIG_SYS_FSL_ERRATUM_ESDHC135
	select UBOOT_CONFIG_SYS_FSL_ERRATUM_ESDHC_A001
	select UBOOT_CONFIG_BOARD_LATE_INIT

endchoice

config UBOOT_CONFIG_SYS_SOC
	default "vf610"

source "../../../../../board/freescale/vf610twr/Kconfig"
source "../../../../../board/phytec/pcm052/Kconfig"
source "../../../../../board/toradex/colibri_vf/Kconfig"

endif
```
