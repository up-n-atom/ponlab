## Documentation/devicetree/bindings/sound/mxl-i2s.yaml
```yaml
# SPDX-License-Identifier: (GPL-2.0-only OR BSD-2-Clause)
%YAML 1.2
---
$id: http://devicetree.org/schemas/sound/mxl-i2s.yaml#
$schema: http://devicetree.org/meta-schemas/core.yaml#

title: MaxLinear I2S controller

properties:
  compatible:
    oneOf:
      - const: mxl,lgm-i2s

  reg:
    maxItems: 1

  interrupts:
    maxItems: 1

  clocks:
    maxItems: 1

  clock-names:
    items:
      - const: freq

  power-domains:
    maxItems: 1

  reset-names:
    items:
      - const: i2s

  resets:
    maxItems: 1

  "#sound-dai-cells":
    const: 0

required:
  - compatible
  - reg
  - interrupts
  - clocks
  - clock-names
  - resets
  - reset-names
  - "#sound-dai-cells"

additionalProperties: false

examples:
  - |
    i2s@e2700000 {
      compatible = "mxl,lgm-i2s";
      reg = <0xe2700000 0x10000>;
      interrupt-parent = <&ioapic1>;
      interrupts = <114 1>;
      clocks = <&cgu0 LGM_CLK_VIF>;
      clock-names = "freq";
      resets = <&rcu0 0x30 26>;
      reset-names = "i2s";
      power-domains = <&pd_i2s1>;
      #sound-dai-cells = <0>;
    };
```

## gpon-libs/config/Config.in
```kconfig
config GPON_TOP_LINE_LEN
	int "Maximum line length for TOP table/dump data"
	range 0 1000
	default 1000

config GPON_TOP_LINE_MAX
	int "Maximum amount of lines for TOP table/dump data"
	range 0 25000
	default 1000
```

## intel/feed_system_service/sse_fapi/config/Config.in
```kconfig
config EIP123_SUPPORT
	bool 'Enable EIP123 Support'
	depends on KEYS_PROVISION
	default y
	help
	  Enable EIP123 SUPPORT

config EIP123_DEBUG
	bool 'Enable Debug'
	depends on KEYS_PROVISION
	help
	  Enable debug messages

config SECURE_BOOT_AUTH_SUPPORT
	bool 'Enable secure upgrade support'
	depends on KEYS_PROVISION
	default y
	help
	  Enable Secure Boot Authentication Support 
```

## pon-base-files/config/Config.in
```kconfig
config PON_SDK_VERSION
	string "PON release version number"
	default "1.23.0"

config PON_BASE_FILES_COPY
	bool "Copy PON base files for version information"
```

## sound/soc/mxl/Kconfig
```kconfig
# SPDX-License-Identifier: GPL-2.0-only
menuconfig SND_MXL_I2S
	tristate "I2S for MaxLinear SoC"
	help
	  Say Y or M if you want to add support for I2S attached to
	  the MXL SoC interface.
```
