// SPDX-License-Identifier: GPL-2.0
/*
 * Copyright (C) 2020-2022 MaxLinear, Inc.
 * Copyright (C) 2019-2020 Intel Corporation.
 */

/dts-v1/;
#include "octopus_851_base.dtsi"
#include "octopus_641_sfp_eth_wan.dtsi"
#include "octopus_641_pcie20.dtsi"
#include "octopus_emmc.dtsi"
#include "octopus_641_led.dtsi"
#include "voice.dtsi"
