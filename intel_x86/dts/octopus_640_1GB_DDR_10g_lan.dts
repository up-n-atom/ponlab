// SPDX-License-Identifier: GPL-2.0
/*
 * Copyright (C) 2024 MaxLinear, Inc.
 * eMMC with 1GB DDR model
 */

/dts-v1/;
#include "octopus_640_base.dtsi"
#include "lgmc_emta_1GB.dtsi"
#include "octopus_640_10g_lan.dtsi"
#include "octopus_640_10g_phy_wan.dtsi"
#include "octopus_emmc.dtsi"
#include "octopus_640_led.dtsi"
#include "octopus_640_gpy215.dtsi"
#include "octopus_640_gsw120.dtsi"
#include "voice.dtsi"
