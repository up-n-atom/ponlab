// SPDX-License-Identifier: GPL-2.0
/*
 * Copyright (C) 2023 MaxLinear, Inc.
 */

/* combo phy 2 */
&combophy2 { /* PCIe20/21, HSIOR_XPCS0/1, SATA20/21 */
	status = "okay";
};

&hsior_xpcs0 {
	status = "disabled";
};

&pcie20 {
	status = "okay";
};
