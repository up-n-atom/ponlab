// SPDX-License-Identifier: GPL-2.0
/*
 * Copyright (C) 2024 MaxLinear, Inc.
 */

/dts-v1/;
#include "octopus_640_base.dtsi"
#include "octopus_640_p34x_lan.dtsi"
#include "octopus_640_10g_phy_wan.dtsi"
#include "octopus_640_qspi_nand.dtsi"
#include "octopus_640_led.dtsi"
#include "voice.dtsi"
