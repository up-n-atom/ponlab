// SPDX-License-Identifier: GPL-2.0
/*
 * Copyright (C) 2021-2024 MaxLinear, Inc.
 */
/dts-v1/;
#include "octopus_641_base.dtsi"
#include "octopus_641_sfp_eth_wan.dtsi"
#include "octopus_641_10g_phy_lan.dtsi"
#include "octopus_emmc.dtsi"
#include "octopus_641_led.dtsi"
#include "voice.dtsi"

