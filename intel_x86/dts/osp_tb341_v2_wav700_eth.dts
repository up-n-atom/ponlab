// SPDX-License-Identifier: GPL-2.0
/*
 * Copyright (C) 2021 MaxLinear, Inc.
 */
 
/dts-v1/;
#include "osp_tb341_v2_base.dtsi"
#include "octopus_641_sfp_eth_wan.dtsi"
#include "osp_tb341_v2_10g_phy_lan.dtsi"
#include "octopus_emmc.dtsi"
#include "wave700.dtsi"
#include "osp_tb341_v2_led.dtsi"
#include "voice.dtsi"
