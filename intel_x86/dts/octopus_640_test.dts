// SPDX-License-Identifier: GPL-2.0
/*
 * This file created for LGMC bring up only.
 * It will be removed after bring up.
 *
 * Copyright (C) 2024 MaxLinear, Inc.
 */

/dts-v1/;
#include "octopus_640_base.dtsi"

/* Please choose between p34x LAN or 10G PHY LAN */
//#include "octopus_640_p34x_lan.dtsi"
#include "octopus_640_10g_lan.dtsi"

/* Please choose the WAN here */
//#include "octopus_640_10g_phy_wan.dtsi"
#include "octopus_640_10g_sfp_wan.dtsi"

#include "octopus_640_gpy215.dtsi"
#include "octopus_640_gsw120.dtsi"

/* Please choose only one of the flash type here*/
#include "octopus_emmc.dtsi"
//#include "octopus_ebu_nand.dtsi"
//#include "octopus_qspi_nand.dtsi"

#include "octopus_640_led.dtsi"
