// SPDX-License-Identifier: GPL-2.0
/*
 * Copyright (C) 2021 MaxLinear, Inc.
 */

/dts-v1/;
#include "octopus_851_base.dtsi"
#include "octopus_641_sfp_pon_wan.dtsi"
#include "octopus_641_10g_phy_lan.dtsi"
#include "octopus_emmc.dtsi"
#include "wave700.dtsi"
#include "octopus_641_led.dtsi"
#include "voice.dtsi"
