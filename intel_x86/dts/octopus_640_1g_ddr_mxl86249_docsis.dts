// SPDX-License-Identifier: GPL-2.0
/*
 * Copyright (C) 2024 MaxLinear, Inc.
 */

/dts-v1/;
#include "octopus_640_base.dtsi"
#include "octopus_640_docsis.dtsi"
#include "octopus_640_p34x_lan.dtsi"
#include "lgmc_emta_docsis_1GB.dtsi"
#include "octopus_emmc.dtsi"
#include "octopus_640_led.dtsi"
#include "octopus_640_gpy215.dtsi"
#include "octopus_640_gsw120.dtsi"
#include "voice.dtsi"
