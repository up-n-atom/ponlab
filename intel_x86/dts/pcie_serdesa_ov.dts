// SPDX-License-Identifier: GPL-2.0
/*
 * Copyright (C) 2022 MaxLinear, Inc.
 *
 * This program is free software; you can redistribute it and/or modify it
 * under the terms of the GNU General Public License, as published by the Free
 * Software Foundation; either version 2 of the License, or (at your option)
 * any later version.
 *
 * This program is distributed in the hope that it will be useful, but WITHOUT
 * ANY WARRANTY; without even the implied warranty of MERCHANTABILITY or
 * FITNESS FOR A PARTICULAR PURPOSE.
 * See the GNU General Public License for more details.
 *
 * You should have received a copy of the GNU General Public License along
 * with this program; if not, see <http://www.gnu.org/licenses/>.
 */

/dts-v1/;
/plugin/;

#include <dt-bindings/gpio/gpio.h>

/* GPIO for SerdesA HSEC8 */
&gpio0 {
	hsec_power0 {
		gpio-hog;
		gpios = <32 GPIO_ACTIVE_HIGH>;
		output-high;
		line-name = "SerdesA_hsec_power";
	};
};

&pcie10 {
	status = "okay";
};

