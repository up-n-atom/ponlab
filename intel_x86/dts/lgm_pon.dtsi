// SPDX-License-Identifier: GPL-2.0
/*
 * Copyright (C) 2023 MaxLinear, Inc.
 */

&cqm_sram {
	reg = <0x0 0x2eb00>;
};

&toe_sram {
	reg = <0x2eb00 0x51500>;
};

&ppv4 {
	qos@1000000 {
		wred-total-resources = <425984>;
	};
};
